## action_technology_sdk/zephyr/framework/sensor/sensor_hal/Kconfig
```kconfig
# Configuration options for Actions Sensor

# Copyright (c) 2020 Actions Technology Co., Ltd
# SPDX-License-Identifier: Apache-2.0

menuconfig SENSOR_HAL
	bool "Sensor hal"
	help
	  Enable Sensor Hal

if SENSOR_HAL

config SENSOR_TASK_CFG
	bool "Config sensor using task"
	default y
#	depends on (SOC_SERIES_LARK || SOC_SERIES_LARK_FPGA)
	help
	  Config sensor using task

config SENSOR_TASK_POLL
	bool "Poll sensor using task"
	default y
	help
	  Poll sensor using task

rsource "devices/Kconfig"

endif # SENSOR_HAL
```

## action_technology_sdk/zephyr/kernel/Kconfig.acts
```kconfig
# Kernel configuration options

# Copyright (c) 2014-2015 Wind River Systems, Inc.
# SPDX-License-Identifier: Apache-2.0

menu "Actions Kernel Options"

config DEVICE_DEBUG
	bool "Device runtime debug"
	default y
	help
	  This option enables device debug code in kernel.

config STACK_MONITOR
	bool "Enable stack usage monitor"
	depends on STACK_SENTINEL
	default n
	help
	  Support stack usage monitor. The kernel will check the thread stack
	  usage at the entry of interrupt.

config STACK_MONITOR_WARN_THRESHOLD
	int "The warning threshold of free stack size"
	depends on STACK_MONITOR
	default 64
	help
	  Config the warning threshold of free stack size.

config STACK_MONITOR_PARANOID
	bool "Check stack usage more paranoid"
	depends on STACK_MONITOR && INIT_STACKS
	default n
	help
	  Check stack usage by comparing with stack initial magic data

config TIME_SLEEP_COMP
	bool "cpu Sleep time compensation"
	depends on ACTS_TIMER  && PM_DEVICE
	default n
	help
	  CPU enter S3, Time stop, need compensation

endmenu
```

## action_technology_sdk/zephyr/lib/cjson/Kconfig
```kconfig
# Copyright (c) 2016 Intel Corporation
# SPDX-License-Identifier: Apache-2.0

config CJSON_LIB
	bool "Build cJSON library"
	default n
	help
	  Build a cJSON parsing/encoding library. Used by sample
	  applications such as the sample/cjson.
```

## action_technology_sdk/zephyr/soc/arm/actions/Kconfig
```kconfig
# Copyright (c) 2016 Open-RnD Sp. z o.o.
# SPDX-License-Identifier: Apache-2.0

config SOC_FAMILY_ACTS
	bool
	select HAS_SEGGER_RTT
	select BUILD_OUTPUT_HEX

if SOC_FAMILY_ACTS

config SOC_FAMILY
	string
	default "actions"

source "soc/arm/actions/*/Kconfig.soc"

endif # SOC_FAMILY_ACTS
```

## action_technology_sdk/zephyr/soc/arm/actions/leopard/Kconfig.defconfig.leopard
```kconfig
# LEOPARD MCU configuration options

# Copyright (c) 2016 Linaro Limited.
# SPDX-License-Identifier: Apache-2.0

if SOC_LEOPARD

config SOC
	default "leopard"

config NUM_IRQS
	default 64

config SOC_SPICACHE_PROFILE
	bool "Enable SPI cache profile"
	default n
	help
	  Enable SPI cache profile for actions SoC

config SOC_SPICACHE_PROFILE_STAT
	bool "Enable SPI cache profile stat"
	default n
	help
	  Enable SPI cache profile stat for actions SoC

config SOC_DSP_EXT_RAM_SIZE
	int "DSP ext ram size Kbytes"
	default 224
	help
	  sizeof dsp ext ram size kbytes.

endif # SOC_LEOPARD
```

## action_technology_sdk/zephyr/subsys/debug/tracedump/Kconfig
```kconfig
# Copyright (c) 2020 Intel Corporation.
# SPDX-License-Identifier: Apache-2.0

config DEBUG_TRACEDUMP
	bool
	prompt "Dump trace info"
	default n
	help
	  This option enable trace dump support.
```

## action_technology_sdk/zephyr/subsys/fs/fsck_msdos/Kconfig
```kconfig
# Copyright (c) 2020 Intel Corporation.
# SPDX-License-Identifier: Apache-2.0

config FSCK_MSDOS
	bool
	prompt "fsck for FAT file system"
	default n
	depends on FAT_FILESYSTEM_ELM
	help
	  This option enable fsck_msdos support.
```

## action_technology_sdk/zephyr/subsys/fw_version/Kconfig
```kconfig
# Kconfig - Firmware version options
#
# Copyright (c) 2019 Actions Semiconductor Co.,Ltd
#
# SPDX-License-Identifier: Apache-2.0
#

menu "Firmware version"

config FIRMWARE_VERSION
	bool
	prompt "Enable firmware version interface"
	default y
	help
	  This option enable firmware version interface

endmenu
```

## action_technology_sdk/zephyr/subsys/partition/Kconfig
```kconfig
# Kconfig - Partition options
#
# Copyright (c) 2019 Actions Semiconductor Co.,Ltd
#
# SPDX-License-Identifier: Apache-2.0
#

menu "Partition"

config PARTITION
	bool
	prompt "Enable partition interface"
	default y
	help
	  This option enable partition interface for FLASH device
endmenu
```

## action_technology_zephyr_sdk/application/app_demo/bt_call_demo/src/btcall/Kconfig
```kconfig
# Kconfig - ACTIONS primitive options for sdk version 2.0

#
# Copyright (c) 2015 Intel Corporation
#
# Licensed under the Apache License, Version 2.0 (the "License");
# you may not use this file except in compliance with the License.
# You may obtain a copy of the License at
#
#     http://www.apache.org/licenses/LICENSE-2.0
#
# Unless required by applicable law or agreed to in writing, software
# distributed under the License is distributed on an "AS IS" BASIS,
# WITHOUT WARRANTIES OR CONDITIONS OF ANY KIND, either express or implied.
# See the License for the specific language governing permissions and
# limitations under the License.
#

config BT_CALL_APP
	bool
	prompt "Bt Call App Support"
	depends on MEDIA_PLAYER
	default n
	select STREAM
	select RINGBUFF_STREAM
	select HFP_PLC
	select HFP_SPEECH
	select HFP_DAE
	select BT_MANAGER
	help
	This option enable or disable bt call app

config BT_CALL_FORCE_PLAY_PHONE_NUM
	bool
	prompt "force play phone number"
	depends on BT_CALL_APP
	default n
	help
	This option enable force play phone number
```

## action_technology_zephyr_sdk/application/app_demo/local_music_demo/Kconfig
```kconfig
# Kconfig - ACTIONS primitive options for sdk version 2.0

#
# Copyright (c) 2015 Intel Corporation
#
# Licensed under the Apache License, Version 2.0 (the "License");
# you may not use this file except in compliance with the License.
# You may obtain a copy of the License at
#
#     http://www.apache.org/licenses/LICENSE-2.0
#
# Unless required by applicable law or agreed to in writing, software
# distributed under the License is distributed on an "AS IS" BASIS,
# WITHOUT WARRANTIES OR CONDITIONS OF ANY KIND, either express or implied.
# See the License for the specific language governing permissions and
# limitations under the License.
#

mainmenu "BT DEMO App"

source "Kconfig.zephyr"

menu "App Configuration"

config APP_PRIORITY
    int
    prompt "App Thread Priority"
    default 10
    help
    This option set app thread priority

config APP_STACKSIZE
    int
    prompt "App Thread Stack Size"
    default 2048
    help
    This option set stack size for app thread

config APP_UI_DISK_B
string "drive name for ui resource"
default "/SD:B"
help
  This option set driver name for ui resource
  
config APP_UI_DISK
  string "drive name for ui resource"
  default "/SD:A"
  help
    This option set driver name for ui resource

config APP_FONT_DISK
  string "drive name for ui resource"
  default "/SD:C"
  help
    This option set driver name for ui resource

config APP_FAT_DISK
  string "drive name for fatfs"
  default "/SD:"
  help
    This option set drive name for fatfs

config WELCOME_UI_DISK
  string "drive name for welcome ui resource"
  default "/SD:A"
  help
    This option set driver name for welcome ui resource

rsource "src/main/Kconfig"
rsource "src/lcmusic/Kconfig"

endmenu
```

## action_technology_zephyr_sdk/application/app_demo/usbd_msc_demo/Kconfig
```kconfig
source "Kconfig.zephyr"
source "${ZEPHYR_BASE}/../thirdparty/lib/CherryUSB/Kconfig"
```

## action_technology_zephyr_sdk/application/bt_watch/boards/ats3085s_dev_watch_ext_nor.conf
```kconfig
#=========== config for boards ===========
CONFIG_DSP_IMAGE_PATH="/NOR:K/"

#CONFIG_VIEW_SCROLL_MEM_LOWEST=y
CONFIG_VIEW_CACHE_LEVEL=2

# Set auto size decided by shared surface buffer size
CONFIG_LV_VDB_SIZE=0
CONFIG_UI_MEM_BLOCK_SIZE=434432
CONFIG_UI_MEM_NUMBER_BLOCKS=10
CONFIG_UI_GUI_MEM_POOL_SIZE=118304
CONFIG_UI_RES_MEM_POOL_SIZE=3000000
CONFIG_BITMAP_PER_FONT_CACHE_SIZE=98304
CONFIG_BITMAP_FONT_CACHE_POOL_SIZE=180000
CONFIG_FREETYPE_FONT_BITMAP_BPP=2
CONFIG_FREETYPE_PER_FONT_CACHE_SIZE=36864
CONFIG_FREETYPE_FONT_ENABLE_MEMORY_FACE=y
CONFIG_FREETYPE_FONT_MAX_FACES=2
CONFIG_FREETYPE_FONT_MAX_SIZES=3
CONFIG_FREETYPE_SHAPE_INFO_CACHE_SIZE=5120
CONFIG_FREETYPE_FONT_SHAPE_CACHE_SIZE=60000
CONFIG_RES_MANAGER_BLOCK_SIZE=434432
CONFIG_RES_MANAGER_BLOCK_NUM=2

CONFIG_OTA_TEMP_PART_DEV_NAME="spi_flash"

#usb mass storage config
CONFIG_MASS_STORAGE_DISK_PDRV=0
CONFIG_MASS_STORAGE_DISK_NAME="NOR"

CONFIG_SPINAND_ACTS=n
CONFIG_SPINAND_LIB=n

CONFIG_DISK_ACCESS_NOR=y
CONFIG_APP_UI_DISK="/NOR:A"
CONFIG_APP_FONT_DISK="/NOR:C"
CONFIG_APP_FAT_DISK="/NOR:"
CONFIG_APP_UI_DISK_B="/NOR:B"
CONFIG_WELCOME_UI_DISK="/NOR:K"

CONFIG_SVG_RENDER=y

CONFIG_MASS_STORAGE_BUF_SIZE=4096

CONFIG_IPMSG_BTC_FCC_NAME="/NOR:K/fcc.bin"
CONFIG_BT_MP_BTC_FILE_NAME="/NOR:K/mp_btc.bin"

CONFIG_USER_WORK_Q=y
CONFIG_USER_WORK_Q_PRIORITY=8

CONFIG_UI_MEM_VDB_SHARE_SURFACE_BUFFER=y

CONFIG_DVFS=y
CONFIG_ACTS_DVFS_DYNAMIC_LEVEL=y

#=========== little fs support ============
#CONFIG_FILE_SYSTEM_SHELL=y
CONFIG_FILE_SYSTEM_MAX_TYPES=3
CONFIG_FILE_SYSTEM_LITTLEFS=y
CONFIG_FS_LITTLEFS_BLOCK_SIZE=4096
CONFIG_FS_LITTLEFS_READ_SIZE=512
CONFIG_FS_LITTLEFS_PROG_SIZE=512
CONFIG_FS_LITTLEFS_CACHE_SIZE=4096
CONFIG_FS_LITTLEFS_LOOKAHEAD_SIZE=128
CONFIG_FS_LITTLEFS_FC_HEAP_SIZE=16384

#=========== video ===========
CONFIG_VIDEO_PLAYER=y
CONFIG_VIDEO_APP=y
#CONFIG_VIDEO_APP_AUDIO_ENABLE=n
```

## action_technology_zephyr_sdk/application/bt_watch/boards/ats3089p_dev_watch_sdnand_8b.conf
```kconfig
#=========== config for boards ===========
CONFIG_DSP_IMAGE_PATH="/SD:K/"
CONFIG_APP_STACKSIZE=2048
CONFIG_MAIN_STACK_SIZE=2048

#CONFIG_VIEW_SCROLL_MEM_LOWEST=y
CONFIG_VIEW_CACHE_LEVEL=2

# Set auto size decided by shared surface buffer size
CONFIG_LV_VDB_SIZE=0
CONFIG_UI_MEM_BLOCK_SIZE=434432
CONFIG_UI_MEM_NUMBER_BLOCKS=10
CONFIG_UI_GUI_MEM_POOL_SIZE=98304
CONFIG_UI_RES_MEM_POOL_SIZE=16377216
CONFIG_BITMAP_PER_FONT_CACHE_SIZE=98304
CONFIG_BITMAP_FONT_CACHE_POOL_SIZE=680000
CONFIG_FREETYPE_FONT_BITMAP_BPP=2
CONFIG_FREETYPE_PER_FONT_CACHE_SIZE=40960
CONFIG_FREETYPE_FONT_ENABLE_MEMORY_FACE=n
CONFIG_FREETYPE_FONT_MAX_FACES=2
CONFIG_FREETYPE_FONT_MAX_SIZES=3
CONFIG_FREETYPE_SHAPE_INFO_CACHE_SIZE=3072
CONFIG_FREETYPE_FONT_SHAPE_CACHE_SIZE=120000
CONFIG_OTA_TEMP_PART_DEV_NAME="sd"
CONFIG_RES_MANAGER_BLOCK_SIZE=434432
CONFIG_RES_MANAGER_BLOCK_NUM=2

#usb mass storage config
CONFIG_MASS_STORAGE_DISK_PDRV=4
CONFIG_MASS_STORAGE_DISK_NAME="SD"
CONFIG_MASS_STORAGE_STACK_SIZE=2048
CONFIG_EMOJI_FONT_USE_MMAP=n
CONFIG_MMC=y
CONFIG_MMC_ACTS=y
CONFIG_MMC_SDCARD=y
CONFIG_DISK_ACCESS_SD=y

#CONFIG_DISK_ACCESS_SPINAND=y
CONFIG_APP_UI_DISK="/SD:A"
CONFIG_APP_FONT_DISK="/SD:C"
CONFIG_APP_FAT_DISK="/SD:"
CONFIG_APP_UI_DISK_B="/SD:B"
CONFIG_WELCOME_UI_DISK="/SD:K"

CONFIG_SVG_RENDER=y

CONFIG_MASS_STORAGE_BUF_SIZE=4096

CONFIG_IPMSG_BTC_FCC_NAME="/SD:K/fcc.bin"
CONFIG_BT_MP_BTC_FILE_NAME="/SD:K/mp_btc.bin"

CONFIG_USER_WORK_Q=y
CONFIG_USER_WORK_Q_PRIORITY=8

CONFIG_UI_MEM_VDB_SHARE_SURFACE_BUFFER=y

CONFIG_DVFS=y
CONFIG_ACTS_DVFS_DYNAMIC_LEVEL=y

#=========== video ===========
CONFIG_VIDEO_PLAYER=y
CONFIG_VIDEO_APP=y
```
