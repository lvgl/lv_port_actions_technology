## action_technology_zephyr_sdk/bootloader/boards/arm/ats3089p_dev_watch_sdnand_8b/ats3089p_dev_watch_sdnand_8b_defconfig
```kconfig
# SPDX-License-Identifier: Apache-2.0

# Deprecated types
CONFIG_DEPRECATED_ZEPHYR_INT_TYPES=y

# Reserve Header
CONFIG_ROM_START_OFFSET=0x200

# Soc
CONFIG_SOC_SERIES_LEOPARD=y
CONFIG_SOC_LEOPARD=y
CONFIG_IRQ_VECTOR_IN_SRAM=y
CONFIG_SLEEP_FUNC_IN_SRAM=y

# Enable MPU
#CONFIG_ARM_MPU=y

# Enable FPU
CONFIG_FPU=y

# Enable irq lock/unlock irq time stat
CONFIG_DISABLE_IRQ_STAT=n
CONFIG_DISABLE_IRQ_MAX_LATENCY_CYCLES=16000
CONFIG_ARCH_SW_ISR_TABLE_ALIGN=8


# Enable sw isr table in ram
CONFIG_DYNAMIC_INTERRUPTS=y

# Enable cacheprofile stat
CONFIG_SOC_SPICACHE_PROFILE=n
CONFIG_SOC_SPICACHE_PROFILE_STAT=n
CONFIG_LOG=n

# Enable irq profiler stat
CONFIG_TRACING_IRQ_PROFILER=n
CONFIG_TRACING_IRQ_PROFILER_MAX_LATENCY=n
CONFIG_TRACING_IRQ_PROFILE_MAX_LATENCY_CYCLES=32000
CONFIG_TRACING_IRQ_PROFILER_IRQLOADING=n
CONFIG_SPIN_VALIDATE=n

# Clock
#CONFIG_CORTEX_M_SYSTICK=y
CONFIG_ACTS_TIMER=y
CONFIG_ACTS_HRTIMER=y
CONFIG_HOSC_CLK_MHZ=32
CONFIG_SYS_CLOCK_HW_CYCLES_PER_SEC=32000000
CONFIG_SYS_CLOCK_TICKS_PER_SEC=500

# Console
CONFIG_CONSOLE=y
CONFIG_UART_CONSOLE=y
CONFIG_EARLY_CONSOLE=y
CONFIG_PRINTK=y
CONFIG_STDOUT_CONSOLE=y
CONFIG_UART_CONSOLE_ON_DEV_NAME="UART_0"
CONFIG_UART_SHELL_ON_DEV_NAME="UART_0"
CONFIG_SERIAL=y
CONFIG_SHELL_BACKEND_SERIAL=y

# Uart
CONFIG_UART_ACTS=y
CONFIG_UART_INTERRUPT_DRIVEN=y
CONFIG_UART_ACTS_PORT_0=y
CONFIG_UART_ACTS_PORT_0_NAME="UART_0"
CONFIG_UART_ACTS_PORT_0_BAUD_RATE=115200
CONFIG_UART_ACTS_PORT_0_PRIORITY=0

# I2C
CONFIG_I2C=y
CONFIG_I2C_ACTS=y
CONFIG_I2CMT_ACTS=y
CONFIG_I2C_ASYNC=y

# GPIO
CONFIG_GPIO=y
CONFIG_GPIO_ACTS=y

# DMA
CONFIG_DMA=y
CONFIG_DMA_ACTS=y
CONFIG_PDMA_ACTS=y
CONFIG_DMA_LCD_RESEVER_CHAN=1
CONFIG_DMA_DBG_DUMP=y
CONFIG_DMA_SPINOR_RESEVER_CHAN=12

# SPI
CONFIG_SPI=y
CONFIG_SPI_ACTS=y
CONFIG_SPIMT_ACTS=y

#code link
CONFIG_USE_DT_CODE_PARTITION=n
CONFIG_FLASH_LOAD_OFFSET=0x1000000
CONFIG_FLASH_LOAD_SIZE=0x100000

#mem
CONFIG_SRAM_SIZE=736
CONFIG_SRAM_BASE_ADDRESS=0x2ff60400
CONFIG_PSRAM_SIZE=8192
CONFIG_PSRAM_BASE_ADDRESS=0x38000000

# FLASH
CONFIG_FLASH=y
CONFIG_FLASH_BASE_ADDRESS=0x10000000
CONFIG_FLASH_SIZE=4096
CONFIG_SPI_FLASH_ACTS=y
CONFIG_SPINOR_TEST_DELAYCHAIN=n
#CONFIG_SPINAND_ACTS=y
#CONFIG_SPINAND_LIB=y
#CONFIG_DMA_SPINAND_RESEVER_CHAN=9
CONFIG_SOC_SPI0_USE_CK64M=n
CONFIG_SPI_NOR_FLASH_4B_ADDRESS=n
CONFIG_NOR_CODE_IN_RAM=y
CONFIG_NOR_ACTS_DATA_PROTECTION_ENABLE=y

#
# Storage
#
#CONFIG_FLASH_MAP=y
#CONFIG_STREAM_FLASH=y
#CONFIG_STREAM_FLASH_ERASE=y
# end of Storage

#
# shell cmd
#
CONFIG_SHELL_DBG=y
# end of shell cmd

# IPMSG
CONFIG_IPMSG_ACTS=y
CONFIG_IPMSG_ACTS_BTC=y
# bt_watch set IPMSG_BTC_SEL_32K
CONFIG_IPMSG_BTC_SEL_32K=y

# MMC
CONFIG_MMC=y
CONFIG_MMC_ACTS=y
CONFIG_MMC_SDCARD=y

# DISK
CONFIG_DISK_ACCESS=y
#CONFIG_DISK_ACCESS_SPINAND=y
CONFIG_DISK_ACCESS_SD=y

# file
CONFIG_FILE_SYSTEM=y
CONFIG_FAT_FILESYSTEM_ELM=y
CONFIG_FILE_SYSTEM_SHELL=y
CONFIG_SD_FS=y
CONFIG_SDFS_NOR_NOT_XIP=y
CONFIG_SD_FS_VADDR_START=0x13000000
CONFIG_SD_FS_NAND_SD_STORAGE=y

# heap
CONFIG_HEAP_MEM_POOL_SIZE=2048
#CONFIG_HEAP_MEM_POOL_MIN_SIZE=64
CONFIG_MINIMAL_LIBC_MALLOC_ARENA_SIZE=0


#log
CONFIG_LOG=y
CONFIG_LOG_MODE_MINIMAL=y
CONFIG_ACTIONS_PRINTK_DMA=y
CONFIG_PRINTK_TIME_FREFIX=n
CONFIG_KERNEL_SHOW_STACK=y
CONFIG_KALLSYMS=y
CONFIG_ASSERT=y
CONFIG_PRINTK_DMA_FULL_LOST=y
CONFIG_CBPRINTF_COMPLETE_BROM=y

#nvram
CONFIG_NVRAM_CONFIG=y
CONFIG_NVRAM_STORAGE_FLASH=y
#CONFIG_NVRAM_STORAGE_DEV_NAME="spinand"
CONFIG_NVRAM_STORAGE_DEV_NAME="sd"
CONFIG_NVRAM_FACTORY_REGION_SEGMENT_SIZE=0x1000
CONFIG_NVRAM_STORAGE_FACTORY_RW_REGION=y
CONFIG_NVRAM_FACTORY_RW_REGION_SEGMENT_SIZE=0x1000
CONFIG_NVRAM_USER_REGION_SEGMENT_SIZE=0x1000


#power
CONFIG_PM=y
CONFIG_DEVICE_POWER_MANAGEMENT=y
CONFIG_PM_POLICY_APP=y
CONFIG_IDLE_STACK_SIZE=1024


#input
CONFIG_INPUT_DEV=y
#CONFIG_INPUT_DEV_ACTS_ADCKEY=n
CONFIG_INPUT_DEV_ACTS_ONOFF_KEY=y
CONFIG_INPUT_DEV_ACTS_TP_KEY=y
CONFIG_INPUT_DEV_ACTS_CST816S_TP_KEY=y
CONFIG_INPUT_DEV_ACTS_GPIOKEY=y

#mpu
CONFIG_MPU_ACTS=n
CONFIG_MPU_MONITOR_FLASH_AREA_WRITE=y
CONFIG_MPU_MONITOR_CACHECODE_WRITE=n
CONFIG_MPU_MONITOR_RAMFUNC_WRITE=n
CONFIG_MPU_MONITOR_USER_DATA=y
CONFIG_MPU_MONITOR_ROMFUNC_WRITE=y

#PWM
CONFIG_PWM=y
CONFIG_PWM_ACTS=y

#libc
CONFIG_LIBC_STRING_BROM=y

#os
#CONFIG_CBPRINTF_COMPLETE_BROM=y

#libgui
CONFIG_GUI_API_BROM=y

#ota
CONFIG_OTA_TEMP_PART_DEV_NAME="sd"
CONFIG_OTA_MUTIPLE_STORAGE=y
CONFIG_OTA_RES_PATCH=n
```

## action_technology_zephyr_sdk/bootloader/drivers/bluetooth/Kconfig.acts
```kconfig
# Copyright (c) 2018 Intel Corporation
# SPDX-License-Identifier: Apache-2.0

menuconfig BT_DRV
	bool "Actions Bluetooth driver"
	default n
	help
	  Enable support for actions bt driver

if BT_DRV

config BT_HCI_RX_PRIO
	int "BT hci rx thread priority"
	default 6

config BT_HCI_TX_RBUF_SIZE
	int "BT hci tx ring buf size"
	default 2048

config BT_HCI_RX_RBUF_SIZE
	int "BT hci rx ring buf size"
	default 2048

config BT_HCI_ACTS
	bool "Enable bt hci driver"
	default n

config BT_ECC_ACTS
	bool "Enable Actions Bluetooth Tinycrypt Ecc"
	select TINYCRYPT
	select TINYCRYPT_ECC_DH
	select TINYCRYPT_SHA256
	select TINYCRYPT_SHA256_HMAC
	select TINYCRYPT_SHA256_HMAC_PRNG
	default n

config BT_CTRL_TWS
	bool "bt ctrl support tws"
	default y

config BT_CTRL_REG
	bool "bt ctrl support read/write (bb/rf) op"
	default n

config BT_CTRL_DEBUG
	bool "Enable debug for BT CPU"
	default n

config BT_CTRL_LOG
	bool "Enable btc log"
	default n

config BT_HCI_RX_PRINT
	bool "Enable Bluetooth hci RX Print"
	default n

config BT_HCI_TX_PRINT
	bool "Enable Bluetooth hci RX Print"
	default n

config BT_CTRL_BQB
	bool "Enable Actions Bluetooth Controller BQB Test"
	default n

config BT_CTRL_RF_DEBUG
	bool "Enable Load bt_rf.bin"
	depends on BT_CTRL_BQB
	default n

config BT_CTRL_BLE_BQB
	bool "Enable Actions Bluetooth LE Controller BQB Test"
	depends on BT_CTRL_BQB
	default n

config BT_POWER_TEST_MODE
	bool "Bluetooth for power test"
	default n
	help
	  Bluetooth for power test

 endif # BT_DRV
```

## action_technology_zephyr_sdk/bootloader/drivers/dma/Kconfig.acts
```kconfig
# Actions DMA configuration options

# Copyright (c) 2018 Justin Watson
# SPDX-License-Identifier: Apache-2.0


menuconfig DMA_ACTS
	bool "Actions acts DMA driver"
	help
	  Enable support for the Actions Physical DMA controllers.

if DMA_ACTS

choice
	prompt "select Actions DMA driver"
config VDMA_ACTS
	bool "Virtual DMA driver for acts"
	help
	  Enable support for Virtual DMA  for acts dma controllers.
config PDMA_ACTS
	bool "Actions acts Physical DMA driver"
	help
	  Enable support for the Actions Physical DMA controllers.
endchoice

config DMA_DBG_DUMP
	bool "DMA dbg dump cmd"
	depends on DMA_ACTS
	help
	   DMA dbg dump cmd. 

config DMA_LCD_RESEVER_CHAN
	int "reserve chan for lcd"
	range 0 12
	default 12
	help
	  reserve chan for lcd，set 0-9 valid chan,else not reserve for lcd, default not reserve

config DMA_SPINAND_RESEVER_CHAN
	int "reserve chan for SPINAND"
	range 0 12
	default 12
	help
	  reserve chan for spinand set 0-9 valid chan,else not reserve for lcd, default not reserve

config DMA_SPINOR_RESEVER_CHAN
	int "reserve chan for SPINOR"
	range 0 12
	default 12
	help
	  reserve chan for spinand set 0-9 valid chan,else not reserve for spinor, default not reserve

endif
```

## action_technology_zephyr_sdk/bootloader/drivers/input/tpkey/Kconfig
```kconfig
# Configuration options for Actions INPUT YP DRIVERS

# Copyright (c) 2020 Actions Technology Co., Ltd
# SPDX-License-Identifier: Apache-2.0

if INPUT_DEV_ACTS_TP_KEY

config INPUT_DEV_ACTS_CST816S_TP_KEY
	bool "Actions SoC TP key driver"
	default n
	help
	  Enable support for Actions SoC TP key driver.

config INPUT_DEV_ACTS_CST816S_COB_TP_KEY
	bool "Actions SoC TP key driver"
	default n
	help
	  Enable support for Actions SoC TP key driver.

config INPUT_DEV_ACTS_IT7259_TP_KEY
	bool "Actions SoC TP key driver"
	default n
	help
	  Enable support for Actions SoC TP key driver.

config INPUT_DEV_ACTS_FT5X0X_TP_KEY
	bool "Actions SoC TP key driver"
	default n
	help
	  Enable support for Actions SoC TP key driver.

endif # INPUT_DEV_ACTS_TP_KEY
```

## action_technology_zephyr_sdk/bootloader/drivers/misc/Kconfig
```kconfig
# misc configuration options

# Copyright (c) 2021 Action Corporation
# SPDX-License-Identifier: Apache-2.0

#
# misc options
#

#source "drivers/misc/Kconfig.acts"

config AUDIO_CHAN_SEL
	bool "select audio channel"
	default n
	help
	  audio channel select device driver initialization priority.

config AUDIO_CHAN_SEL_INIT_PRIORITY
	int "Init priority"
	default 60
	help
	  I2C device driver initialization priority.
```

## action_technology_zephyr_sdk/bootloader/drivers/nvram/Kconfig
```kconfig
# Kconfig - flash driver configuration options

#
# Copyright (c) 2016 Intel Corporation
#
# SPDX-License-Identifier: Apache-2.0
#

#
# flash driver
#
menuconfig NVRAM_CONFIG
	bool
	prompt "Non-volatile config support"
	default n
	help
	  Enable support for Non-volatile config.

if NVRAM_CONFIG

config NVRAM_STORAGE_FLASH
	bool
	prompt "NVRAM based on Flash"
	depends on FLASH
	default y

config NVRAM_STORAGE_RAMSIM
	bool
	prompt "Simulated NVRAM based on RAM"
	depends on FLASH && !NVRAM_STORAGE_FLASH
	default n

config NVRAM_STORAGE_DEV_NAME
	string
	prompt "Storage device name for NVRAM"
	default "spinor"

config NVRAM_FACTORY_REGION_SEGMENT_SIZE
	hex "Factory read-only region segment size"
	help
	  This option specifies the region segment size of factory config in the NVRAM,
	  It need be aligned with flash erase sector.

config NVRAM_STORAGE_FACTORY_RW_REGION
	bool
	prompt "Enable NVRAM FACTORY_RW_REGION"
	depends on FLASH
	default n

config NVRAM_FACTORY_RW_REGION_SEGMENT_SIZE
	hex "Factory region segment size"
	help
	  This option specifies the region segment size of factory config in the NVRAM,
	  It need be aligned with flash erase sector.

config NVRAM_USER_REGION_SEGMENT_SIZE
	hex "User region segment size"
	help
	  This option specifies the region segment size of user config in the NVRAM,
	  It need be aligned with flash erase sector.

config NVRAM_CONFIG_INIT_PRIORITY
	int "NVRAM config init priority"
	depends on NVRAM_CONFIG
	default 48
	help
	 This option controls the priority of SPINOR flash device
	 initialization. Lower values ensures that the device
	 is initialized earlier in the startup cycle. If unsure, leave
	 at default value.
endif
```

## action_technology_zephyr_sdk/bootloader/drivers/spi/Kconfig
```kconfig
# SPI driver configuration options

# Copyright (c) 2015-2016 Intel Corporation
# SPDX-License-Identifier: Apache-2.0

#
# SPI Drivers
#
menuconfig SPI
	bool "SPI hardware bus support"
	help
	  Enable support for the SPI hardware bus.

if SPI

config SPI_ASYNC
	bool "Enable Asynchronous call support"
	select POLL
	help
	  This option enables the asynchronous API calls.

config SPI_SLAVE
	bool "Enable Slave support [EXPERIMENTAL]"
	help
	  Enables Driver SPI slave operations. Slave support depends
	  on the driver and the hardware it runs on.

config SPI_INIT_PRIORITY
	int "Init priority"
	default 70
	help
	  Device driver initialization priority.

config SPI_COMPLETION_TIMEOUT_TOLERANCE
	int "Completion timeout tolerance (ms)"
	default 200
	help
	  The tolerance value in ms for the SPI completion timeout logic.

module = SPI
module-str = spi
source "subsys/logging/Kconfig.template.log_config"


source "drivers/spi/Kconfig.acts"
endif # SPI
```
