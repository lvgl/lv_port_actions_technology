## action_technology_sdk/zephyr/drivers/timer/Kconfig
```kconfig
# Timer driver configuration options

# Copyright (c) 2014-2015 Wind River Systems, Inc.
# Copyright (c) 2016 Cadence Design Systems, Inc.
# Copyright (c) 2019 Intel Corp.
# SPDX-License-Identifier: Apache-2.0

menu "Timer Drivers"

DT_COMPAT_ARM_V6M_SYSTICK := arm,armv6m-systick
DT_COMPAT_ARM_V7M_SYSTICK := arm,armv7m-systick
DT_COMPAT_ARM_V8M_SYSTICK := arm,armv8m-systick
DT_COMPAT_ARM_V8_1M_SYSTICK := arm,armv8.1m-systick

config CORTEX_M_SYSTICK
	bool "Cortex-M SYSTICK timer"
	depends on CPU_CORTEX_M_HAS_SYSTICK
	select TICKLESS_CAPABLE
	help
	  This module implements a kernel device driver for the Cortex-M processor
	  SYSTICK timer and provides the standard "system clock driver" interfaces.

source "drivers/timer/Kconfig.acts"

config NPCX_ITIM_TIMER
	bool "Nuvoton NPCX series internal 64/32-bit timers"
	default y
	depends on SOC_FAMILY_NPCX
	select TICKLESS_CAPABLE
	help
	  This module implements a kernel device driver for the Nuvoton NPCX
	  series internal 64/32-bit timers and provides the standard "system
	  clock driver" interfaces.

config SYSTEM_CLOCK_DISABLE
	bool "API to disable system clock"
	help
	  This option enables the sys_clock_disable() API in the kernel. It is
	  needed by some subsystems (which will automatically select it), but is
	  rarely needed by applications.

config TIMER_READS_ITS_FREQUENCY_AT_RUNTIME
	bool "Timer queries its hardware to find its frequency at runtime"
	help
	  The drivers select this option automatically when needed. Do not modify
	  this unless you have a very good reason for it.

config SYSTEM_CLOCK_SLOPPY_IDLE
	bool "Timer allowed to skew uptime clock during idle"
	help
	  When true, the timer driver is not required to maintain a
	  correct system uptime count when the system enters idle.
	  Some platforms may take advantage of this to reduce the
	  overhead from regular interrupts required to handle counter
	  wraparound conditions.

config SYSTEM_CLOCK_INIT_PRIORITY
	int "System clock driver initialization priority"
	default 0
	help
	  This options can be used to set a specific initialization priority
	  value for the system clock driver. As driver initialization  might need
	  the clock to be running already, you should let the default value as it
	  is (0).

# Hidden option to be selected by individual SoC.
config TICKLESS_CAPABLE
	bool
	help
	  Timer drivers should select this flag if they are capable of
	  supporting tickless operation.  That is, a call to
	  sys_clock_set_timeout() with a number of ticks greater than
	  one should be expected not to produce a call to
	  sys_clock_announce() (really, not to produce an interrupt at
	  all) until the specified expiration.

DT_COMPAT_NXP_OS_TIMER := nxp,os-timer

config MCUX_OS_TIMER
	bool "MCUX OS Event timer"
	depends on HAS_MCUX_OS_TIMER
	default $(dt_compat_enabled,$(DT_COMPAT_NXP_OS_TIMER))
	select TICKLESS_CAPABLE
	help
	  This module implements a kernel device driver for the NXP OS
	  event timer and provides the standard "system clock driver" interfaces.

config MCUX_LPTMR_TIMER
	bool "MCUX LPTMR timer"
	depends on HAS_MCUX_LPTMR && !COUNTER_MCUX_LPTMR
	help
	  This module implements a kernel device driver for the NXP MCUX Low
	  Power Timer (LPTMR) and provides the standard "system clock driver"
	  interfaces.

endmenu
```

## action_technology_sdk/zephyr/drivers/timer/Kconfig.acts
```kconfig
menuconfig ACTS_TIMER
	bool "Actions SoC timer"
	default n
	depends on SOC_FAMILY_ACTS
	select TICKLESS_CAPABLE
	help
	This module implements a kernel device driver for the Actions
	SoC timer and provides the standard "system clock driver" interfaces.  

config ACTS_HRTIMER
    bool "Actions hardware timer"
    default n
    help
    This module implements a kernel device driver for the Actions
    SoC timer and provides the standard "system clock driver" interfaces.
 
```

## action_technology_sdk/zephyr/drivers/usb/Kconfig
```kconfig
# Kconfig - USB configuration options

#
# Copyright (c) 2016 Wind River Systems, Inc.
#
# SPDX-License-Identifier: Apache-2.0
#

menuconfig USB_DEVICE
	bool "USB"
	default n
	help
	  Enable USB device drivers.

menuconfig USB_HOST
	bool "USB HOST"
	default n
	help
	  Enable USB host drivers.

if USB_HOST
config USB_HOST_DRIVER
	bool
	select USB_HOST_STACK
	default n
endif # USB_HOST

rsource "otg/Kconfig"
```

## action_technology_sdk/zephyr/framework/anc/Kconfig
```kconfig
# Configuration options for Actions OSAL

# Copyright (c) 2020 Actions Technology Co., Ltd
# SPDX-License-Identifier: Apache-2.0

menuconfig ANC_HAL
	bool "ANC Hal"
	default n
	help
	  Enable ANC Hal

if ANC_HAL



endif # ANC_HAL
```

## action_technology_sdk/zephyr/framework/audio/Kconfig
```kconfig
# Configuration options for Actions DSP

# Copyright (c) 2020 Actions Technology Co., Ltd
# SPDX-License-Identifier: Apache-2.0

config AUDIO_IN
	bool
	prompt "Audio In Hal Support"
	default n
	help
	This option enables actions audio in hal.

config AUDIO_OUT
	bool
	prompt "Audio Out Hal Support"
	default n
	help
	This option enables actions audio out hal.
```

## action_technology_sdk/zephyr/framework/display/Kconfig
```kconfig
# Configuration options for Actions OSAL

# Copyright (c) 2020 Actions Technology Co., Ltd
# SPDX-License-Identifier: Apache-2.0

if DISPLAY

menuconfig DISPLAY_COMPOSER
	bool "Display Composer"
	default y if UI_SERVICE
	help
	  Enable Display composer

if DISPLAY_COMPOSER

config DISPLAY_COMPOSER_DEBUG_FPS
	bool "Debug Post Frame Rate (fps) in Display Composer"
	default y
	help
	  Debug post frame rate (fps) in Display Composer

config DISPLAY_COMPOSER_DEBUG_VSYNC
	bool "Debug VSYNC/TE Signal Period in Display Composer"
	default y
	help
	  Debug VSYNC/TE signal period in Display Composer

endif # DISPLAY_COMPOSER

config GUI_API_BROM
	bool "GUI ROM API"
	help
	  Enable GUI ROM API

if GUI_API_BROM

config GUI_API_BROM_LARK
	bool
	default y if SOC_SERIES_LARK

config GUI_API_BROM_LEOPARD
	bool
	default y if SOC_SERIES_LEOPARD

endif # GUI_API_BROM

endif # DISPLAY
```

## action_technology_sdk/zephyr/framework/dma2d/Kconfig
```kconfig
# Configuration options for Actions OSAL

# Copyright (c) 2020 Actions Technology Co., Ltd
# SPDX-License-Identifier: Apache-2.0

menuconfig DMA2D_HAL
	bool "DMA2D Hal"
	default y
	depends on DISPLAY_ENGINE
	help
	  Enable DMA2D Hal

if DMA2D_HAL

endif # DMA2D_HAL
```

## action_technology_sdk/zephyr/framework/dsp/Kconfig
```kconfig
# Configuration options for Actions OSAL

# Copyright (c) 2020 Actions Technology Co., Ltd
# SPDX-License-Identifier: Apache-2.0

menuconfig DSP_HAL
	bool "DSP Hal"
	default n
	help
	  Enable DSP Hal

if DSP_HAL



endif # DSP_HAL
```

## action_technology_sdk/zephyr/framework/sensor/sensor_algo/Kconfig
```kconfig
# Configuration options for Actions Sensor

# Copyright (c) 2020 Actions Technology Co., Ltd
# SPDX-License-Identifier: Apache-2.0

menuconfig SENSOR_ALGO
	bool "Sensor algorithm"
	help
	  Enable Sensor algorithm

if SENSOR_ALGO

config SENSOR_ALGO_HR_GH30X
	bool "GH30X heart-rate algorithm"
	default n
	help
	  Enable GH30X heart-rate algorithm

config SENSOR_ALGO_HR_VCARE
	bool "VCARE heart-rate algorithm"
	default n
	help
	  Enable VCARE heart-rate algorithm

config SENSOR_ALGO_HR_VCARE_VC9202
	bool "VCARE heart-rate algorithm"
	default n
	help
	  Enable VCARE heart-rate algorithm

config SENSOR_ALGO_HR_HX3605
	bool "HX3605 heart-rate algorithm"
	default n
	help
	  Enable HX3605 heart-rate algorithm
	  
config SENSOR_ALGO_HR_HX3690
	bool "HX3690 heart-rate algorithm"
	default n
	help
	  Enable HX3690 heart-rate algorithm
	  
config SENSOR_ALGO_MOTION_CYWEE
	bool "Cywee motion algorithm"
	default n
	help
	  Enable Cywee motion algorithm

if SENSOR_ALGO_MOTION_CYWEE

config SENSOR_ALGO_MOTION_CYWEE_DML
	bool "Cywee motion algorithm DML"
	default n
	help
	  Enable Cywee motion algorithm DML
	  
config SENSOR_ALGO_MOTION_CYWEE_IN_RAM
	bool "Cywee motion algorithm in ram"
	default y if !SOC_NO_PSRAM
	help
	  Enable Cywee motion algorithm in ram

endif # SENSOR_ALGO_MOTION_CYWEE

config SENSOR_ALGO_MOTION_SILAN
	bool "Silan motion algorithm"
	default n
	help
	  Enable Silan motion algorithm

endif # SENSOR_ALGO
```
