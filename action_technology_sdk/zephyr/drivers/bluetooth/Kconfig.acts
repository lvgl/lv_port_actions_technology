## action_technology_sdk/zephyr/drivers/bluetooth/Kconfig.acts
```kconfig
# Copyright (c) 2018 Intel Corporation
# SPDX-License-Identifier: Apache-2.0

menuconfig BT_DRV
	bool "Actions Bluetooth driver"
	default n
	help
	  Enable support for actions bt driver

if BT_DRV

config BT_HCI_RX_PRIO
	int "BT hci rx thread priority"
	default 6

config BT_HCI_TX_RBUF_SIZE
	int "BT hci tx ring buf size"
	default 2048

config BT_HCI_RX_RBUF_SIZE
	int "BT hci rx ring buf size"
	default 4096

config BT_HCI_ACTS
	bool "Enable bt hci driver"
	default n

config BT_ECC_ACTS
	bool "Enable Actions Bluetooth Tinycrypt Ecc"
	select TINYCRYPT
	select TINYCRYPT_ECC_DH
	select TINYCRYPT_SHA256
	select TINYCRYPT_SHA256_HMAC
	select TINYCRYPT_SHA256_HMAC_PRNG
	default n

config BT_CTRL_TWS
	bool "bt ctrl support tws"
	default y

config BT_CTRL_REG
	bool "bt ctrl support read/write (bb/rf) op"
	default n

config BT_CTRL_DEBUG
	bool "Enable debug for BT CPU"
	default n

config BT_CTRL_LOG
	bool "Enable btc log"
	default n

config BT_HCI_RX_PRINT
	bool "Enable Bluetooth hci RX Print"
	default n

config BT_HCI_TX_PRINT
	bool "Enable Bluetooth hci RX Print"
	default n

config BT_CTRL_BQB
	bool "Enable Actions Bluetooth Controller BQB Test"
	default n

config BT_CTRL_RF_DEBUG
	bool "Enable Load bt_rf.bin"
	depends on BT_CTRL_BQB
	default n

config BT_FCC_TEST
	bool "Enable Actions Bluetooth FCC Test"
	default n

config BT_SRRC_TEST
	bool "Enable Actions Bluetooth SRRC Test"
	default n

config BT_QC_TEST
	bool "Bluetooth for QC test"
	default n
	help
	  Bluetooth for QC test

config BT_FAST_BOOT
	bool "Bluetooth fast boot"
	default n
	help
	  Bluetooth fast boot

config BT_3M
	bool "Bluetooth BREDR 3M support"
	default n
	help
	  Bluetooth 3M support

 endif # BT_DRV
```

## action_technology_sdk/zephyr/drivers/cec/Kconfig
```kconfig
# Kconfig - HDMI CEC configuration options

#
# Copyright (c) 2015 Intel Corporation
#
# SPDX-License-Identifier: Apache-2.0
#

#
# CEC options
#
menuconfig CEC_ACTS
	bool
	prompt "Actions CEC Drivers"
	default n
	help
	Enable Actions CEC Driver Configuration

config CEC_DEV_NAME
	string "HDMI CEC Driver's name"
	depends on CEC_ACTS
	default "CEC_0"
```

## action_technology_sdk/zephyr/drivers/compensation/Kconfig
```kconfig
# BLUETOOTH configuration options

# Copyright (c) 2015 Intel Corporation
# SPDX-License-Identifier: Apache-2.0

source "drivers/compensation/Kconfig.acts"
```

## action_technology_sdk/zephyr/drivers/compensation/Kconfig.acts
```kconfig
# Kconfig - DSP device configuration options
#
#
# Copyright (c) 2018 Actions Semiconductor Co., Ltd
#
# SPDX-License-Identifier: Apache-2.0
#

#
# compenstation options
#

config COMPENSATION
    bool
    prompt "compensation drivers"
    default n
    help
    enable freq compensation
      
config COMPENSATION_ACTS
    bool
	prompt "actions compensation drivers"
    default n
	select COMPENSATION
    help
    enable actions freq compensation
    
config COMPENSATION_FREQ_INDEX_NUM
	int
	prompt "compensation freq index num"
	depends on COMPENSATION_ACTS
	default 2
	help
	config actions freq compensation array number
	
config COMPENSATION_DEFAULT_HOSC_CAP
    int 
	prompt "default hosc cap"
    depends on COMPENSATION_ACTS
    default 100
    help
    config actions freq compensation default value 

config COMPENSATION_HOSC_CAP_NVRAM_PRIORITY
    bool 
	prompt "compensation hosc cap read nvram priority"
    depends on COMPENSATION_ACTS
    default y
    help
    config actions freq compensation hosc cap read nvram priority 
    
config TEMP_COMPENSATION_ACTS
    bool
	prompt "actions temp compensation"
    depends on COMPENSATION_ACTS
    default n
    help
    enable actions temperature freq compensation
                 
                                           
```

## action_technology_sdk/zephyr/drivers/display/Kconfig.acts
```kconfig
# Configuration options for Actions Display

# Copyright (c) 2020 Actions Technology Co., Ltd
# SPDX-License-Identifier: Apache-2.0

config DISPLAY_MMU
	bool
	help
	  Enable Display MMU.

orsource "engine/Kconfig"
orsource "dma2d_lite/Kconfig"
rsource "controller/Kconfig"
rsource "panel/Kconfig"
```

## action_technology_sdk/zephyr/drivers/display/panel/Kconfig
```kconfig
# Configuration options for Actions Display Panel

# Copyright (c) 2020 Actions Technology Co., Ltd
# SPDX-License-Identifier: Apache-2.0

if DISPLAY_LCDC

# Normal panels

config PANEL_ER76288A
	bool "RD-ER76288A display driver"
	help
	  Enable driver for RD-ER76288A display driver.

config PANEL_FT2308
	bool "FT2308 display driver"
	help
	Enable driver for FT2308 display driver.

config PANEL_GC9C01
	bool "GC9C01 display driver"
	help
	  Enable driver for GC9C01 display driver.

config PANEL_ICNA3310B
	bool "ICNA3310B display driver"
	help
	  Enable driver for ICNA3310B display driver.

config PANEL_ICNA3311
	bool "ICNA3311 display driver"
	help
	  Enable driver for ICNA3311 display driver.

config PANEL_RM69090
	bool "RM69090 display driver"
	help
	  Enable driver for RM69090 display driver.

config PANEL_RM690B0
	bool "RM690B0 display driver"
	help
	  Enable driver for RM690B0 display driver.

config PANEL_SH8601Z0
	bool "SH8601Z0 display driver"
	help
	  Enable driver for SH8601Z0 display driver.

config PANEL_ST77916
	bool "ST77916 display driver"
	help
	  Enable driver for ST77916 display driver.

config PANEL_ST7802
	bool "ST7802 display driver"
	help
	  Enable driver for ST7802 display driver.

config PANEL_JD9853
	bool "JD9853 display driver"
	help
	  Enable driver for JD9853 display driver.

# Ram-less panels

config PANEL_AXS15231B
	bool "AXS15231B display driver"
	help
	  Enable driver for AXS15231B display driver.

config PANEL_ST77903
	bool "ST77903 display driver"
	help
	  Enable driver for ST77903 display driver.

# TR panels

config PANEL_LPM015M135A
	bool "LPM015M135A display driver"
	help
	  Enable driver for JDI LPM015M135A display driver.

endif # DISPLAY_LCDC
```

## action_technology_sdk/zephyr/drivers/dma/Kconfig
```kconfig
# DMA configuration options

# Copyright (c) 2016 Intel Corporation
# SPDX-License-Identifier: Apache-2.0

#
# DMA options
#
menuconfig DMA
	bool "DMA driver Configuration"

if DMA
config DMA_64BIT
	bool "DMA 64 bit address support"
	help
	  When this option is true, 64 bit source and dest
	  DMA addresses are supported.

module = DMA
module-str = dma
source "subsys/logging/Kconfig.template.log_config"

source "drivers/dma/Kconfig.acts"

endif # DMA
```

## action_technology_sdk/zephyr/drivers/dsp/Kconfig
```kconfig
# Configuration options for Actions DSP

# Copyright (c) 2020 Actions Technology Co., Ltd
# SPDX-License-Identifier: Apache-2.0

menuconfig DSP
	bool "DSP Drivers"
	help
	  Enable dsp drivers

if DSP

config DSP_ACTS_DEV_NAME
	string "Device name of DSP Controller"
	default "DSP_LEOPARD"
	help
	  Device name of DSP Controller

config DSP_ACTIVE_POWER_LATENCY_MS
	int "dsp active power latency in milliseconds"
	default -1
	help
	  Set the latency of power-off dsp after dsp became idle. Set negative (< 0)
	  if you want to disable this feature.

config DSP_DEBUG_PRINT
    bool "enable dsp debug print"
    default n
    help
       enable dsp debug print

config DSP_LOAD_ROM
    bool "enable load dsp rom"
    default n
    help
      enable load dsp rom

config DSP_DEPAND_ON_ROM
    bool "depand on dsp rom"
    default n
    help
      enable depand on dsp rom

config LOAD_IMAGE_FROM_FS
    bool "load dsp image from fs"
    default n
    help
      enable load dsp image from fs

config DSP_IMAGE_PATH
	string "dsp image path"
	default "/SD:K/"
	help
	  This is dsp image path.

endif # DSP
```

## action_technology_sdk/zephyr/drivers/flash/Kconfig.acts
```kconfig
# Copyright (c) 2018 Intel Corporation
# SPDX-License-Identifier: Apache-2.0


menuconfig SPI_FLASH_ACTS
	bool "actions SPI flash driver"
	select FLASH_HAS_DRIVER_ENABLED
	select FLASH_HAS_PAGE_LAYOUT
	help
	  Enable support for actions SPI flash driver

config SPI_NOR_FLASH_DRV_EXT
	bool
	prompt "Select the external NOR driver"
	default n
	depends on SPI_FLASH_ACTS
	help
		If you say Y here, Select the external NOR driver, else use brom nor driver.

config SPI_NOR_FLASH_4B_ADDRESS
	bool
	prompt "Support NOR flash 4-byte address driver"
	default n
	depends on SPI_FLASH_ACTS
	select SPI_NOR_FLASH_DRV_EXT
	help
		If you say Y here, you will get support NOR flash 4-byte address driver.
		If unsure, it is safe to say N.

config NOR_CODE_IN_RAM
	bool
	prompt "extern nor flash driver run in RAM"
	default n
	select  SPI_NOR_FLASH_DRV_EXT
	help
		If you say Y here, the external NOR driver run in RAM.

config NOR_SUSPEND_RESUME
	bool
	prompt "nor suspend & resume enable"
	default n
	help
		If you say Y here, nor driver use suspend & resume enable.

config NOR_SECURIYT_SUSPPORT
	bool
	prompt "nor security registers erase/program/read suspport"
	default n
	help
		If you say Y here, nor security registers erase/program/read suspport.


config SIM_FLASH_ACTS
	bool
	prompt "Support sim flash driver"
	default n

config SIM_FLASH_SIZE
    hex
    depends on SIM_FLASH_ACTS
    prompt "sim flash size"
    default 0x4000
    help
    	sim flash max size

config BLOCK_DEV_FLASH_ACTS
	bool
	prompt "Support block dev flash drvier"
	default n
```

## action_technology_sdk/zephyr/drivers/gps/Kconfig
```kconfig
config SENSOR_GPS_AG3352B
	bool "GPS AG3352B enable"
	default n
	help
		Enable AG3352B GPS

config SENSOR_GPS_TG9255
	bool "GPS TG9255 enable"
	default n
	help
		Enable TG9255 GPS

config SENSOR_GPS_CC1165W
	bool "GPS CC1165W enable"
	default n
	help
		Enable CC1165W GPS

config GPS
	bool "GPS  enable"
	default n
	help
		Enable  GPS
```

## action_technology_sdk/zephyr/drivers/gpu/verisilicon/Kconfig
```kconfig
# Configuration options for GPU

# Copyright (c) 2020 Actions Technology Co., Ltd
# SPDX-License-Identifier: Apache-2.0

config VG_LITE
	bool "Verisilicon VG-Lite"
	help
	  This option enables the Verisilicon VG-Lite support.

if VG_LITE

config VG_LITE_K_MEM_POOL_SIZE
	int "VG-Lite heap memory pool size (in bytes)"
	default 0
	help
	  This option specifies the size of the VG-Lite heap memory pool.
	  A size of zero means that no VG-Lite memory pool is defined.

endif # VG_LITE
```

## action_technology_sdk/zephyr/drivers/i2c/Kconfig.acts
```kconfig
# Copyright (c) 2018 Intel Corporation
# SPDX-License-Identifier: Apache-2.0


menuconfig I2C_ACTS
	bool "actions I2C driver"
	select RING_BUFFER
	help
	  Enable support for actions I2C driver

menuconfig I2CMT_ACTS
	bool "actions I2CMT driver"
	select RBUF_LIB
	help
	  Enable support for actions I2CMT driver

if I2CMT_ACTS

config I2CMT_LARK
	bool "I2CMT driver on SoC Lark"
	default n
	depends on SOC_SERIES_LARK
	help
	  Enable I2CMT driver on SoC Lark

config I2CMT_LEOPARD
	bool "I2CMT driver on SoC Leopard"
	default y
	depends on SOC_SERIES_LEOPARD
	help
	  Enable I2CMT driver on SoC Leopard

config I2CMT_0_MAX_TASK_LEN
	int "I2CMT0 max task len"
	default 256
	help
	  Setting max task len limit for I2CMT0

config I2CMT_1_MAX_TASK_LEN
	int "I2CMT1 max task len"
	default 256
	help
	  Setting max task len limit for I2CMT1

endif # I2CMT_ACTS
```

## action_technology_sdk/zephyr/drivers/rtc/Kconfig
```kconfig
# Kconfig - RTC configuration options
#
#
# Copyright (c) 2015 Intel Corporation
#
# SPDX-License-Identifier: Apache-2.0
#

#
# Actions Real-Time Clock (RTC) options
#

config RTC_ACTS
	bool "Actions SoC RTC Driver"
	depends on SOC_FAMILY_ACTS
	default n
	help
	Build Actions SoC RTC driver.

config RTC_0_NAME
	string "RTC0 Driver's name"
	depends on RTC_ACTS
	default "RTC_0"

config ALARM8HZ_ACTS
	bool "Actions SoC ALARM 8HZ Driver"
	depends on SOC_FAMILY_ACTS
	default n
	help
	Build Actions SoC Alarm 8HZ driver.

config ALARM8HZ_0_NAME
	string "ALARM8HZ Driver's name"
	depends on ALARM8HZ_ACTS
	default "ALARM8HZ_0"
```

## action_technology_sdk/zephyr/drivers/sensor/Kconfig
```kconfig
# Sensor configuration options

# Copyright (c) 2016 Intel Corporation
# SPDX-License-Identifier: Apache-2.0

menuconfig SENSOR
	bool "Sensor Drivers"
	help
	  Include sensor drivers in system config

if SENSOR

module = SENSOR
module-str = sensor
source "subsys/logging/Kconfig.template.log_config"

config SENSOR_INIT_PRIORITY
	int "Sensor init priority"
	default 90
	help
	  Sensor initialization priority.

config SENSOR_SHELL
	bool "Enable sensor shell"
	depends on SHELL
	select CBPRINTF_FP_SUPPORT
	default y if !SHELL_MINIMAL
	help
	  This shell provides access to basic sensor data.

config SENSOR_SHELL_BATTERY
	bool "Enable sensor shell 'battery' command"
	depends on SHELL
	help
	  This enables the 'battery' command which reports charging information
	  in a convenient format. It makes use of a fuel gauge to read its
	  information.

comment "Device Drivers"

source "drivers/sensor/lis2dw12/Kconfig"

source "drivers/sensor/lps22hh/Kconfig"

source "drivers/sensor/lsm6dso/Kconfig"

endif # SENSOR
```

## action_technology_sdk/zephyr/drivers/serial/Kconfig
```kconfig
# Serial driver configuration options

# Copyright (c) 2014-2015 Wind River Systems, Inc.
# SPDX-License-Identifier: Apache-2.0

menuconfig SERIAL
	bool "Serial Drivers"
	help
	  Enable options for serial drivers.

if SERIAL

comment "Capabilities"

config SERIAL_HAS_DRIVER
	bool
	help
	  This is an option to be enabled by individual serial driver
	  to signal that there is a serial driver. This is being used
	  by other drivers which are dependent on serial.

config SERIAL_SUPPORT_ASYNC
	bool
	help
	  This is an option to be enabled by individual serial driver
	  to signal that the driver and hardware supports async operation.

config SERIAL_SUPPORT_INTERRUPT
	bool
	help
	  This is an option to be enabled by individual serial driver
	  to signal that the driver and hardware supports interrupts.

config UART_USE_RUNTIME_CONFIGURE
	bool "Enable runtime configuration for UART controllers"
	default y
	help
	  Enable runtime configuration of UART controllers.
	  This allows applications to call uart_configure() to
	  configure the UART controllers at runtime, and calling
	  uart_config_get() to retrieve configuration. If this is
	  disabled, UART controllers rely on UART driver's
	  initialization function to properly configure
	  the controller.

	  Say y if unsure. Disable this to reduce footprint for
	  applications that do not require runtime UART configuration.

config UART_ASYNC_API
	bool "Enable new asynchronous UART API [EXPERIMENTAL]"
	depends on SERIAL_SUPPORT_ASYNC
	help
	  This option enables new asynchronous UART API.

config UART_INTERRUPT_DRIVEN
	bool "Enable UART Interrupt support"
	depends on SERIAL_SUPPORT_INTERRUPT
	help
	  This option enables interrupt support for UART allowing console
	  input and other UART based drivers.

config UART_LINE_CTRL
	bool "Enable Serial Line Control API"
	help
	  This enables the API for apps to control the serial line,
	  such as baud rate, CTS and RTS.

	  Implementation is up to individual driver.

	  Says no if not sure.

config UART_DRV_CMD
	bool "Enable driver commands API"
	help
	  This enables the API to send extra commands to drivers.
	  This allows drivers to expose hardware specific functions.

	  Says no if not sure.

comment "Serial Drivers"

source "drivers/serial/Kconfig.acts"

source "drivers/serial/Kconfig.rtt"

endif # SERIAL
```

## action_technology_sdk/zephyr/drivers/spinand/Kconfig
```kconfig
# flash configuration options

# Copyright (c) 2015 Intel Corporation
# SPDX-License-Identifier: Apache-2.0


if FLASH

rsource "Kconfig.acts"

endif # FLASH
```
