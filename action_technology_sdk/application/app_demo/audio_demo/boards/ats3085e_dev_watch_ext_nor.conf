## action_technology_sdk/application/app_demo/audio_demo/boards/ats3085e_dev_watch_ext_nor.conf
```kconfig
CONFIG_DSP_IMAGE_PATH="/NOR:K/"

#usb mass storage config
CONFIG_MASS_STORAGE_DISK_PDRV=0
CONFIG_MASS_STORAGE_DISK_NAME="NOR"

#psram config
#CONFIG_PSRAM_SIZE=4096

CONFIG_SPINAND_ACTS=n
CONFIG_SPINAND_LIB=n

CONFIG_DISK_ACCESS_NOR=y
CONFIG_APP_FAT_DISK="/NOR:"

#CONFIG_MASS_STORAGE_BUF_SIZE=4096

CONFIG_USER_WORK_Q=y
CONFIG_USER_WORK_Q_PRIORITY=8
```

## action_technology_sdk/application/app_demo/bt_music_demo/boards/ats3085s_dev_watch_ext_nor.conf
```kconfig
CONFIG_DSP_IMAGE_PATH="/NOR:K/"


CONFIG_DISK_ACCESS_NOR=y
CONFIG_APP_FAT_DISK="/NOR:"

CONFIG_MASS_STORAGE_BUF_SIZE=4096

CONFIG_IPMSG_BTC_FCC_NAME="/NOR:K/fcc.bin"

CONFIG_USER_WORK_Q=y
CONFIG_USER_WORK_Q_PRIORITY=8

CONFIG_DISPLAY_COMPOSER=y
CONFIG_SURFACE_DOUBLE_BUFFER=y
CONFIG_UI_MEM_NUMBER_BLOCKS=2
CONFIG_UI_MEM_BLOCK_SIZE=434312
```

## action_technology_sdk/application/app_demo/gpu_demo/boards/ats3085s_dev_watch_ext_nor.conf
```kconfig
#=========== config for boards ===========

CONFIG_LV_VDB_SIZE=108578
CONFIG_UI_MEM_VDB_SHARE_SURFACE_BUFFER=y
CONFIG_UI_MEM_BLOCK_SIZE=434432
CONFIG_UI_GUI_MEM_POOL_SIZE=1780000
CONFIG_UI_RES_MEM_POOL_SIZE=1280000

#CONFIG_BITMAP_PER_FONT_CACHE_SIZE=16552
CONFIG_BITMAP_FONT_CACHE_POOL_SIZE=128000
CONFIG_FREETYPE_PER_FONT_CACHE_SIZE=4096

CONFIG_SPINAND_ACTS=n
CONFIG_SPINAND_LIB=n

CONFIG_DISK_ACCESS_NOR=y
CONFIG_APP_UI_DISK="/NOR:A"
CONFIG_APP_FONT_DISK="/NOR:C"
CONFIG_APP_FAT_DISK="/NOR:"
CONFIG_APP_UI_DISK_B="/NOR:B"
CONFIG_WELCOME_UI_DISK="/NOR:K"
```

## action_technology_sdk/application/app_demo/local_music_demo/src/lcmusic/Kconfig
```kconfig
# Kconfig - ACTIONS primitive options for sdk version 2.0

#
# Copyright (c) 2015 Intel Corporation
#
# Licensed under the Apache License, Version 2.0 (the "License");
# you may not use this file except in compliance with the License.
# You may obtain a copy of the License at
#
#     http://www.apache.org/licenses/LICENSE-2.0
#
# Unless required by applicable law or agreed to in writing, software
# distributed under the License is distributed on an "AS IS" BASIS,
# WITHOUT WARRANTIES OR CONDITIONS OF ANY KIND, either express or implied.
# See the License for the specific language governing permissions and
# limitations under the License.
#

config LCMUSIC_APP
	bool
	prompt "Local Music App Support"
	depends on  MEDIA_PLAYER
	default n
	#select MUTIPLE_VOLUME_MANAGER
	select ITERATOR
	select FILE_ITERATOR
	select FILE_STREAM
	select LOCAL_PLAYER
	select FILE_SYSTEM
	select FAT_FILESYSTEM_ELM
	help
	This option enables or disable lcmusic app.

config DISK_MUSIC_APP
	bool
	prompt "Disk Music App Support"
	default n
	depends on LCMUSIC_APP
	help
	This option enables or disable the disk music app.

config SOUNDBAR_LCMUSIC
	bool
	prompt "SOUNDBAR LCMUSIC SUPPORT"
	depends on MEDIA_PLAYER
	default n
	select LCMUSIC_APP
	help
	This option enables or disable soundbar lcmusic

config FORMAT_CHECK
	bool
	prompt "Format Check Support"
	depends on LCMUSIC_APP
	default y
	help
	This option enables or disable the format check.

config BKG_SCAN_DISK
	bool
	prompt "Background scan disk support"
	default n
	depends on LCMUSIC_APP
	help
	This option enables or disable Background scan disk.
```

## action_technology_sdk/application/app_demo/noise_cancel_demo/boards/ats3085s_watch_bootnand.conf
```kconfig
#=========== config for boards ===========
CONFIG_DSP_IMAGE_PATH="/NAND:K/"
#usb mass storage config
CONFIG_MASS_STORAGE_DISK_PDRV=1
CONFIG_MASS_STORAGE_DISK_NAME="NAND"


CONFIG_SLEEP_SENSOR_RUN_ON_NOR=n
CONFIG_DISK_ACCESS=y
CONFIG_DISK_ACCESS_SPINAND=y
CONFIG_APP_FAT_DISK="/NAND:"


CONFIG_MASS_STORAGE_BUF_SIZE=4096

CONFIG_IPMSG_BTC_FCC_NAME="/NAND:K/fcc.bin"
CONFIG_USER_WORK_Q=y
CONFIG_USER_WORK_Q_PRIORITY=8
```

## action_technology_sdk/application/app_demo/noise_cancel_demo/boards/ats3089c_dev_watch.conf
```kconfig
#=========== config for boards ===========
CONFIG_DSP_IMAGE_PATH="/NAND:K/"

#usb mass storage config
CONFIG_MASS_STORAGE_DISK_PDRV=1
CONFIG_MASS_STORAGE_DISK_NAME="NAND"
CONFIG_MASS_STORAGE_STACK_SIZE=2048
CONFIG_EMOJI_FONT_USE_MMAP=n

CONFIG_DISK_ACCESS_SPINAND=y
CONFIG_APP_UI_DISK="/NAND:A"
CONFIG_APP_FONT_DISK="/NAND:C"
CONFIG_APP_FAT_DISK="/NAND:"
CONFIG_APP_UI_DISK_B="/NAND:B"
CONFIG_WELCOME_UI_DISK="/NAND:K"

CONFIG_MASS_STORAGE_BUF_SIZE=4096

CONFIG_IPMSG_BTC_FCC_NAME="/NAND:K/fcc.bin"

CONFIG_USER_WORK_Q=y
CONFIG_USER_WORK_Q_PRIORITY=8
```

## action_technology_sdk/application/bt_watch/boards/ats3089p_dev_watch.conf
```kconfig
#=========== config for boards ===========
CONFIG_DSP_IMAGE_PATH="/NAND:K/"
CONFIG_APP_STACKSIZE=2048
CONFIG_MAIN_STACK_SIZE=2048

#CONFIG_VIEW_SCROLL_MEM_LOWEST=y
CONFIG_VIEW_CACHE_LEVEL=2

# Set auto size decided by shared surface buffer size
CONFIG_LV_VDB_SIZE=0
CONFIG_UI_MEM_BLOCK_SIZE=434432
CONFIG_UI_MEM_NUMBER_BLOCKS=10
CONFIG_UI_GUI_MEM_POOL_SIZE=98304
CONFIG_UI_RES_MEM_POOL_SIZE=19377216
CONFIG_BITMAP_PER_FONT_CACHE_SIZE=98304
CONFIG_BITMAP_FONT_CACHE_POOL_SIZE=380000
CONFIG_FREETYPE_FONT_BITMAP_BPP=2
CONFIG_FREETYPE_PER_FONT_CACHE_SIZE=40960
CONFIG_FREETYPE_FONT_ENABLE_MEMORY_FACE=n
CONFIG_FREETYPE_FONT_MAX_FACES=2
CONFIG_FREETYPE_FONT_MAX_SIZES=3
CONFIG_FREETYPE_SHAPE_INFO_CACHE_SIZE=5120
CONFIG_FREETYPE_FONT_SHAPE_CACHE_SIZE=60000
CONFIG_OTA_TEMP_PART_DEV_NAME="spinand"
CONFIG_RES_MANAGER_BLOCK_SIZE=434432
CONFIG_RES_MANAGER_BLOCK_NUM=2

#usb mass storage config
CONFIG_MASS_STORAGE_DISK_PDRV=1
CONFIG_MASS_STORAGE_DISK_NAME="NAND"
CONFIG_MASS_STORAGE_STACK_SIZE=2048
CONFIG_EMOJI_FONT_USE_MMAP=n

CONFIG_DISK_ACCESS_SPINAND=y
CONFIG_APP_UI_DISK="/NAND:A"
CONFIG_APP_FONT_DISK="/NAND:C"
CONFIG_APP_FAT_DISK="/NAND:"
CONFIG_APP_UI_DISK_B="/NAND:B"
CONFIG_WELCOME_UI_DISK="/NAND:K"

CONFIG_SVG_RENDER=y

CONFIG_MASS_STORAGE_BUF_SIZE=4096

CONFIG_IPMSG_BTC_FCC_NAME="/NAND:K/fcc.bin"
CONFIG_BT_MP_BTC_FILE_NAME="/NAND:K/mp_btc.bin"

CONFIG_USER_WORK_Q=y
CONFIG_USER_WORK_Q_PRIORITY=8

CONFIG_UI_MEM_VDB_SHARE_SURFACE_BUFFER=y

CONFIG_DVFS=y
CONFIG_ACTS_DVFS_DYNAMIC_LEVEL=y

#=========== video ===========
CONFIG_VIDEO_PLAYER=y
CONFIG_VIDEO_APP=y

#=========== lottie ===========
#CONFIG_LV_USE_LOTTIE=y
#CONFIG_LV_USE_THORVG=y
#CONFIG_LV_USE_THORVG_INTERNAL=y

#CONFIG_CPLUSPLUS=y
#CONFIG_STD_CPP14=y
#CONFIG_LIB_CPLUSPLUS=y
#CONFIG_RTTI=y

#CONFIG_NEWLIB_LIBC_MIN_REQUIRED_HEAP_SIZE=524288

#CONFIG_UISRV_STACKSIZE=32768
```

## action_technology_sdk/application/bt_watch/boards/ats3089p_dev_watch_sdnand.conf
```kconfig
#=========== config for boards ===========
CONFIG_DSP_IMAGE_PATH="/SD:K/"
CONFIG_APP_STACKSIZE=2048
CONFIG_MAIN_STACK_SIZE=2048

#CONFIG_VIEW_SCROLL_MEM_LOWEST=y
CONFIG_VIEW_CACHE_LEVEL=1

CONFIG_LV_VDB_SIZE=108578
CONFIG_LV_USE_LODEPNG=y
CONFIG_UI_MEM_BLOCK_SIZE=434432
CONFIG_UI_MEM_NUMBER_BLOCKS=10
CONFIG_UI_GUI_MEM_POOL_SIZE=131072
CONFIG_UI_RES_MEM_POOL_SIZE=16377216
CONFIG_BITMAP_PER_FONT_CACHE_SIZE=98304
CONFIG_BITMAP_FONT_CACHE_POOL_SIZE=680000
CONFIG_FREETYPE_FONT_BITMAP_BPP=2
CONFIG_FREETYPE_PER_FONT_CACHE_SIZE=40960
CONFIG_FREETYPE_FONT_ENABLE_MEMORY_FACE=n
CONFIG_FREETYPE_FONT_MAX_FACES=2
CONFIG_FREETYPE_FONT_MAX_SIZES=3
CONFIG_FREETYPE_SHAPE_INFO_CACHE_SIZE=3072
CONFIG_FREETYPE_FONT_SHAPE_CACHE_SIZE=120000
CONFIG_OTA_TEMP_PART_DEV_NAME="sd"
CONFIG_RES_MANAGER_BLOCK_SIZE=434432
CONFIG_RES_MANAGER_BLOCK_NUM=2

#usb mass storage config
CONFIG_MASS_STORAGE_DISK_PDRV=4
CONFIG_MASS_STORAGE_DISK_NAME="SD"
CONFIG_MASS_STORAGE_STACK_SIZE=2048
CONFIG_EMOJI_FONT_USE_MMAP=n
CONFIG_MMC=y
CONFIG_MMC_ACTS=y
CONFIG_MMC_SDCARD=y
CONFIG_DISK_ACCESS_SD=y

#CONFIG_DISK_ACCESS_SPINAND=y
CONFIG_APP_UI_DISK="/SD:A"
CONFIG_APP_FONT_DISK="/SD:C"
CONFIG_APP_FAT_DISK="/SD:"
CONFIG_APP_UI_DISK_B="/SD:B"
CONFIG_WELCOME_UI_DISK="/SD:K"

CONFIG_SVG_RENDER=y

CONFIG_MASS_STORAGE_BUF_SIZE=4096

CONFIG_IPMSG_BTC_FCC_NAME="/SD:K/fcc.bin"
CONFIG_BT_MP_BTC_FILE_NAME="/SD:K/mp_btc.bin"

CONFIG_USER_WORK_Q=y
CONFIG_USER_WORK_Q_PRIORITY=8

CONFIG_UI_MEM_VDB_SHARE_SURFACE_BUFFER=y

CONFIG_DVFS=y
CONFIG_ACTS_DVFS_DYNAMIC_LEVEL=y

#=========== video ===========
CONFIG_VIDEO_PLAYER=y
CONFIG_VIDEO_APP=y
#=========== glyphix config ==========
CONFIG_GLYPHIX=y
CONFIG_GX_SCREEN_WIDTH=466
CONFIG_GX_SCREEN_HEIGHT=466
CONFIG_GX_SCREEN_DPI=326
CONFIG_GX_DEFAULT_FONT_SIZE=32
CONFIG_GX_UI_HEAP_MEM_POOL_SIZE=8388608
CONFIG_GX_STORAGE_ROOTFS_PATH="/SD:/gx"

CONFIG_LIB_CPLUSPLUS=y
CONFIG_CPLUSPLUS=y
CONFIG_POSIX_API=y
CONFIG_POSIX_MAX_OPEN_FILES=64
CONFIG_POSIX_MAX_FDS=64
CONFIG_PTHREAD_IPC=y
CONFIG_FS_FATFS_NUM_FILES=64
CONFIG_FS_FATFS_NUM_DIRS=64

CONFIG_BT_ECC_ACTS=n
CONFIG_BTSRV_STACKSIZE=2048

#=========== mbedtls config ===========
#CONFIG_ZEPHYR_MBEDTLS_MODULE=y
CONFIG_MBEDTLS=y
CONFIG_MBEDTLS_BUILTIN=y
CONFIG_MBEDTLS_CFG_FILE="config-tls-generic.h"
CONFIG_MBEDTLS_TLS_VERSION_1_2=y

# Supported key exchange modes
CONFIG_MBEDTLS_KEY_EXCHANGE_RSA_ENABLED=y

# Supported cipher modes
CONFIG_MBEDTLS_CIPHER_AES_ENABLED=y
CONFIG_MBEDTLS_AES_ROM_TABLES=y
CONFIG_MBEDTLS_CIPHER_DES_ENABLED=y
CONFIG_MBEDTLS_CIPHER_MODE_CBC_ENABLED=y
CONFIG_MBEDTLS_PEM_CERTIFICATE_FORMAT=y

# Supported message authentication methods
CONFIG_MBEDTLS_MAC_MD5_ENABLED=y
CONFIG_MBEDTLS_MAC_SHA1_ENABLED=y
CONFIG_MBEDTLS_MAC_SHA256_ENABLED=y
CONFIG_MBEDTLS_SHA256_SMALLER=y

# Random number generators
CONFIG_MBEDTLS_CTR_DRBG_ENABLED=y

# Other configurations
CONFIG_MBEDTLS_CIPHER=y
CONFIG_MBEDTLS_MD=y
CONFIG_MBEDTLS_ENTROPY_ENABLED=y
CONFIG_MBEDTLS_SSL_MAX_CONTENT_LEN=1500
CONFIG_APP_LINK_WITH_MBEDTLS=y

#vglite gpu memory 512*1024
CONFIG_VG_LITE_K_MEM_POOL_SIZE=512000
#libc malloc memory 256*1024
CONFIG_NEWLIB_LIBC_MIN_REQUIRED_HEAP_SIZE=262144
CONFIG_SYSTEM_WORKQUEUE_STACK_SIZE=2048
CONFIG_THIRD_PARTY_APP=y
# media service thread stack size
CONFIG_MEDIASRV_STACKSIZE=4096
# system heap
CONFIG_HEAP_MEM_POOL_SIZE=65536

# bsp using mp3 encoder
CONFIG_ENCODER_MP3=y
CONFIG_ENCODER_MP3_HW_ACCELERATION=y

CONFIG_ASSERT=y

CONFIG_TASK_WDT=n

CONFIG_DISKIO_CACHE=n
```

## action_technology_sdk/application/bt_watch/src/card_reader/Kconfig
```kconfig
# Kconfig - ACTIONS primitive options for sdk version 2.0

#
# Copyright (c) 2015 Intel Corporation
#
# Licensed under the Apache License, Version 2.0 (the "License");
# you may not use this file except in compliance with the License.
# You may obtain a copy of the License at
#
#     http://www.apache.org/licenses/LICENSE-2.0
#
# Unless required by applicable law or agreed to in writing, software
# distributed under the License is distributed on an "AS IS" BASIS,
# WITHOUT WARRANTIES OR CONDITIONS OF ANY KIND, either express or implied.
# See the License for the specific language governing permissions and
# limitations under the License.
#

config CARD_READER_APP
	bool
	prompt "CARD READER App Support"
	select USB_MASS_STORAGE
	select MUTIPLE_VOLUME_MANAGER
	default n
	help
	This option enables or disable the card reader app.

config CARD_READER_RUNTIME
	bool
	prompt "CARD READER runtime Support"
	depends on CARD_READER_APP
	default n
	help
	This option enables or disable dynamically switch card reader modes based on hotplug information.
```

## action_technology_sdk/application/bt_watch/src/ota/Kconfig
```kconfig
menuconfig OTA_APP
	bool
	prompt "OTA App Support"
	select OTA_UPGRADE
	select STREAM
	default n
	help
	This option enable or disable ota app

config OTA_FOREGROUND
	bool "OTA Foreground Support"
	depends on OTA_APP
	default n
	help
	  This option enable OTA foreground upgrade.

config OTA_BACKGROUND
	bool "OTA background Support"
	depends on OTA_APP
	default n
	help
	  This option enable OTA background upgrade.

config SYSTEM_RECOVERY_APP_SUPPORT
	bool
	prompt "System Recovery App Support"
	depends on OTA_APP
	default n
	depends on SYSTEM_RECOVERY
	help
	This option enable or disable system recovery app

config OTA_UPGRADE
	bool "OTA Upgrade Support"
	default n
	select PARTITION
	select FIRMWARE_VERSION
	select RING_BUFFER
	help
	  This option enable OTA upgrade.

if OTA_UPGRADE
config OTA_RECOVERY
	bool "OTA recovery firmware Support"
#   select MMC
#	select MUTIPLE_VOLUME_MANAGER
#	select FILE_STREAM
	select STREAM
#	select MMC_SDCARD
	default n
	depends on OTA_UPGRADE
	help
	  This option enable OTA recovery firmware.

config OTA_RECOVERY_APP
	bool "OTA recovery application Support"
	default n
	depends on OTA_RECOVERY
	help
	  This option enable OTA recovery application.

config OTA_TEMP_PART_DEV_NAME
	string "OTA temp partition device name"
	depends on OTA_RECOVERY
	default "sd"
	help
	  Specify the device name for temp partition.

config XSPI1_NOR_ACTS_DEV_NAME
	string "SPI1 NOR flash device name"
	depends on XSPI_NOR_ACTS
	default "spi1_nor"
	help
	  Specify the device name for SPI1 NOR flash driver.

config OTA_BACKEND_SDCARD
    bool "OTA upgrade by SDCARD Support"
#	select MMC
	select MUTIPLE_VOLUME_MANAGER
	select FILE_STREAM
	select STREAM
#	select MMC_SDCARD
    default n
    help
      This option enables OTA upgrade by SDCARD.

config OTA_BACKEND_BLUETOOTH
    bool "OTA upgrade by Bluetooth Support"
	depends on BT_MANAGER
	select STREAM
    select BT_SPPBLE_STREAM
    default n
    help
      This option enables OTA upgrade by Bluetooth SPP/BLE.

config OTA_BACKEND_TEMP_PART
    bool "OTA upgrade by spinor Support"
    select FLASH
    default n
    help
      This option enables OTA upgrade by spinor.

config OTA_FILE_PATCH
    bool "OTA file patch Support"
    depends on !OTA_RECOVERY
    default n
    help
      This option enables OTA file patch.

config OTA_STORAGE_FS
    bool "OTA upgrade by SDCARD Support"
	select MUTIPLE_VOLUME_MANAGER
	select FILE_STREAM
    default n
    help
      This option enables OTA upgrade by SDCARD.

config OTA_MUTIPLE_STORAGE
    bool "OTA upgrade Support multiple storage"
    depends on OTA_RECOVERY
    default n
    help
      This option enables OTA upgrade by multiple storage.

config OTA_RES_PATCH
    bool "OTA res patch Support"
    default n
    help
      This option enables OTA res patch.
endif
```

## action_technology_sdk/bootloader/boards/arm/ats3085s4_watch_bootemmc/Kconfig.board
```kconfig
# STM32F469I-DISCO board configuration

# Copyright (c) 2016 Linaro Limited.
# SPDX-License-Identifier: Apache-2.0

config BOARD_ATS3085S4_WATCH_BOOTEMMC
	bool "leopard ats3085s4 bootemmc Development Board"
	depends on SOC_LEOPARD
```

## action_technology_sdk/bootloader/boards/arm/ats3085s_watch_bootnand/Kconfig.board
```kconfig
# STM32F469I-DISCO board configuration

# Copyright (c) 2016 Linaro Limited.
# SPDX-License-Identifier: Apache-2.0

config BOARD_ATS3085S_WATCH_BOOTNAND
	bool "loepard ats3085s bootnand  Development Board"
	depends on SOC_LEOPARD
```

## action_technology_sdk/bootloader/boards/arm/ats3089p_dev_watch_sdnand/Kconfig.board
```kconfig
# STM32F469I-DISCO board configuration

# Copyright (c) 2016 Linaro Limited.
# SPDX-License-Identifier: Apache-2.0

config BOARD_ATS3089P_DEV_WATCH_SDNAND
	bool "loepard ats3089p sdnand Development Board"
	depends on SOC_LEOPARD
```

## action_technology_sdk/bootloader/boards/arm/ats3089u_dev_watch/Kconfig.board
```kconfig
# STM32F469I-DISCO board configuration

# Copyright (c) 2016 Linaro Limited.
# SPDX-License-Identifier: Apache-2.0

config BOARD_ATS3089U_DEV_WATCH
	bool "loepard ats3089u Development Board"
	depends on SOC_LEOPARD
```
