## action_technology_sdk/bootloader/drivers/Kconfig
```kconfig
# drivers configuration options

# Copyright (c) 2015 Intel Corporation
# SPDX-License-Identifier: Apache-2.0

menu "Device Drivers"

source "drivers/bluetooth/Kconfig"


source "drivers/console/Kconfig"

source "drivers/debug/Kconfig"
source "drivers/serial/Kconfig"

source "drivers/timer/Kconfig"

source "drivers/gpio/Kconfig"

source "drivers/spi/Kconfig"

source "drivers/i2c/Kconfig"

source "drivers/watchdog/Kconfig"

source "drivers/flash/Kconfig"

source "drivers/dma/Kconfig"

source "drivers/display/Kconfig"

source "drivers/ipmsg/Kconfig"

source "drivers/mmc/Kconfig"

source "drivers/misc/Kconfig"

source "drivers/nvram/Kconfig"

source "drivers/input/Kconfig"

source "drivers/spinand/Kconfig"

source "drivers/mpu/Kconfig"


rsource "pwm/Kconfig"
endmenu
```

## action_technology_sdk/bootloader/drivers/display/controller/Kconfig
```kconfig
# Configuration options for Actions Display Controller

# Copyright (c) 2020 Actions Technology Co., Ltd
# SPDX-License-Identifier: Apache-2.0

menuconfig DISPLAY_CONTROLLER
	bool "Display Controller"
	help
	  Enable display controller

if DISPLAY_CONTROLLER

config DISPLAY_LCDC
	bool "Display LCD Controller"
	default y
	help
	  Enable LCD display controller

config DISPLAY_LCDC_LARK
	bool
	default y if SOC_SERIES_LARK
	depends on DISPLAY_LCDC
	help
	  Enable LCD display controller for Lark SoC Series.

config DISPLAY_LCDC_LEOPARD
	bool
	default y if SOC_SERIES_LEOPARD
	depends on DISPLAY_LCDC
	help
	  Enable LCD display controller for Leopard SoC Series.

endif # DISPLAY_CONTROLLER
```

## action_technology_sdk/bootloader/drivers/display/dma2d_lite/Kconfig
```kconfig
# Configuration options for Actions Display Accelerator

# Copyright (c) 2020 Actions Technology Co., Ltd
# SPDX-License-Identifier: Apache-2.0

menuconfig DMA2D_LITE
	bool "DMA2D Lite Engine"
	depends on SOC_SERIES_LEOPARD
	help
	  Enable DMA2D Lite Engine

if DMA2D_LITE

config DMA2D_LITE_INSTANCE_NUM
	int "DMA2D Lite Instance Number"
	default 2
	help
	  Set DMA2D lite maximum instances to support

endif # DMA2D_LITE
```

## action_technology_sdk/bootloader/drivers/display/engine/Kconfig
```kconfig
# Configuration options for Actions Display Accelerator

# Copyright (c) 2020 Actions Technology Co., Ltd
# SPDX-License-Identifier: Apache-2.0

menuconfig DISPLAY_ENGINE
	bool "Display Engine"
	help
	  Enable display engine

if DISPLAY_ENGINE

config DISPLAY_ENGINE_LARK
	bool
	default y if SOC_SERIES_LARK
	help
	  Display Engine for Lark SoC Series.

config DISPLAY_ENGINE_LEOPARD
	bool
	default y if SOC_SERIES_LEOPARD
	help
	  Display Engine for Leopard SoC Series.

config DISPLAY_ENGINE_INSTANCE_NUM
	int "Display Engine Instance Number"
	default 3
	help
	  Set display engine maximum instances to support

config DISPLAY_ENGINE_HIHG_PRIO_INSTANCE
	bool
	help
	  Enable display engine high priority instance

config DISPLAY_ENGINE_DRAW_COMMAND_NUM
	int "Display Engine Command Number Per Instance"
	default 10
	help
	  Set display engine maximum instances commands to support

config DISPLAY_ENGINE_POST_COMMAND_NUM
	int "Display Engine Command Number Per Instance"
	default 3
	help
	  Set display engine maximum instances commands to support

config DISPLAY_ENGINE_COMMAND_TIMEOUT_MS
	int "Display Engine Command Timeout in Milliseconds"
	default 500
	help
	  Set display engine command timeout in milliseconds

endif # DISPLAY_ENGINE
```

## action_technology_sdk/bootloader/drivers/flash/Kconfig.acts
```kconfig
# Copyright (c) 2018 Intel Corporation
# SPDX-License-Identifier: Apache-2.0


menuconfig SPI_FLASH_ACTS
	bool "actions SPI flash driver"
	select FLASH_HAS_DRIVER_ENABLED
	select FLASH_HAS_PAGE_LAYOUT
	help
	  Enable support for actions SPI flash driver

config SPI_NOR_FLASH_DRV_EXT
	bool
	prompt "Select the external NOR driver"
	default n
	depends on SPI_FLASH_ACTS
	help
		If you say Y here, Select the external NOR driver, else use brom nor driver.

config SPI_NOR_FLASH_4B_ADDRESS
	bool
	prompt "Support NOR flash 4-byte address driver"
	default n
	depends on SPI_FLASH_ACTS
	select SPI_NOR_FLASH_DRV_EXT
	help
		If you say Y here, you will get support NOR flash 4-byte address driver.
		If unsure, it is safe to say N.

config NOR_CODE_IN_RAM
	bool
	prompt "extern nor flash driver run in RAM"
	default n
	depends on SPI_NOR_FLASH_DRV_EXT
	help
		If you say Y here, the external NOR driver run in RAM.
```

## action_technology_sdk/bootloader/drivers/gpio/Kconfig
```kconfig
# GPIO configuration options

# Copyright (c) 2015 Intel Corporation
# SPDX-License-Identifier: Apache-2.0

menuconfig GPIO
	bool "GPIO Drivers"
	select HAS_DTS_GPIO
	help
	  Include GPIO drivers in system config

if GPIO

module = GPIO
module-str = gpio
source "subsys/logging/Kconfig.template.log_config"

config GPIO_SHELL
	bool "Enable GPIO Shell"
	depends on SHELL
	help
	  Enable GPIO Shell for testing.

config EXTEND_GPIO_ET6416
	bool "Enable GPIO_ET6416"
	help
	  Enable GPIO GPIO_ET6416.

config EXTEND_GPIO_ET6416_SHELL
	bool "Enable GPIO_ET6416 shell dbg"
	depends on EXTEND_GPIO_ET6416
	help
	  Enable GPIO GPIO_ET6416 shell dbg.

source "drivers/gpio/Kconfig.acts"

endif # GPIO
```

## action_technology_sdk/bootloader/drivers/i2c/Kconfig.acts
```kconfig
# Copyright (c) 2018 Intel Corporation
# SPDX-License-Identifier: Apache-2.0


menuconfig I2C_ACTS
	bool "actions I2C driver"
	help
	  Enable support for actions I2C driver

menuconfig I2CMT_ACTS
	bool "actions I2CMT driver"
	select RBUF_LIB
	help
	  Enable support for actions I2CMT driver

if I2CMT_ACTS

config I2CMT_LARK
	bool "I2CMT driver on SoC Lark"
	default y
	depends on SOC_SERIES_LARK
	help
	  Enable I2CMT driver on SoC Lark

endif # I2CMT_ACTS
```

## action_technology_sdk/bootloader/drivers/input/Kconfig
```kconfig
# Kconfig - Input device configuration options
#
#
# Copyright (c) 2021 Actions Semiconductor Co., Ltd
#
# SPDX-License-Identifier: Apache-2.0
#

menuconfig INPUT_DEV
	bool
	prompt "Input device drivers"
	default n
	help
	  Enable input device driver configuration

if INPUT_DEV

source "drivers/input/tpkey/Kconfig"

config SYS_LOG_INPUT_DEV_LEVEL
	int
	prompt "INPUT Device drivers log level"
	range 0 4
	default 0
	help
	  Sets log level for INPUT Device driver.

	  Levels are:
	  - 0 OFF, do not write
	  - 1 ERROR, only write SYS_LOG_ERR
	  - 2 WARNING, write SYS_LOG_WRN in addition to previous level
	  - 3 INFO, write SYS_LOG_INF in addition to previous levels
	  - 4 DEBUG, write SYS_LOG_DBG in addition to previous levels

config INPUT_DEV_ACTS_ADCKEY
	bool "Actions SoC adc keypad driver"
	depends on SOC_FAMILY_ACTS
	default n
	help
	  Enable support for Actions SoC adc keypad driver.

config ADCKEY_POLL_TIMER
	bool "Actions Soc ADC key polling status by timer"
	depends on INPUT_DEV_ACTS_ADCKEY
	default n
	help
	  If you say Y here, you will get support ADC polling status by timer.

config INPUT_DEV_ACTS_GPIOKEY
	bool "Actions SoC gpio keypad driver"
	depends on SOC_FAMILY_ACTS
	default n
	help
	  Enable support for Actions SoC gpio keypad driver.

config GPIO_KEY_POLL_TIMER
	bool "Actions Soc GPIO key polling status by timer"
	depends on INPUT_DEV_ACTS_GPIOKEY
	default n
	help
	  If you say Y here, you will get support GPIO key polling status by timer.

config INPUT_DEV_ACTS_ONOFF_KEY
	bool "Actions SoC On/Off key driver"
	depends on SOC_FAMILY_ACTS
	default n
	help
	  Enable support for Actions SoC On/Off key driver.

config ONOFF_KEY_POLL_TIMER
	bool "Actions Soc On/Off key polling status by timer"
	depends on INPUT_DEV_ACTS_ONOFF_KEY
	default n
	help
	  If you say Y here, you will get support On/Off key polling status by timer.

config INPUT_DEV_ACTS_TP_KEY
	bool "Actions SoC On/Off key driver"
	depends on SOC_FAMILY_ACTS
	default n
	help
	  Enable support for Actions SoC TP key driver.

config INPUT_DEV_ACTS_KEY_PAD
	bool "Actions SoC mx key pad driver"
	depends on SOC_FAMILY_ACTS
	default n
	help
	  Enable support for Actions SoC mx key pad driver.

config INPUT_DEV_ACTS_QUAD_DECODER
	bool "Actions SoC QD driver"
	depends on SOC_FAMILY_ACTS
	default n
	help
	  Enable support for Actions SoC QD driver.

config INPUT_DEV_ACTS_IR_CAPTURE
	bool "Actions SoC IR capture driver"
	depends on SOC_FAMILY_ACTS
	default n
	help
	  Enable support for Actions SoC IR capture driver.
endif # INPUT_DEV
```

## action_technology_sdk/bootloader/drivers/ipmsg/Kconfig
```kconfig
# ipmsg configuration options

# Copyright (c) 2015 Intel Corporation
# SPDX-License-Identifier: Apache-2.0


rsource "Kconfig.acts"
```

## action_technology_sdk/bootloader/drivers/ipmsg/Kconfig.acts
```kconfig
# Copyright (c) 2018 Intel Corporation
# SPDX-License-Identifier: Apache-2.0

menuconfig IPMSG_ACTS
	bool "actions ipmsg driver"
	select RBUF_LIB
	help
	  Enable support for actions ipmsg driver


if IPMSG_ACTS

config IPMSG_ACTS_SC
	bool "IPM driver for Sensor CPU"
	default n
	help
	  Driver for Sensor CPU

config IPMSG_ACTS_BTC
	bool "IPM driver for Bluetooth CPU"
	depends on IPMSG_ACTS
	help
	  Driver for Bluetooth CPU

if IPMSG_ACTS_BTC

choice
	prompt "select storage for bt fw"
	default BTC_FW_IN_NOR

config BTC_FW_IN_NOR
	bool "BTC Firmware bin in nor"
	help
	   BTC Firmware bin in nor.
config BTC_FW_IN_NAND
	bool "BTC Firmware bin in nand"
	help
	   select BTC Firmware bin in sdcard.

config BTC_FW_IN_SD
	bool "BTC Firmware bin in sdcard"
	help
	   select BTC Firmware bin in sdcard.

config BTC_FW_IN_NOR_EXT
	bool "BTC Firmware bin in extern nor"
	help
	   select BTC Firmware bin in extern nor.

endchoice
endif

config IPMSG_BTC_SEL_32K
	bool "Bluetooth CPU select 32768 oscillator"
	depends on IPMSG_ACTS
	default n
	help
	  Bluetooth CPU select 32768 oscillator

endif #IPMSG_ACTS
```

## action_technology_sdk/bootloader/drivers/mmc/Kconfig.acts
```kconfig
# Copyright (c) 2018 Intel Corporation
# SPDX-License-Identifier: Apache-2.0


if MMC

config MMC_SDCARD
	bool "Support SD Card"
	default n
	help
	  Enable support for SD Card.

config MMC_SDIO
	bool "SDIO driver"
	default n
	help
	  Enable support for SDIO.

config MMC_ACTS
	bool "Actions SoC MMC driver"
	default n
	help
	  Enable MMC Controller of Actions SoC

config SD_USE_IOVCC1_POWER
	bool "sdmmc use IOVCC1 as power"
	default n
	help
	  Enable IOVCC1 as sdmmc power

endif
```
