## action_technology_sdk/zephyr/boards/arm/ats3085s_dev_watch_2cs_nor/Kconfig.defconfig
```kconfig
# Copyright (c) 2016 Linaro Limited.
# SPDX-License-Identifier: Apache-2.0

if BOARD_ATS3085S_DEV_WATCH_2CS_NOR

config BOARD
	default "ats3085s_dev_watch_2cs_nor"

config I2CMT_LEOPARD
    default y

config SPIMT_LEOPARD
    default y

if DISPLAY

config PANEL_ICNA3310B
    default y

endif # DISPLAY

if LOG

config LOG_BUFFER_SIZE
	default 4096

config LOG_DETECT_MISSED_STRDUP
    default n

endif # LOG


if SHELL_DBG

config KERNEL_SHELL
	default y

config DEVICE_SHELL
	default y

config POSIX_CLOCK
	default y

config DATE_SHELL
	default y

config INIT_STACKS
	default y

config THREAD_STACK_INFO
	default y

config THREAD_MONITOR
	default y

config THREAD_NAME
	default y

if GPIO

config GPIO_SHELL
	default y

endif # GPIO

if FILE_SYSTEM

config FILE_SYSTEM_SHELL
	default y

endif # FILE_SYSTEM

if FLASH

config FLASH_SHELL
	default y

endif # FLASH

if FLASH_MAP

config FLASH_MAP_SHELL
	default y

endif # FLASH_MAP

endif # SHELL_DBG

if SPINAND_ACTS
config SPI_HOST
	default 3
endif # SPINAND_ACTS

endif # BOARD_ATS3085S_DEV_WATCH_EXT_NOR
```

## action_technology_sdk/zephyr/boards/arm/ats3085s_watch_bootemmc/Kconfig.board
```kconfig
# STM32F469I-DISCO board configuration

# Copyright (c) 2016 Linaro Limited.
# SPDX-License-Identifier: Apache-2.0

config BOARD_ATS3085S_WATCH_BOOTEMMC
	bool "leopard ats3085s bootemmc Development Board"
	depends on SOC_LEOPARD
```

## action_technology_sdk/zephyr/boards/arm/ats3089_dev_watch_24bit/Kconfig.board
```kconfig
# STM32F469I-DISCO board configuration

# Copyright (c) 2016 Linaro Limited.
# SPDX-License-Identifier: Apache-2.0

config BOARD_ATS3089_DEV_WATCH_24BIT
	bool "loepard ats3089 24bit Development Board"
	depends on SOC_LEOPARD
```

## action_technology_sdk/zephyr/boards/arm/ats3089_dev_watch_glyphix/Kconfig.board
```kconfig
# STM32F469I-DISCO board configuration

# Copyright (c) 2016 Linaro Limited.
# SPDX-License-Identifier: Apache-2.0

config BOARD_ATS3089_DEV_WATCH_GLYPHIX
	bool "loepard ats3089 glyphix Development Board"
	depends on SOC_LEOPARD
```

## action_technology_sdk/zephyr/boards/arm/ats3089_dev_watch_sdnand/Kconfig.board
```kconfig
# STM32F469I-DISCO board configuration

# Copyright (c) 2016 Linaro Limited.
# SPDX-License-Identifier: Apache-2.0

config BOARD_ATS3089_DEV_WATCH_SDNAND
	bool "loepard ats3089 sdnand Development Board"
	depends on SOC_LEOPARD
```

## action_technology_sdk/zephyr/drivers/Kconfig
```kconfig
# drivers configuration options

# Copyright (c) 2015 Intel Corporation
# SPDX-License-Identifier: Apache-2.0

menu "Device Drivers"

source "drivers/bluetooth/Kconfig"

source "drivers/cfg_drv/Kconfig"

source "drivers/console/Kconfig"

source "drivers/debug/Kconfig"

source "drivers/serial/Kconfig"

source "drivers/timer/Kconfig"

source "drivers/gpio/Kconfig"

source "drivers/spi/Kconfig"

source "drivers/i2c/Kconfig"

source "drivers/adc/Kconfig"

source "drivers/watchdog/Kconfig"

source "drivers/flash/Kconfig"

source "drivers/sensor/Kconfig"

source "drivers/dma/Kconfig"

source "drivers/usb/Kconfig"

source "drivers/display/Kconfig"

source "drivers/audio/Kconfig"

source "drivers/ipmsg/Kconfig"

source "drivers/mmc/Kconfig"

source "drivers/misc/Kconfig"

source "drivers/nvram/Kconfig"

source "drivers/dsp/Kconfig"

source "drivers/input/Kconfig"

source "drivers/power_supply/Kconfig"

source "drivers/spinand/Kconfig"

source "drivers/rtc/Kconfig"

source "drivers/cec/Kconfig"

source "drivers/mpu/Kconfig"

source "drivers/video/Kconfig"

source "drivers/compensation/Kconfig"

source "drivers/gpu/Kconfig"

source "drivers/se/Kconfig"

source "drivers/gps/Kconfig"

rsource "pwm/Kconfig"

rsource "led/Kconfig"

rsource "anc/Kconfig"

rsource "dvfs/Kconfig"
endmenu
```

## action_technology_sdk/zephyr/drivers/adc/Kconfig
```kconfig
# ADC configuration options

# Copyright (c) 2015 Intel Corporation
# SPDX-License-Identifier: Apache-2.0

#
# ADC options
#
menuconfig ADC
	bool "ADC drivers"
	# All platforms that implement the ADC driver are now required to
	# provide relevant DTS entries.
	help
	  Enable ADC (Analog to Digital Converter) driver configuration.

if ADC

config ADC_SHELL
	bool "Enable ADC Shell"
	default n
	depends on SHELL
	help
	  Enable ADC Shell for testing.

# By selecting or not this option particular ADC drivers indicate if it is
# required to explicitly specify analog inputs when configuring channels or
# just the channel identifier is sufficient.
config ADC_CONFIGURABLE_INPUTS
	bool

config ADC_ASYNC
	bool "Enable asynchronous call support"
	select POLL
	help
	  This option enables the asynchronous API calls.

module = ADC
module-str = ADC
source "subsys/logging/Kconfig.template.log_config"

source "drivers/adc/Kconfig.acts"

endif # ADC
```

## action_technology_sdk/zephyr/drivers/anc/Kconfig
```kconfig
# Configuration options for Actions ANC

# Copyright (c) 2020 Actions Technology Co., Ltd
# SPDX-License-Identifier: Apache-2.0

menuconfig ANC
	bool "ANC Drivers"
	help
	  Enable anc drivers

if ANC

config ANC_ACTS_DEV_NAME
	string "Device name of ANC Controller"
	default "ANC_LARK"
	help
	  Device name of ANC Controller

config ANC_DEBUG_PRINT
    bool "enable anc debug print"
    default n
    help
       enable anc debug print

endif # ANC
```

## action_technology_sdk/zephyr/drivers/audio/Kconfig
```kconfig
# Kconfig - Audio configuration options
#
#
# Copyright (c) 2017 Actions Semiconductor Co.,Ltd
#
# SPDX-License-Identifier: Apache-2.0
#

menuconfig AUDIO_ACTS
	bool
	prompt "audio Drivers"
	default n
	help
	Enable options for Actions audio drivers.

if AUDIO_ACTS

config AUDIO_OUT_ACTS
	bool
	prompt "Actions SoC audio output driver"
	default n
	help
	Device driver for Actions SoC audio output

config AUDIO_OUT_ACTS_DEV_NAME
	string "Device Name for Actions SoC audio output"
	default "audio_out"
	depends on AUDIO_OUT_ACTS
	help
	  This is the device name for audio output, and is included in the
	  device struct.

config AUDIO_OUT_DAC_SUPPORT
	bool
	prompt "enable DAC out or not"
	default n
	depends on AUDIO_OUT_ACTS
	help
	audio enable DAC out or not.

config AUDIO_OUT_DAC_PCMBUF_SUPPORT
	bool
	prompt "enable DAC PCMBUF or not"
	default n
	depends on AUDIO_OUT_DAC_SUPPORT
	help
	audio enable DAC PCMBUF or not.

config AUDIO_ANTIPOP_PROCESS
	bool
	prompt "Enable acts audio antipop process"
	default n
	depends on AUDIO_OUT_DAC_SUPPORT
	help
	If you say Y here, you will get support actions audio antipop process when power on and off.

config AUDIO_OUT_I2STX_SUPPORT
	bool
	prompt "enable i2s tx out or not"
	default n
	depends on AUDIO_OUT_ACTS
	help
	audio enable I2S-TX out or not.

config AUDIO_OUT_SPDIFTX_SUPPORT
	bool
	prompt "enable spdif tx out or not"
	default n
	depends on AUDIO_OUT_ACTS
	help
	audio enable spdif out or not.

config AUDIO_OUT_PDMTX_SUPPORT
	bool
	prompt "enable PDMTX out or not"
	default n
	depends on AUDIO_OUT_ACTS
	help
	audio enable PDMTX out or not.

config AUDIO_IN_ACTS
	bool
	prompt "Actions SoC audio input driver"
	default n
	help
	Device driver for Actions SoC audio input

config AUDIO_IN_ACTS_DEV_NAME
	string "Device Name for Actions SoC audio input"
	default "audio_in"
	depends on AUDIO_IN_ACTS
	help
	  This is the device name for audio input, and is included in the
	  device struct.

config AUDIO_IN_ADC_SUPPORT
	bool
	prompt "enable ADC out or not"
	default n
	depends on AUDIO_IN_ACTS
	help
	audio enable ADC in or not.

config ADC_STARTUP_DISCARD_TIME
	int "setup the time in millisecond once ADC startup to discard data"
	default 80
	help
		This option setup the time in millisecond to discard data when ADC startup.

config AUDIO_IN_I2SRX_SUPPORT
	bool
	prompt "enable i2s rx in or not"
	default n
	depends on AUDIO_IN_ACTS
	help
	audio enable i2srx in or not.

config AUDIO_IN_SPDIFRX_SUPPORT
	bool
	prompt "enable spdif rx in or not"
	default n
	depends on AUDIO_IN_ACTS
	help
	audio enable spdif in or not.

config AUDIO_IN_ANC_SUPPORT
	bool
	prompt "enable Active Noise Control or not"
	default n
	depends on AUDIO_IN_ACTS
	help
	audio enable ANC(Active Noise Control) or not.

config AUDIO_PA_AW87390_SUPPORT
	bool
	prompt "enable AW87390 pa or not"
	default n
	help
	Enable external AW87390 pa or not.

config BOARD_EXTERNAL_PA_ENABLE
	bool
	prompt "enable external pa or not"
	default n
	help
	Enable external pa or not.

config EXTERN_PA_CLASS
	int "set external pa default class mode"
	depends on BOARD_EXTERNAL_PA_ENABLE
	default 1
	range 0 1
	help
	Set extern pa class mode, 0 for classAB, other value for classD.

config AUDIO_POWERON_OPEN_PA
	bool
	prompt "open PA when power on"
	depends on AUDIO_OUT_DAC_SUPPORT
	default n
	help
	Open PA when power on or not.

config AUDIO_POWERON_OPEN_I2STX
	bool
	prompt "open I2STX when power on"
	depends on AUDIO_OUT_I2STX0_SUPPORT
	default n
	help
	Open I2STX when power on or not.

config AUDIO_DRIVER_SHELL
	bool "Acts audio driver shell support"
	depends on SHELL
	default n
	help
	If you say Y here, you will get support for the actions audio driver shell.

config AUDIO_DRIVER_STREAM_SHELL
	bool "Acts audio driver stream shell for play/record test"
	depends on AUDIO_DRIVER_SHELL
	default n
	help
	If you say Y here, you will get support the actions audio stream shell
	for audio driver play or record test.

config AUDIO_DEBUG_TRACE
	bool "Enable audio debug trace"
	default n
	help
	If you say Y here, you will get support audio debug trace function.

config AUDIO_DYNAMIC_DEBUG
	bool "Enable audio dynamic debug"
	default n
	help
	If you say Y here, you will get support audio dynamic debug function.

config AUDIO_ACTS_UTILS
	bool "Acts audio driver utils support"
	depends on AUDIO_OUT_ACTS || AUDIO_IN_ACTS
	default y
	help
	If you say Y here, you will get support for the actions audio driver utils.

config ADC_DMIC
	bool
	prompt "Enable ADC use DMIC"
	default n
	help
		If you say Y here, you will get support the digital MIC function in ADC.
		If unsure, it is safe to say N.

config ADC_DMIC_RL_SEQUENCE
	bool
	prompt "ADC DMIC data in RL sequence"
	depends on ADC_DMIC
	default n
	help
		If you say Y here, you will get support the digital DMIC R and L data sequence.
		For the LARK chipset, this macro will be used to control DMIC01 channel sequence.
		If unsure, it is safe to say N.

config ADC_DMIC23_RL_SEQUENCE
	bool
	prompt "ADC DMIC data in RL sequence"
	depends on ADC_DMIC
	default n
	help
		If you say Y here, you will get support the digital DMIC23 R and L data sequence.
		If unsure, it is safe to say N.

endif # AUDIO
```

## action_technology_sdk/zephyr/drivers/bluetooth/Kconfig
```kconfig
# BLUETOOTH configuration options

# Copyright (c) 2015 Intel Corporation
# SPDX-License-Identifier: Apache-2.0

source "drivers/bluetooth/Kconfig.acts"
```
