## action_technology_sdk/framework/system/alarm_manager/Kconfig
```kconfig
# Kconfig - Actions file system

#
# Copyright (c) 2016 Actions Corporation
#
# SPDX-License-Identifier: Apache-2.0
#

menuconfig ALARM
	bool
	prompt "Alarm"
	depends on RTC
	select ALARM_MANAGER
	default n
	help
	This option enables actions input

config ALARM_MANAGER
	bool
	prompt "alarm manager Support"
	default n
	help
	This option enables actions alarm manager.
```

## action_technology_sdk/framework/system/fs_manager/Kconfig
```kconfig
# Kconfig - Actions file system

#
# Copyright (c) 2016 Actions Corporation
#
# SPDX-License-Identifier: Apache-2.0
#

menuconfig MUTIPLE_VOLUME_MANAGER
	bool
	prompt "Mutiple Volume Manager"
	default n
	help
	This option enables actions filesystem


config FS_MANAGER
	bool
	prompt "FS Manager"
	depends on MUTIPLE_VOLUME_MANAGER
	select FILE_SYSTEM
	select FILE_SYSTEM_FAT
	default n
	help
	This option enables actions mutiple volume manager

config SDFS_MANAGER
	bool
	prompt "SDFS Manager"
	depends on MUTIPLE_VOLUME_MANAGER
	select FILE_SYSTEM
	default n
	help
	This option enables actions sdfs manager

config FS_MANAGER_INIT_CHECK
	bool
	prompt "FS Manager init check"
	depends on FS_MANAGER
	default y
	help
	This option enables fs manager init check
```

## action_technology_sdk/framework/system/hotplug/Kconfig
```kconfig
# Kconfig - Actions hotplug

#
# Copyright (c) 2016 Actions Corporation
#
# SPDX-License-Identifier: Apache-2.0
#

menuconfig HOTPLUG
	bool
	prompt "Hotplug"
	select HOTPLUG_MANAGER
	default n
	help
	This option enables actions hotplug

config HOTPLUG_MANAGER
	bool
	prompt "Hotplug Manager Support"
	depends on HOTPLUG
	default n
	help
	This option enables actions hotplug manager.

config USB_HOTPLUG_THREAD_ENABLED
	bool
	prompt "USB hotplug thread (shared) enabled"
	depends on USB_HOST || USB_MASS_STORAGE_SHARE_THREAD
	default y
	help
	  This option enables USB hotplug thread (shared)

config USB_HOTPLUG_STACKSIZE
	int
	prompt "USB hotplug stack (shared) size"
	depends on USB_HOTPLUG_THREAD_ENABLED
	default 1200
	help
	  Stack size for USB hotplug thread, be care it may be used for other
	  shared threads at the same time.

config USB_HOTPLUG_PRIORITY
	int
	prompt "USB hotplug thread priority"
	depends on USB_HOTPLUG_THREAD_ENABLED
	default 12
	help
	  priority only for USB host enumeration thread for now,
	  others may have own prioities, such as mass storage.

config USB_HOTPLUG
	bool
	prompt "USB hotplug"
	depends on HOTPLUG
	default n
	help
	  This option enables usb hotplug

config CARD_HOTPLUG
	bool
	prompt "CARD hotplug"
	depends on HOTPLUG && MMC
	default n
	help
	  This option enables card hotplug

config CHARGER_HOTPLUG
	bool
	prompt "charger hotplug"
	depends on HOTPLUG
	default n
	help
	  This option enables charger hotplug

config LINEIN_HOTPLUG
	bool
	prompt "linein hotplug"
	depends on HOTPLUG
	default n
	help
	  This option enables linein hotplug
```

## action_technology_sdk/framework/system/power/Kconfig
```kconfig
# Kconfig - Actions power manager

#
# Copyright (c) 2016 Actions Corporation
#
# SPDX-License-Identifier: Apache-2.0
#

menuconfig POWER
	bool
	prompt "Power"
	select POWER_MANAGER
	default n
	help
	This option enables actions power 
	
config POWER_MANAGER
	bool
	prompt "power manager"
	depends on POWER
	default n
	help
	This option enables actions power manager.
```

## action_technology_sdk/framework/system/tts/Kconfig
```kconfig
# Kconfig - ACTIONS primitive options for sdk version 2.0

#
# Copyright (c) 2015 Intel Corporation
#
# Licensed under the Apache License, Version 2.0 (the "License");
# you may not use this file except in compliance with the License.
# You may obtain a copy of the License at
#
#     http://www.apache.org/licenses/LICENSE-2.0
#
# Unless required by applicable law or agreed to in writing, software
# distributed under the License is distributed on an "AS IS" BASIS,
# WITHOUT WARRANTIES OR CONDITIONS OF ANY KIND, either express or implied.
# See the License for the specific language governing permissions and
# limitations under the License.
#

menuconfig PLAYTTS
    bool
    prompt "TTS"
    depends on  MEDIA_PLAYER
    select DECODER_ACT
    select DECODER_ACT_HW_ACCELERATION
    select STREAM
    select BUFFER_STREAM
    default n
    help
    This option enables the play tts.

config PLAY_KEYTONE
    bool
    prompt "support keytone"
    depends on PLAYTTS
    select AUDIO_MIX
    select RESAMPLE
    default n
    help
    This option support keytone.
    
config PLAY_TIPTONE
    bool
    prompt "support tip tone"
    depends on PLAYTTS
    default n
    help
    This option support tip tone.

config TTS_MFILE_STREAM
    bool
    prompt "support play tts continuously"
    depends on PLAYTTS
    default n
    help
    This option support play tts continuously.
```

## action_technology_sdk/framework/usb/class/hid/Kconfig
```kconfig
# Kconfig - USB HID configuration options

#
# Copyright (c) 2018 Intel Corp.
#
# SPDX-License-Identifier: Apache-2.0
#

config USB_DEVICE_HID
	bool
	prompt "USB human interface device(HID) support"
	default n
	help
	  USB human interface device(HID) support.

if USB_DEVICE_HID

config USB_HID_DEVICE_IF_NUM
	int
	prompt "Interface number of hid device"
	default 0
	help
	  Interface number of hid device.

config HID_INTERRUPT_IN_EP_MPS
	int
	prompt "HID class (full-speed) interrupt IN endpoint size"
	default 64
	range 8 64
	help
	  HID class interrupt in endpoint size.

config HID_INTERRUPT_IN_EP_ADDR
	hex
	prompt "USB HID device interrupt in endpoint address"
	default 0x81
	range 0x81 0x8f
	help
	  USB HID device interrupt in endpoint address.

config USB_HID_MAX_PAYLOAD_SIZE
	int
	prompt "USB HID device payload size of interrupt endpoint"
	default 64
	range 8 1024
	help
	  Max allowed payload size over USB HID interrupt endpoint.

config HID_INTERRUPT_OUT
	bool
	prompt "support USB HID device interrupt out"
	default n
	help
	  support USB HID device interrupt out.

if HID_INTERRUPT_OUT

config HID_INTERRUPT_OUT_EP_MPS
	int
	prompt "HID class (full-speed) interrupt OUT endpoint size"
	default 64
	range 8 64
	help
	  HID class interrupt out endpoint size.

config HID_INTERRUPT_OUT_EP_ADDR
	hex
	prompt "USB HID device interrupt out endpoint address"
	default 0x01
	range 0x01 0x0f
	help
	  USB HID device interrupt out endpoint address.

endif #HID_INTERRUPT_OUT

config HID_INTERRUPT_EP_INTERVAL_HS
	hex
	prompt "USB HID device interrupt interval in High-Speed mode"
	default 0x4
	range 0x1 0x10
	help
	  USB HID device interrupt interval in High-Speed mode.

config HID_INTERRUPT_EP_INTERVAL_FS
	hex
	prompt "USB HID device interrupt interval in Full/Low-Speed mode"
	default 0x1
	range 0x1 0xff
	help
	  USB HID device interrupt interval in Full-Speed mode.

config USB_HID_DEVICE_MANUFACTURER
	string
	prompt "USB HID device manufacturer name"
	default "Actions"
	help
	  USB hid device manufacturer string, can be configured by vendor.

config USB_HID_DEVICE_PRODUCT
	string
	prompt "USB HID device product name"
	default "USB-HID-DEV"
	help
	  USB hid device product string, can be configured by vendor.

config USB_HID_DEVICE_SN
	string
	prompt "USB HID device serial number"
	default "0123456789AB"
	help
	  USB hid device serial number string, can be configured by vendor.

config USB_HID_DEVICE_SN_NVRAM
	string
	prompt "get serial number from NVRAM"
	default "BT_MAC"
	help
	  get USB hid device serial number string from NVRAM, can be configured by vendor.

config USB_HID_DEVICE_VID
	hex
	prompt "USB hid device vendor ID"
	default 0x10d6
	help
	  USB hid device vendor ID, can be configured by vendor.

config USB_HID_DEVICE_PID
	hex
	prompt "USB hid device product ID"
	default 0xb012
	help
	  USB hid device product ID, can be configured by vendor.

config HID_REPORT_DESC_SIZE
	int
	prompt "USB HID device hid report descriptor size."
	default 64
	help
	  USB HID device hid report descriptor size.

config USB_SELF_DEFINED_REPORT
	bool
	prompt "Support HID class device self-defined report"
	default n
	help
	  Support HID class device self-defined report.

config SYS_LOG_USB_HID_LEVEL
	int "USB HID device class driver log level"
	depends on LOG
	default 0
	help
	  Sets log level for USB HID device class driver.

	  Levels are:

	  - 0 OFF, do not write

	  - 1 ERROR, only write LOG_ERR

	  - 2 WARNING, write LOG_WRN in addition to previous level

	  - 3 INFO, write LOG_INF in addition to previous levels

	  - 4 DEBUG, write LOG_DBG in addition to previous levels

endif #USB_DEVICE_HID
```

## action_technology_sdk/framework/usb/class/stub/Kconfig
```kconfig
# Kconfig - USB STUB configuration options
#
# Copyright (c) 2020 Actions Corp.
#
# SPDX-License-Identifier: Apache-2.0
#

config USB_DEVICE_STUB
	bool
	prompt "USB STUB Device support"
	default n
	help
	  Enables USB STUB Device support.

if USB_DEVICE_STUB

config USB_STUB_DEVICE_MANUFACTURER
	string
	prompt "USB manufacturer name"
	default "Actions"
	help
	  USB stub device manufacturer string, can be configured by vendor.

config USB_STUB_DEVICE_PRODUCT
	string
	prompt "USB product name"
	default "USB-STUB-DEV"
	help
	  USB stub device product string, can be configured by vendor.

config USB_STUB_DEVICE_SN
	string
	prompt "USB serial number"
	default "0123456789AB"
	help
	  USB stub device serialnumber string, can be configured by vendor.

config USB_STUB_DEVICE_SN_NVRAM
	string
	prompt "get serial number from NVRAM"
	default "BT_MAC"
	help
	  get USB stub device serial number string from NVRAM, can be configured by vendor.

config STUB_IN_EP_ADDR
	hex "USB STUB bulk-IN endpoint address"
	default 0x81
	range 0x81 0x8f
	help
	  USB STUB bulk-IN endpoint address.

config STUB_OUT_EP_ADDR
	hex "USB STUB bulk-OUT endpoint address"
	default 0x02
	range 0x01 0x0f
	help
	  USB STUB bulk-OUT endpoint address.

config STUB_EP_MPS
	int "Maximum packet length of USB stub device endpoint"
	default 64
	range 8 512
	help
	  Maximum packet length of USB stub device endpoint.

config SYS_LOG_USB_STUB_LEVEL
	int "USB STUB device class driver log level"
	depends on LOG
	default 0
	help
	  Sets log level for USB STUB device class driver

	  Levels are:

	  - 0 OFF, do not write

	  - 1 ERROR, only write SYS_LOG_ERR

	  - 2 WARNING, write SYS_LOG_WRN in addition to previous level

	  - 3 INFO, write SYS_LOG_INF in addition to previous levels

	  - 4 DEBUG, write SYS_LOG_DBG in addition to previous levels

endif #USB_DEVICE_STUB
```

## action_technology_sdk/framework/usb/host/storage/Kconfig
```kconfig
# Kconfig - USB host storage driver configuration options

#
# Copyright (c) 2020 Actions Corporation.
#
# SPDX-License-Identifier: Apache-2.0
#

config USB_HOST_STORAGE
	bool
	prompt "USB Host Mass Storage support"
	default n
	help
	  Enable USB Host Mass Storage support.
```

## action_technology_sdk/thirdparty/lib/awk_map/Kconfig
```kconfig
# Kconfig - awk library

#
# Copyright (c) 2016 Actions Corporation
#
# SPDX-License-Identifier: Apache-2.0
#

config AWK_LIB
	bool
	prompt "Enable awk library"
    default n
    help
    This option enable awk library
	
config AWK_MEM_POOL_SIZE
	int
	prompt "Set memory pool size for awk lib"
	depends on AWK_LIB
	default 153600
	help
	This option set memory pool size for awk lib

config AWK_FAST_MEM_POOL_SIZE
	int
	prompt "Set memory pool size for awk lib"
	depends on AWK_LIB
	default 1894400
	help
	This option set memory pool size for awk lib
```

## action_technology_sdk/thirdparty/lib/gui/lvgl/zephyr/Kconfig
```kconfig
# SPDX-License-Identifier: Apache-2.0

menuconfig LVGL
	bool "Light and Versatile Graphics Library"
	help
	  This option enables the LVGL GUI library.

if LVGL

config APP_LINK_WITH_LVGL
	bool "Link 'app' with LVGL"
	default y
	help
	  Add LVGL header files to the 'app' include path. It may be
	  disabled if the include paths for LVGL are causing aliasing
	  issues for 'app'.

config LV_Z_USE_FILESYSTEM
	bool "Enable file system"
	depends on FILE_SYSTEM
	default y
	help
	  Enable LVGL file system

menu "Rendering Configuration"
	config LV_USE_ACTIONS
		default y

	config LV_USE_DRAW_ACTS2D
		default y if DMA2D_HAL

	config LV_USE_DRAW_VG_LITE
		default y if VG_LITE

	if LV_USE_DRAW_VG_LITE
		config LV_VG_LITE_COMMAND_BUFFER_SIZE
			int "Command buffer size in kilobytes for VG-Lite."
			default 32

		config LV_VG_LITE_USE_GPU_INIT
			default y

		config LV_VG_LITE_FLUSH_MAX_COUNT
			default 4

		config LV_VG_LITE_GRAD_CACHE_CNT
			default 2

		config LV_VG_LITE_STROKE_CACHE_CNT
			default 1

		config LV_VG_LITE_BUFFER_ADDR_START
			default 0x2ff30000 if SOC_SERIES_LEOPARD

		config LV_VG_LITE_BUFFER_ADDR_END
			default 0x3fffffff if SOC_SERIES_LEOPARD

		config LV_USE_VECTOR_GRAPHIC
			default y
	endif #LV_USE_DRAW_VG_LITE

	config LV_DRAW_BUF_ALIGN
		default 64 if LV_USE_DRAW_VG_LITE
endmenu

rsource "../Kconfig"
rsource "Kconfig.memory"

endif #LVGL
```

## action_technology_sdk/thirdparty/lib/gui/lvgl/zephyr/Kconfig.gpu
```kconfig
# SPDX-License-Identifier: Apache-2.0

menu "Rendering Configuration"

config LV_VG_LITE_COMMAND_BUFFER_SIZE
	int "Command buffer size in kilobytes for VG-Lite."
	depends on LV_USE_DRAW_VG_LITE
	default 32

config LV_USE_DRAW_ACTS_DMA2D
	bool "Use Actions' DMA2D GPU"
	depends on DMA2D_HAL
	default y

endmenu
```

## action_technology_sdk/thirdparty/lib/opulinks/Kconfig
```kconfig
config USING_OPULINKS_LIB
	bool
	prompt "Enable using opulinks lib"
    default n
    help
    This option choose opulinks lib
```

## action_technology_sdk/zephyr/boards/arm/ats3085s4_dev_watch_ext_nor/Kconfig.board
```kconfig
# STM32F469I-DISCO board configuration

# Copyright (c) 2016 Linaro Limited.
# SPDX-License-Identifier: Apache-2.0

config BOARD_ATS3085S4_DEV_WATCH_EXT_NOR
	bool "leopard ats3085s 4m psram Development Board"
	depends on SOC_LEOPARD
```

## action_technology_sdk/zephyr/boards/arm/ats3085s4_watch_bootemmc/Kconfig.defconfig
```kconfig
# Copyright (c) 2016 Linaro Limited.
# SPDX-License-Identifier: Apache-2.0

if BOARD_ATS3085S4_WATCH_BOOTEMMC

config BOARD
	default "ats3085s4_watch_bootemmc"

config I2CMT_LEOPARD
    default y

config SPIMT_LEOPARD
    default y

if DISPLAY

config PANEL_ICNA3310B
    default y

endif # DISPLAY

if LOG

config LOG_BUFFER_SIZE
	default 4096

config LOG_DETECT_MISSED_STRDUP
    default n

endif # LOG


if SHELL_DBG

config KERNEL_SHELL
	default y

config DEVICE_SHELL
	default y

config POSIX_CLOCK
	default y

config DATE_SHELL
	default y

config INIT_STACKS
	default y

config THREAD_STACK_INFO
	default y

config THREAD_MONITOR
	default y

config THREAD_NAME
	default y

if GPIO

config GPIO_SHELL
	default y

endif # GPIO

if FILE_SYSTEM

config FILE_SYSTEM_SHELL
	default y

endif # FILE_SYSTEM

if FLASH

config FLASH_SHELL
	default y

endif # FLASH

if FLASH_MAP

config FLASH_MAP_SHELL
	default y

endif # FLASH_MAP

endif # SHELL_DBG

if SPINAND_ACTS
config SPI_HOST
	default 3
endif # SPINAND_ACTS

endif # BOARD_ATS3085S4_WATCH_BOOTEMMC
```

## action_technology_sdk/zephyr/boards/arm/ats3085s_dev_watch_2cs_nor/Kconfig.board
```kconfig
# STM32F469I-DISCO board configuration

# Copyright (c) 2016 Linaro Limited.
# SPDX-License-Identifier: Apache-2.0

config BOARD_ATS3085S_DEV_WATCH_2CS_NOR
	bool "loepard ats3085s 2CS Development Board"
	depends on SOC_LEOPARD
```
