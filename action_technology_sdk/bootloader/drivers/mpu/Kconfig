## action_technology_sdk/framework/base/memory/Kconfig
```kconfig
# Kconfig - Actions memory manager

#
# Copyright (c) 2016 Actions Corporation
#
# SPDX-License-Identifier: Apache-2.0
#

menuconfig MEMORY
        bool
        prompt "Actions Memory Manager Support"
        default y
        help
        This option enables mem manager support

config SYS_MEMORY_DEBUG
        bool
        prompt "sys mem debug"
        default n
        help
        This option sys mem debug enable
choice
	prompt "app Memory Manager Funciton Selection"
	default APP_USED_MEM_POOL
	depends on MEMORY
	help
	  Select Memory Manager Funciton to compile.

config  APP_USED_MEM_POOL
        bool
        prompt "used mem pool as app mem manager"
		depends on MEMORY
        help
        This option enables used mem pool as app mem manager

config APP_USED_MEM_SLAB
        bool
        prompt "used mem slab as app mem manager"
		depends on MEMORY
        help
        This option enables used mem slab as app mem manager

config APP_USED_MEM_PAGE
        bool
        prompt "used mem page/buddy as app mem manager"
        depends on MEMORY
        help
        This option enables used mem page/buddy as app mem manager

endchoice

config  APP_USED_SYSTEM_SLAB
        bool
        prompt "enable app shared system slab"
		depends on MEMORY
        help
        This option enables used system slab as app mem manager

config APP_USED_DYNAMIC_SLAB
        bool
        prompt "used mem dynamic slab , one big slab maybe divided into multiple small slab"
        default n
		depends on APP_USED_MEM_SLAB
		depends on MEMORY
        help
        This option enables used mem dynamic slab , one big slab maybe divided into multiple small slab

config MEM_GUARD
        bool
        prompt "enable mem guard for leak and overwrite"
        default n
        depends on MEMORY
        help
        This option enables detect memory leak
        
config SLAB_TOTAL_NUM
        int
        prompt "total slabs num"
        default 9
		depends on APP_USED_MEM_SLAB
        help
        This option set total slabs num

config SLAB0_BLOCK_SIZE
        int
        prompt "sys SLAB0 block size of per slabs"
        default 8
		depends on APP_USED_MEM_SLAB
        help
        This option set block size of slab0

config SLAB0_NUM_BLOCKS
        int
        prompt "sys SLAB0 num of blocks of per slabs"
        default 32
		depends on APP_USED_MEM_SLAB
        help
        This option set num of blocks of slab0

config SLAB1_BLOCK_SIZE
        int
        prompt "sys SLAB1 block size of per slabs"
        default 16
		depends on APP_USED_MEM_SLAB
        help
        This option set block size of slab1

config SLAB1_NUM_BLOCKS
        int
        prompt "sys SLAB1 num of blocks of per slabs"
        default 11
		depends on APP_USED_MEM_SLAB
        help
        This option set num of blocks of slab1

config SLAB2_BLOCK_SIZE
        int
        prompt "sys SLAB2 block size of per slabs"
        default 32
		depends on APP_USED_MEM_SLAB
        help
        This option set block size of slab2

config SLAB2_NUM_BLOCKS
        int
        prompt "sys SLAB2 num of blocks of per slabs"
        default 60
		depends on APP_USED_MEM_SLAB
        help
        This option set num of blocks of slab2

config SLAB3_BLOCK_SIZE
        int
        prompt "sys SLAB3 block size of per slabs"
        default 64
		depends on APP_USED_MEM_SLAB
        help
        This option set block size of slab3

config SLAB3_NUM_BLOCKS
        int
        prompt "sys SLAB3 num of blocks of per slabs"
        default 12
		depends on APP_USED_MEM_SLAB
        help
        This option set num of blocks of slab3

config SLAB4_BLOCK_SIZE
        int
        prompt "sys SLAB4 block size of per slabs"
        default 128
		depends on APP_USED_MEM_SLAB
        help
        This option set block size of slab4

config SLAB4_NUM_BLOCKS
        int
        prompt "sys SLAB4 num of blocks of per slabs"
        default 4
		depends on APP_USED_MEM_SLAB
        help
        This option set num of blocks of slab4

config SLAB5_BLOCK_SIZE
        int
        prompt "sys SLAB5 block size of per slabs"
        default 256
		depends on APP_USED_MEM_SLAB
        help
        This option set block size of slab5

config SLAB5_NUM_BLOCKS
        int
        prompt "sys SLAB5 num of blocks of per slabs"
        default 9
		depends on APP_USED_MEM_SLAB
        help
        This option set num of blocks of slab5

config SLAB6_BLOCK_SIZE
        int
        prompt "sys SLAB6 block size of per slabs"
        default 512
		depends on APP_USED_MEM_SLAB
        help
        This option set block size of slab6

config SLAB6_NUM_BLOCKS
        int
        prompt "sys SLAB6 num of blocks of per slabs"
        default 7
		depends on APP_USED_MEM_SLAB
        help
        This option set num of blocks of slab6

config SLAB7_BLOCK_SIZE
        int
        prompt "sys SLAB7 block size of per slabs"
        default 1024
		depends on APP_USED_MEM_SLAB
        help
        This option set block size of slab7

config SLAB7_NUM_BLOCKS
        int
        prompt "sys SLAB7 num of blocks of per slabs"
        default 7
		depends on APP_USED_MEM_SLAB
        help
        This option set num of blocks of slab7

config SLAB8_BLOCK_SIZE
        int
        prompt "sys SLAB8 block size of per slabs"
        default 1536
		depends on APP_USED_MEM_SLAB
        help
        This option set block size of slab7

config SLAB8_NUM_BLOCKS
        int
        prompt "sys SLAB8 num of blocks of per slabs"
        default 2
		depends on APP_USED_MEM_SLAB
        help
        This option set num of blocks of slab8


config RAM_POOL_PAGE_NUM
        int
        prompt "sys ram pool page num"
        default 10
        help
        This option set num of ram pool page
```

## action_technology_sdk/framework/base/property/Kconfig
```kconfig
# Kconfig - Actions perperty manager

#
# Copyright (c) 2016 Actions Corporation
#
# SPDX-License-Identifier: Apache-2.0
#
menuconfig PROPERTY
	bool
	prompt "Property"
	default n
	help
	This option enables actions property manager.
	
config PROPERTY_CACHE
	bool
	prompt "property cache"
	depends on PROPERTY
	default n
	help
	This option enables actions property manager.
```

## action_technology_sdk/framework/base/utils/Kconfig
```kconfig
menuconfig ACTIONS_UTILS
    bool
    prompt "Actions Utils Support"
	depends on ACTIONS_FRAMEWORK
    default y
    help
    This option enables the actions test service. 

config ACTS_RING_BUFFER
	bool
	prompt "Actions Ring Buffers Support"
	depends on ACTIONS_UTILS
	default n
	help
	Enable usage of actions ring buffers. This is similar to kernel ring buffer,
	except that it contains a device address and support arbitrary buffer size.
	For optimal performance, use buffer sizes that are a power of 2.
	
config ACTS_EBERGY_STATISTICS
	bool
	prompt "Actions Energy statistics"
	depends on ACTIONS_UTILS
	default n
	help
	Enable usage of actsions Enable actions Energy statistics.

config ACTS_TRANSCODE
	bool
	prompt "Actions Transcode Support"
	depends on ACTIONS_UTILS
	default n
	help
	Enable usage of actsions Enable actions transcode.


rsource "stream/Kconfig"
rsource "iterator/Kconfig"
```

## action_technology_sdk/framework/base/utils/iterator/Kconfig
```kconfig
# Kconfig - Actions iterarator

#
# Copyright (c) 2016 Actions Corporation
#
# SPDX-License-Identifier: Apache-2.0
#

menuconfig ITERATOR
	bool
	prompt "Actions Iterator Support"
	depends on ACTIONS_UTILS
	default n
	help
	  This option enables actions iterator.

config FILE_ITERATOR
	bool
	prompt "File Iterator Support"
	depends on ITERATOR
	select FILE_SYSTEM
	default n
	help
	  This option enables actions file iterator.

config PLIST_SUPPORT_FOLDER_CNT
	int
	prompt "Play list folder count support"
	depends on ITERATOR
	default 100
	help
	  This option set the folder count support by the play list.

config SUPPORT_FILE_FULL_NAME
	bool
	prompt "Play list support file full name"
	depends on ITERATOR
	default n
	help
	  This option enables the file full name support.
```

## action_technology_sdk/framework/base/utils/stream/Kconfig
```kconfig
# Kconfig - Actions stream function

#
# Copyright (c) 2016 Actions Corporation
#
# SPDX-License-Identifier: Apache-2.0
#

menuconfig STREAM
	bool
	depends on ACTIONS_UTILS
	prompt "Actions Stream Support"
	default n
	help
	This option enables actions stream .

config FILE_STREAM
	bool
	prompt "file stream Support"
	depends on STREAM
	select FILE_SYSTEM
	default n
	help
	This option enables actions file stream .

config MULTI_FILE_STREAM
	bool
	prompt "multi file stream Support"
	depends on STREAM
	select FILE_SYSTEM
	default n
	help
	This option enables actions multi file stream .

config LOOP_FSTREAM
	bool
	prompt "loop fstream Support"
	depends on STREAM
	select FILE_SYSTEM
	default n
	help
	This option enables actions loop fstream .

config BUFFER_STREAM
	bool
	prompt "buffer stream Support"
	depends on STREAM
	default n
	help
	This option enables actions buffer stream .

config RINGBUFF_STREAM
	bool
	prompt "buffer stream Support"
	depends on STREAM
	select ACTS_RING_BUFFER
	default n
	help
	This option enables actions buffer stream .

config PSRAM_STREAM
	bool
	prompt "Psram Stream Support"
	depends on STREAM
	default n
	help
	This option enables actions Psram stream .

config CLONE_STREAM
	bool
	prompt "clone stream Support"
	depends on STREAM
	default n
	help
	This option enables actions clone stream .

config ZERO_STREAM
	bool
	prompt "zero stream Support"
	depends on STREAM
	default n
	help
	This option enables actions zero stream .
```

## action_technology_sdk/framework/display/compression/Kconfig
```kconfig
# Kconfig - Actions memory manager

#
# Copyright (c) 2016 Actions Corporation
#
# SPDX-License-Identifier: Apache-2.0
#

config TILE_CACHE_NUM
	int "Number of tile cache"
	default 1
	help
	  This option specifies the Number of tile cache.

config TILE_MAX_W
	int "max width of tiles (pixels)"
	default 32
	help
	  This option specifies the max width of tiles(pixels).


config TILE_MAX_H
	int "max height of tiles (pixels)"
	default 32
	help
	  This option specifies the max height of tiles(pixels).


config TILE_BYTES_PER_PIXELS
	int "bytes per pixels (pixels)"
	default 4
	help
	  This option specifies the bytes per pixels(pixels).
```

## action_technology_sdk/framework/display/font/Kconfig
```kconfig
# Kconfig - Actions font manager

#
# Copyright (c) 2016 Actions Corporation
#
# SPDX-License-Identifier: Apache-2.0
#

config BITMAP_FONT_CACHE_POOL_SIZE
	int "cache pool size for all fonts"
	default 368640
	help
	   This option set cache size for each font size

config EMOJI_FONT_USE_MMAP
	bool "enable mmap on emoji font"
	default false
	help
	   This option enable mmap emoji font to save cache space	

config BITMAP_FONT
	bool "bitmap font library"
	help
	  This option enables the bitmap font library.

if BITMAP_FONT

config BITMAP_FONT_USE_HIGH_FREQ_CACHE
	bool "bitmap font high freq cache"
	help
	  This option enables bitmap font high freqency cache.

config BITMAP_FONT_HIGH_FREQ_CACHE_SIZE
	int "high freq char cache size"
	default 1536000
	help
	   This option set max font cache size for high freq Hanzi chars

config BITMAP_PER_FONT_CACHE_SIZE
	int "cache size per font size"
	default 65536
	help
	   This option set cache size for each font size

config BITMAP_FONT_MAX_OPENED_FONT
	int "max fonts can be opened"
	default 2
	help
	  This option set max num of opened fonts

config BITMAP_FONT_SUPPORT_EMOJI
	bool "bitmap font emoji support"
	help
	  This option enables bitmap font emoji support.	  
endif # BITMAP_FONT

config FREETYPE_FONT
	bool "freetype font library"
	help
	  This option enables the freetype font library.

if FREETYPE_FONT

config FREETYPE_MEM_POOL_USER
	bool "freetype use mem pool"
	help
	  This option enables the freetype mem pool.

config FREETYPE_FONT_MAX_FACES
	int "freetype max faces can be opened"
	default 2
	help
		This option set max faces can be opened
		
config FREETYPE_FONT_MAX_SIZES
	int "freetype max sizes can be opened"
	default 5
	help
		This option set max sizes can be opened

config FREETYPE_FONT_ENABLE_MEMORY_FACE
	bool "freetype enable memory face"
	help
	  This option enables freetype to open memory face.

config FREETYPE_FONT_BITMAP_BPP
	int "final bpp of rendered glyph"
	default 2
	help
	  This option set final bpp of rendered glyph
	  
config FREETYPE_PER_FONT_CACHE_SIZE
	int "cache size per font size"
	default 65536
	help
	   This option set cache size for each font size

	  
config FREETYPE_FONT_MAX_SUBCACHE_BYTES
	int "freetype max bytes can be used in freetype cache"
	default 5
	help
		This option set max btyes can be used in freetype cache

config FREETYPE_FONT_ENABLE_SVG_PATH
	bool "enable svg path optimization"
	default n
	help
		This option enalbe svg path optimization

config FREETYPE_SHAPE_INFO_CACHE_SIZE
	int "shape info cache size"
	default 4096
	help
		This option set shape info cache size

config FREETYPE_FONT_SHAPE_CACHE_SIZE
	int "shape cache size"
	default 120000
	help
	This option set shape cache size
endif # FREETYPE_FONT
```

## action_technology_sdk/framework/display/lvgl/Kconfig
```kconfig
# SPDX-License-Identifier: Apache-2.0

if LVGL

config LVGL_USE_RES_MANAGER
	bool "Enable resource attributes conversion"
	default y
	depends on RES_MANAGER
	help
	  Enable resource atributes conversion

config LVGL_RES_PRELOAD_PRIORITY
	int "Res Preload Thread Prioriy"
	default 5
	depends on LVGL_USE_RES_MANAGER
	help
	This option set res preload thread priority

config LVGL_RES_PRELOAD_STACKSIZE
	int "Res Preload Thread Stack Size"
	default 1536
	depends on LVGL_USE_RES_MANAGER
	help
	This option set stack size for res preload thread

config LVGL_USE_BITMAP_FONT
	bool "Enable bitmap fonts"
	default y
	depends on BITMAP_FONT
	help
	  Enable bitmap font support

config LVGL_USE_FREETYPE_FONT
	bool "Enable freetype fonts"
	default y
	depends on FREETYPE_FONT
	help
	  Enable freetype font support

config LVGL_USE_IMG_DECODER_ACTS_RES
	bool "Enable Actions image res decoder"
	help
	  Enable Actions image res decoder

endif # LVGL
```

## action_technology_sdk/framework/display/vg_lite/Kconfig
```kconfig
#
# Copyright (c) 2016 Actions Corporation
#
# SPDX-License-Identifier: Apache-2.0
#

if VG_LITE

choice
	prompt "Memory pool"
	default VG_LITE_MALLOC_GUI_HEAP
	help
	  Memory pool to use for lvgl allocated objects

	config VG_LITE_MALLOC_GUI_HEAP
		bool "UI GUI heap"
		depends on UI_MEMORY_MANAGER && (UI_GUI_MEM_POOL_SIZE != 0)
		help
		  Use UI Manager GUI heap

	config VG_LITE_MALLOC_SYS_HEAP
		bool "User space private pool"
		help
		  Use a dedicated memory pool from a private sys heap.

	config VG_LITE_MALLOC_LIBC
		bool "Use libc allocation"
		help
		  Use libc allocation.

endchoice

if VG_LITE_MALLOC_SYS_HEAP

config VG_LITE_MALLOC_HEAP_SIZE
	int "VG-Lite malloc heap size (in bytes)"
	default 2048
	help
	  This option specifies the size of the VG-Lite malloc heap.
	  A size of zero means that no VG-Lite heap is defined.

endif

endif # VG_LITE
```
