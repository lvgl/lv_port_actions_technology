## action_technology_sdk/bootloader/drivers/mpu/Kconfig
```kconfig
# Kconfig - DSP device configuration options
#
#
# Copyright (c) 2018 Actions Semiconductor Co., Ltd
#
# SPDX-License-Identifier: Apache-2.0
#

#
# MPU options
#

config MPU_ACTS
	bool "Memory protect unit for Actions SoC"
	default n
	help
	enable actions mpu
	
choice
    prompt "mpu driven select"
    default MPU_EXCEPTION_DRIVEN
    help
      Select mpu driven 
	
config MPU_IRQ_DRIVEN
    bool    
    prompt "use mpu interrupt driven"
    depends on MPU_ACTS
    help
    This option select mpu driven type
    
config MPU_EXCEPTION_DRIVEN
    bool    
    prompt "use mpu exception driven"
    depends on MPU_ACTS
    help
    This option select mpu driven type    	
endchoice


config MPU_MONITOR_CACHECODE_WRITE
    bool    
    prompt "use mpu monitor cache code write"
    depends on MPU_ACTS
    default y
    help
    This option enables mpu monitor cache code write 

config MPU_MONITOR_FLASH_AREA_WRITE
    bool    
    prompt "use mpu monitor nor flash cache address write"
    depends on !MPU_MONITOR_CACHECODE_WRITE
    default n
    help
    This option enables nor flash address  write

config MPU_MONITOR_FLASH_AREA_BASE
    hex    
    prompt "use mpu monitor nor flash area write base address"
    depends on MPU_MONITOR_FLASH_AREA_WRITE
    default 0x10000000
    help
    This option set mpu monitor nor flash area write base address
config MPU_MONITOR_FLASH_AREA_END
    hex    
    prompt "use mpu monitor nor flash area write end address"
    depends on MPU_MONITOR_FLASH_AREA_WRITE
    default 0x18000000
    help
    This option set mpu monitor nor flash area write end address
     
    
config MPU_MONITOR_RAMFUNC_WRITE
    bool    
    prompt "use mpu monitor ramfunc write"
    depends on MPU_ACTS
    default y
    help
    This option enables mpu monitor ramfunc write     


config MPU_MONITOR_USER_DATA
    bool    
    prompt "use mpu monitor user data"
    depends on MPU_ACTS
    default y
    help
    This option enables mpu monitor dsp write mcu memory 
           
config MPU_MONITOR_ROMFUNC_WRITE
    bool    
    prompt "use mpu monitor rom func write"
    depends on MPU_ACTS
    default n
    help
    This option enables mpu monitor rom func write     
    
config MPU_ACTS_MAX_INDEX
    int    
    prompt "mpu max entry index"
    depends on MPU_ACTS
    default 4
    help
    This option select mpu monitor bt controller memory index     


config MPU_MONITOR_CACHECODE_WRITE_INDEX
    int    
    prompt "use mpu monitor cache code write index"
    depends on MPU_MONITOR_CACHECODE_WRITE || MPU_MONITOR_FLASH_AREA_WRITE
    default 0
    help
    This option select mpu monitor cache code write index 
    
config MPU_MONITOR_RAMFUNC_WRITE_INDEX
    int    
    prompt "use mpu monitor ramfunc write"
    depends on MPU_MONITOR_RAMFUNC_WRITE
    default 1
    help
    This option select mpu monitor ramfunc write index    

    
config MPU_MONITOR_USER_DATA_INDEX
    int    
    prompt "use mpu monitor user data memory index"
    depends on MPU_ACTS
    default 3
    help
    This option select mpu monitor user data memory index    
    
config MPU_MONITOR_ROMFUNC_WRITE_INDEX
    int    
    prompt "use mpu monitor rom func write index"
    depends on MPU_MONITOR_ROMFUNC_WRITE
    default 2
    help
    This option select mpu monitor rom func write index       

                                              
```

## action_technology_sdk/bootloader/drivers/pwm/Kconfig
```kconfig
# Kconfig - PWM configuration options

#
# Copyright (c) 2015 Intel Corporation
#
# SPDX-License-Identifier: Apache-2.0
#

menuconfig PWM
	bool
	prompt "PWM device drivers"
	default n
	help
	  Enable input device driver configuration

if PWM
config LOG_PWM_DEV_LEVEL
	int
	prompt "INPUT Device drivers log level"
	range 0 4
	default 0
	help
	  Sets log level for PWM Device driver.

	  Levels are:
	  - 0 OFF, do not write
	  - 1 ERROR, only write SYS_LOG_ERR
	  - 2 WARNING, write SYS_LOG_WRN in addition to previous level
	  - 3 INFO, write SYS_LOG_INF in addition to previous levels
	  - 4 DEBUG, write SYS_LOG_DBG in addition to previous levels

config PWM_ACTS
	bool "Actions SoC PWM driver"
	default n
	help
	  Enable support for Actions PWM driver.

endif # PWM
```

## action_technology_sdk/bootloader/drivers/spinand/Kconfig.acts
```kconfig
# Copyright (c) 2018 Intel Corporation
# SPDX-License-Identifier: Apache-2.0


menuconfig SPINAND_ACTS
	bool "actions SPINand flash driver"
	select FLASH_HAS_DRIVER_ENABLED
	help
	  Enable support for actions SPINand flash driver

config SPI_HOST
	int "Switch spi host for spinand"
	default 3
	range 0 3
	help
	  Select spi host for spinand

config SPINAND_LIB
	bool "actions SPINand flash driver for soc lark."
	select FLASH_HAS_DRIVER_ENABLED
	help
	  Enable support for actions SPINand flash driver
```

## action_technology_sdk/bootloader/framework/Kconfig
```kconfig
# drivers configuration options

# Copyright (c) 2020 Actions Corporation
# SPDX-License-Identifier: Apache-2.0

menu "Framework Porting Drivers"
rsource "key/Kconfig"
rsource "osal/Kconfig"
rsource "dma2d/Kconfig"
rsource "display/Kconfig"
rsource "memory/Kconfig"
rsource "misc/Kconfig"
endmenu
```

## action_technology_sdk/bootloader/framework/display/Kconfig
```kconfig
# Configuration options for Actions OSAL

# Copyright (c) 2020 Actions Technology Co., Ltd
# SPDX-License-Identifier: Apache-2.0

if DISPLAY

menuconfig DISPLAY_COMPOSER
	bool "Display Composer"
	default y if UI_SERVICE
	help
	  Enable Display composer

if DISPLAY_COMPOSER

config DISPLAY_COMPOSER_DEBUG_FPS
	bool "Debug Post Frame Rate (fps) in Display Composer"
	default y
	help
	  Debug post frame rate (fps) in Display Composer

config DISPLAY_COMPOSER_DEBUG_VSYNC
	bool "Debug VSYNC/TE Signal Period in Display Composer"
	default y
	help
	  Debug VSYNC/TE signal period in Display Composer

endif # DISPLAY_COMPOSER

config GUI_API_BROM
	bool "ROM GUI api"
	default y if SOC_LARK_FPGA || SOC_LARK
	help
	  Enable ROM GUI api

config UI_DMA_MEMSETCPY
	bool "DMA accelerated memset/memcpy for UI"
	default y if SOC_LARK_FPGA || SOC_LARK
	help
	  Enable DMA accelerated memset/memcpy for UI

endif # DISPLAY
```

## action_technology_sdk/bootloader/framework/osal/Kconfig
```kconfig
# Configuration options for Actions OSAL

# Copyright (c) 2020 Actions Technology Co., Ltd
# SPDX-License-Identifier: Apache-2.0

menuconfig OSAL
	bool "OS Hal"
	default n
	help
	  Enable OS Hal

if OSAL

config USER_WORK_Q
	bool "support user work queue"
	help
	  This option support user work queue

config USER_WORK_Q_PRIORITY
	int "user work queue priority"
	default -11
	depends on USER_WORK_Q
	help
	  This option user work queue priority

config USER_WORK_Q_STACK_SIZE
	int "user work queue stack size"
	default 1024
	depends on USER_WORK_Q
	help
	  This option user work queue stack size

config DISPLAY_WORK_Q
	bool "support display work queue"
	help
	  This option support display work queue

config DISPLAY_WORK_Q_PRIORITY
	int "display work queue priority"
	default -12
	depends on DISPLAY_WORK_Q
	help
	  This option display work queue priority

config DISPLAY_WORK_Q_STACK_SIZE
	int "display work queue stack size"
	default 1024
	depends on DISPLAY_WORK_Q
	help
	  This option display work queue stack size

endif # OSAL
```

## action_technology_sdk/bootloader/lib/rbuf/Kconfig
```kconfig
# Copyright (c) 2018 Nordic Semiconductor
# SPDX-License-Identifier: Apache-2.0

config RBUF_LIB
	bool "rbuf lib Support"
	help
	  This option enables the rbuf library
```

## action_technology_sdk/bootloader/soc/arm/actions/Kconfig.defconfig
```kconfig
# SPDX-License-Identifier: Apache-2.0

source "soc/arm/actions/*/Kconfig.defconfig.series"
```

## action_technology_sdk/bootloader/soc/arm/actions/leopard/Kconfig.defconfig.series
```kconfig
# Copyright (c) 2016 Linaro Limited
# SPDX-License-Identifier: Apache-2.0

# Kconfig symbols common to leopard  series

if SOC_SERIES_LEOPARD

source "soc/arm/actions/leopard/Kconfig.defconfig.leopard*"

config SOC_SERIES
	default "leopard"

#config CORTEX_M_SYSTICK
#	bool
#	default y

config HOSC_CLK_MHZ
	int "HOSC Clock (MHz)"

DT_CHOSEN_Z_PSRAM := zephyr,psram

config PSRAM_SIZE
	int "PSRAM Size in kB"
	default $(dt_chosen_reg_size_int,$(DT_CHOSEN_Z_PSRAM),0,K)
	help
	  The PSRAM size in kB. The default value comes from /chosen/zephyr,sram in
	  devicetree. The user should generally avoid changing it via menuconfig or
	  in configuration files.

config PSRAM_BASE_ADDRESS
	hex "PSRAM Base Address"
	default $(dt_chosen_reg_addr_hex,$(DT_CHOSEN_Z_PSRAM))
	help
	  The PSRAM base address. The default value comes from from
	  /chosen/zephyr,psram in devicetree. The user should generally avoid
	  changing it via menuconfig or in configuration files.

endif # SOC_SERIES_LEOPARD
```

## action_technology_sdk/bootloader/soc/arm/actions/leopard/Kconfig.soc
```kconfig
# Copyright (c) 2016 Linaro Limited.
# SPDX-License-Identifier: Apache-2.0

choice
	prompt "LEOPARD MCU Selection"
	depends on SOC_SERIES_LEOPARD

config SOC_LEOPARD
	bool "LEOPARD"

endchoice

if SOC_LEOPARD

config SOC_SPI0_USE_CK64M
	bool
	prompt "enable cpu spi0 to use CK64M clock source"
	default y
	help
		enable cpu spi0 to use CK64M clock source

config IRQ_VECTOR_IN_SRAM
	bool
	prompt "enable irq vector copy to sram"
	default n
	help
		enable irq vector copy to sram

config SLEEP_FUNC_IN_SRAM
	bool
	prompt "enable sleep func copy to sram"
	default y
	help
		enable sleep func copy to sram

config SOC_EP_MODE
	bool
	prompt "indicate ep mode"
	default n
	help
		ebable indicate ep mode

config SOC_NO_PSRAM
	bool
	prompt "indicate soc not integrate psram"
	default n
	help
		prompt  "indicate soc not integrate psram"
config SOC_SIGN_ENABLE
	bool
	prompt "signature verification eanble"
	default n
	help
		signature verification eanble


config SPI0CAHE_PSRAM
	bool
	prompt "SPI0CACHE MAP TO PSRAM"
	default n
	help
		spi0 cache map to psram

endif
```

## action_technology_sdk/bootloader/subsys/trace/Kconfig
```kconfig
config ACTIONS_PRINTK_DMA
	bool "printk use uart dma transfer"
	depends on !LOG_PRINTK
	select UART_DMA_DRIVEN
	default n
	help
		printk use uart dma transfer.

config PRINTK_DMA_FULL_LOST
	bool "printk lost if dma buf full"
	depends on ACTIONS_PRINTK_DMA
	default y
	help
		printk lost if dma buf full.


config PRINTK_TIME_FREFIX
	bool "printk add time prefix"
	depends on ACTIONS_PRINTK_DMA
	default n
	help
		printk add time prefix.

config KERNEL_SHOW_STACK
	bool "support show stack"
	default n
	help
		support show stack and crash show stack.

config DMA_PRINTK_BUF_SIZE
	int "Printk dma buffer size"
	default 4096
	help
	    Printk dma buffer size.
```

## action_technology_sdk/framework/base/Kconfig
```kconfig
#
# Copyright (c) 2020 Actions Semiconductor
#
# SPDX-License-Identifier: LicenseRef-BSD-5-Clause-Actions
#

menu "Actions framework"

config ACTIONS_FRAMEWORK
	bool
	prompt "actions framework"
	default n
	select LEGACY_TIMEOUT_API
	select OSAL
	help
	This option enable or disable actions framework

rsource "core/Kconfig"
rsource "utils/Kconfig"
rsource "property/Kconfig"
rsource "memory/Kconfig"
endmenu
```

## action_technology_sdk/framework/base/core/Kconfig
```kconfig
# Kconfig - Actions system manager

#
# Copyright (c) 2016 Actions Corporation
#
# SPDX-License-Identifier: Apache-2.0
#

menuconfig CORE
	bool
	prompt "Core"
	default n
	select APP_MANAGER
	select SRV_MANAGER
	select MSG_MANAGER
	help
	This option enables actions system manager.

config APP_MANAGER
	bool
	prompt "App Manager Support"
	depends on CORE
	default n
	help
	This option enables actions app manager.

config SRV_MANAGER
	bool
	prompt "Server Manager Support"
	depends on CORE
	default n
	help
	This option enables actions server manager.

config MSG_MANAGER
	bool
	prompt "Message Manager Support"
	depends on CORE
	default n
	help
	This option enables actions message manager.

config MESSAGE_DEBUG
	bool "Debug Message Support"
	depends on MSG_MANAGER
	help
	  This option enable message debug support.
```
