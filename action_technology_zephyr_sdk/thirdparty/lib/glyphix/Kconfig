## action_technology_zephyr_sdk/zephyr/drivers/input/tpkey/Kconfig
```kconfig
# Configuration options for Actions INPUT YP DRIVERS

# Copyright (c) 2020 Actions Technology Co., Ltd
# SPDX-License-Identifier: Apache-2.0

if INPUT_DEV_ACTS_TP_KEY

config INPUT_DEV_ACTS_CST816S_TP_KEY
	bool "Actions SoC TP key driver"
	default n
	help
	  Enable support for Actions SoC TP key driver.

config INPUT_DEV_ACTS_CST816S_COB_TP_KEY
	bool "Actions SoC TP key driver"
	default n
	help
	  Enable support for Actions SoC TP key driver.

config INPUT_DEV_ACTS_CST820_TP_KEY
	bool "Actions SoC TP key driver"
	default n
	help
	  Enable support for Actions SoC TP key driver.

config INPUT_DEV_ACTS_IT7259_TP_KEY
	bool "Actions SoC TP key driver"
	default n
	help
	  Enable support for Actions SoC TP key driver.

config INPUT_DEV_ACTS_FT5X0X_TP_KEY
	bool "Actions SoC TP key driver"
	default n
	help
	  Enable support for Actions SoC TP key driver.

config INPUT_DEV_ACTS_FT3169_TP_KEY
	bool "FocalTech FT3169 TP key driver"
	default n
	help
	  Enable support for FocalTech FT3169 TP key driver.
config INPUT_DEV_ACTS_FT3168_TP_KEY
	bool "FocalTech FT3168 TP key driver"
	default n
	help
	  Enable support for FocalTech FT3168 TP key driver.

config INPUT_DEV_ACTS_ZTW622_TP_KEY
	bool "FocalTech ZTW622 TP key driver"
	help
	  Enable support for FocalTech ZTW622 TP key driver.

config INPUT_DEV_ACTS_TEST_FPS_FAKE_TP
	bool "Test fps fake tp"
	default y
	help
	  Enable support for test fps fake tp.

endif # INPUT_DEV_ACTS_TP_KEY
```

## action_technology_zephyr_sdk/zephyr/drivers/led/Kconfig
```kconfig
# Configuration options for Actions Display Accelerator

# Copyright (c) 2020 Actions Technology Co., Ltd
# SPDX-License-Identifier: Apache-2.0
config ACT_LED
	bool "led display"
	default n
	help
	  Enable led display

config ACT_DYNAMIC_LED
	bool "led display"
	default n
	help
	  Enable led display
```

## action_technology_zephyr_sdk/zephyr/drivers/mmc/Kconfig.acts
```kconfig
# Copyright (c) 2018 Intel Corporation
# SPDX-License-Identifier: Apache-2.0


if MMC

config MMC_SDCARD
	bool "Support SD Card"
	default n
	help
	  Enable support for SD Card.

config MMC_SDIO
	bool "SDIO driver"
	default n
	help
	  Enable support for SDIO.

config MMC_ACTS
	bool "Actions SoC MMC driver"
	default n
	help
	  Enable MMC Controller of Actions SoC

config SD_USE_IOVCC1_POWER
	bool "sdmmc use IOVCC1 as power"
	default n
	help
	  Enable IOVCC1 as sdmmc power

config SD_IDLE_SLEEP_MS
	int "idle appointed time, then sleep"
	default 6000
	help
	  If mmc keeps time(ms) in not read or not written state, go to sleep.

endif
```

## action_technology_zephyr_sdk/zephyr/drivers/power_supply/Kconfig
```kconfig
# Kconfig - Power supply configuration options
#
#
# Copyright (c) 2021 Actions Semiconductor Co., Ltd
#
# SPDX-License-Identifier: Apache-2.0
#

menuconfig POWER_SUPPLY
    bool
    prompt "Power supply drivers"
    default n
    help
      Enable power supply drivers configuration

if POWER_SUPPLY

config POWER_SUPPLY_ACTS_BATTERY
    bool "Actions SoC battery power supply driver"
    depends on SOC_FAMILY_ACTS
    default n
    help
      Enable support for Actions SoC battery driver.

choice
    prompt "Actsion Soc battery power supply methods"
    depends on POWER_SUPPLY_ACTS_BATTERY
    help
        This option will select the different methods for the battery power supply.

config ACTS_LARK_BATTERY_SUPPLY_INTERNAL
    bool "lark battery supplied by internal charger"
    help
        Support battery power supplied by internal charger.

config ACTS_LARK_BATTERY_SUPPLY_EXTERNAL
    bool "lark battery supplied by external charger"
    help
        Support battery power supplied by external charger.

config ACTS_LEOPARD_BATTERY_SUPPLY_INTERNAL
    bool "leopard battery supplied by internal charger"
    help
        Support battery power supplied by internal charger.

config ACTS_LEOPARD_BATTERY_SUPPLY_EXTERNAL
    bool "leopard battery supplied by external charger"
    help
        Support battery power supplied by external charger.

endchoice

config ACTS_BATTERY_SUPPLY_CHARGER_BOX
    bool "battery supplied by the charger box"
    depends on ACTS_LARK_BATTERY_SUPPLY_INTERNAL
    help
        Support battery power supplied by charger box.

config ACTS_BATTERY_SUPPLY_EXT_COULOMETER
    bool "battery measure by external coulometer"
    depends on ACTS_LARK_BATTERY_SUPPLY_EXTERNAL || ACTS_LEOPARD_BATTERY_SUPPLY_EXTERNAL
    help
        Support bettery power measured by external coulometer.

config ACTS_BATTERY_SUPPORT_CHARGER_NTC
    bool "battery support NTC temperature detect"
    depends on ACTS_LARK_BATTERY_SUPPLY_INTERNAL || ACTS_LEOPARD_BATTERY_SUPPLY_INTERNAL
	default n
    help
        Support battery temperature detect.
		
config ACTS_BATTERY_SUPPORT_INIT_CHARGER_NTC
    bool "battery support init charge stage NTC temperature detect"
    depends on ACTS_LARK_BATTERY_SUPPLY_INTERNAL && ACTS_BATTERY_SUPPORT_CHARGER_NTC
	default n
    help
        Support battery init charge stage temperature detect.

config ACTS_BATTERY_SUPPORT_MINI_CHARGER_NTC
    bool "battery support mini charge stage NTC temperature detect"
    depends on (ACTS_LEOPARD_BATTERY_SUPPLY_INTERNAL && ACTS_BATTERY_SUPPORT_CHARGER_NTC) || ACTS_LEOPARD_BATTERY_SUPPLY_EXTERNAL
	default n
    help
        Support battery mini charge stage temperature detect.

config ACTS_BATTERY_SUPPORT_FAST_CHARGER
    bool "battery support fast charge function"
    depends on ACTS_LARK_BATTERY_SUPPLY_INTERNAL || ACTS_LEOPARD_BATTERY_SUPPLY_INTERNAL
	default n
    help
        Support battery fast charge.
		
config ACTS_BATTERY_POWERON_MIN_VOL_WITHOUT_DC5V
    int "power on min voltage setting"
    depends on ACTS_LARK_BATTERY_SUPPLY_INTERNAL || ACTS_LEOPARD_BATTERY_SUPPLY_INTERNAL || ACTS_LEOPARD_BATTERY_SUPPLY_EXTERNAL
	default 3300 if ACTS_LARK_BATTERY_SUPPLY_INTERNAL
	default 3600 if ACTS_LEOPARD_BATTERY_SUPPLY_INTERNAL
	default 3600 if ACTS_LEOPARD_BATTERY_SUPPLY_EXTERNAL
    help
        Set power on min voltage when not plug dc5v .	

config ACTS_BATTERY_SYSTEM_CONSUME_MA
    int "default system consume current"
    depends on ACTS_LARK_BATTERY_SUPPLY_INTERNAL || ACTS_LEOPARD_BATTERY_SUPPLY_INTERNAL
	default 10
    help
        Set default value for system consume current .	
		
config ACTS_BATTERY_WAKEUP_PERIOD_MINUTE
    int "default wakeup period for sample batadc"
    depends on ACTS_LARK_BATTERY_SUPPLY_INTERNAL || ACTS_LEOPARD_BATTERY_SUPPLY_INTERNAL
	default 10
    help
        Set default value for wakeup period for sample batadc .			

config ACTS_BATTERY_DRIVER_SHELL
    bool "ext battery charger support shell"
    depends on ACTS_LEOPARD_BATTERY_SUPPLY_INTERNAL || ACTS_LARK_BATTERY_SUPPLY_EXTERNAL || ACTS_LEOPARD_BATTERY_SUPPLY_EXTERNAL
	default y
    help
        Support extern charger driver use shell .		

endif # POWER_SUPPLY
```

## action_technology_zephyr_sdk/zephyr/drivers/se/Kconfig
```kconfig
# Kconfig - SE configuration options

#
# Copyright (c) 2015 Intel Corporation
#
# SPDX-License-Identifier: Apache-2.0
#

menuconfig SE
	bool "SE device drivers"
	default n
	help
	  Enable input device driver configuration

if SE
config LOG_SE_DEV_LEVEL
	int
	prompt "INPUT Device drivers log level"
	range 0 4
	default 0
	help
	  Sets log level for PWM Device driver.

	  Levels are:
	  - 0 OFF, do not write
	  - 1 ERROR, only write SYS_LOG_ERR
	  - 2 WARNING, write SYS_LOG_WRN in addition to previous level
	  - 3 INFO, write SYS_LOG_INF in addition to previous levels
	  - 4 DEBUG, write SYS_LOG_DBG in addition to previous levels

config AES_ACTS
	bool "Actions hardware aes"
	default n
	help
	  Enable support for Actions hardware aes.

config SHA_ACTS
	bool "Actions hardware sha"
	default n
	help
	  Enable support for Actions hardware sha.

if AES_ACTS
	config AES_DMA
	bool "AES encrypt by dma"
	default n
	help
	  Enable DMA for hardware aes.
endif # AES_ACTS

config CRC_ACTS
	bool "Actions hardware crc"
	default n
	help
	  Enable support for Actions hardware crc.

if SHA_ACTS
	config LOG_SHA_LEVEL
	int "SHA log level"
	default 3
	help
	  LOG level for SHA.

	config SHA_CACHE_NSEG
	int "SHA cache N segments"
	default 16
	help
	  Segments for SHA cache.

endif # LOG_SHA_LEVEL

endif # SE
```

## action_technology_zephyr_sdk/zephyr/drivers/serial/Kconfig.acts
```kconfig
menuconfig UART_ACTS
	bool "Actions SoC UART driver"
	default n
	select SERIAL_HAS_DRIVER
	select SERIAL_SUPPORT_INTERRUPT
	depends on SOC_FAMILY_ACTS
	help
	  This option enables the Actions SoC UART driver.
	  
config UART_DMA_DRIVEN
    bool
    prompt "Enable UART DMA support"
    default n
    depends on UART_ACTS
    help
    This option enables dma support for UART allowing console
    input and other UART based drivers.	 
    
config UART_DMA_TX_DRIVEN
    bool
    prompt "Enable UART DMA tx support"
    default n
    depends on UART_ACTS
    help
    This option enables tx dma support for UART allowing console
    input and other UART based drivers.       

config UART_DMA_RX_DRIVEN
    bool
    prompt "Enable UART DMA rx support"
    default n
    depends on UART_ACTS
    help
    This option enables rx dma support for UART allowing console
    input and other UART based drivers. 

config UART_STUB_BAUD_RATE
	int "uart stub Baud Rate"
	default 6000000
	depends on STUB_DEV_UART
	help
	  The baud rate for uart stub.

# ---------- Port 0 ----------

menuconfig UART_ACTS_PORT_0
	bool "Enable Actions SoC UART Port 0"
	default n
	depends on UART_ACTS
	help
	  This tells the driver to configure the UART port at boot, depending on
	  the additional configure options below.

config UART_ACTS_PORT_0_NAME
	string "Port 0 Device Name"
	default "UART_0"
	depends on UART_ACTS_PORT_0
	help
	  This is the device name for UART, and is included in the device
	  struct. 

config UART_ACTS_PORT_0_BAUD_RATE
	int "Port 0 Baud Rate"
	range 1200 6000000
	default 3000000
	depends on UART_ACTS_PORT_0
	help
	  The baud rate for UART port to be set to at boot.

	  Leave at 0 to skip initialization.

config UART_ACTS_PORT_0_IRQ_PRIORITY
	int "Port 0 Interrupt Priority"
	default 1
	depends on UART_ACTS_PORT_0
	help
	  Port 0 Interrupt Priority

config UART_ACTS_PORT_0_PRIORITY
	int "Port 0 Init priority"
	default 20
	depends on UART_ACTS_PORT_0
	help
	  Port 0 device driver initialization priority.
	    	  

# ---------- Port 1 ----------

menuconfig UART_ACTS_PORT_1
	bool "Enable Actions SoC UART Port 1"
	default n
	depends on UART_ACTS
	help
	  This tells the driver to configure the UART port at boot, depending on
	  the additional configure options below.

config UART_ACTS_PORT_1_NAME
	string "Port 1 Device Name"
	default "UART_1"
	depends on UART_ACTS_PORT_1
	help
	  This is the device name for UART, and is included in the device
	  struct. 

config UART_ACTS_PORT_1_BAUD_RATE
	int "Port 1 Baud Rate"
	default 115200
	depends on UART_ACTS_PORT_1
	help
	  The baud rate for UART port to be set to at boot.

	  Leave at 0 to skip initialization.

config UART_ACTS_PORT_1_IRQ_PRIORITY
	int "Port 1 Interrupt Priority"
	default 1
	depends on UART_ACTS_PORT_1
	help
	  Port 1 Interrupt Priority

config UART_ACTS_PORT_1_PRIORITY
	int "Port 1 Init priority"
	default 20
	depends on UART_ACTS_PORT_1
	help
	  Port 1 device driver initialization priority.
```

## action_technology_zephyr_sdk/zephyr/drivers/spi/Kconfig.acts
```kconfig
# Copyright (c) 2018 Intel Corporation
# SPDX-License-Identifier: Apache-2.0


menuconfig SPI_ACTS
	bool "actions SPI driver"
	help
	  Enable support for actions SPI driver

menuconfig SPIMT_ACTS
	bool "actions SPIMT driver"
	select RBUF_LIB
	help
	  Enable support for actions SPIMT driver

if SPIMT_ACTS

config SPIMT_LARK
	bool "SPIMT driver on SoC Lark"
	default n
	depends on SOC_SERIES_LARK
	help
	  Enable SPIMT driver on SoC Lark

config SPIMT_LEOPARD
	bool "SPIMT driver on SoC Leopard"
	default y
	depends on SOC_SERIES_LEOPARD
	help
	  Enable SPIMT driver on SoC Leopard

endif # SPIMT_ACTS
```

## action_technology_zephyr_sdk/zephyr/drivers/usb/otg/Kconfig
```kconfig
# Kconfig - USB otg configuration options

#
# Copyright (c) 2020 Actions Corporation.
#
# SPDX-License-Identifier: Apache-2.0
#

config USB_DEVICE_DRIVER
	bool
	prompt "USB device driver"
	select USB_DEVICE_STACK
	default n

config SYS_LOG_USB_OTG_DRIVER_LEVEL
	int
	prompt "USB otg driver log level"
	depends on LOG
	default 0
	help
	  Sets log level for USB otg driver

	  Levels are:

	  - 0 OFF, do not write

	  - 1 ERROR, only write SYS_LOG_ERR

	  - 2 WARNING, write SYS_LOG_WRN in addition to previous level

	  - 3 INFO, write SYS_LOG_INF in addition to previous levels

	  - 4 DEBUG, write SYS_LOG_DBG in addition to previous levels

config USB_AOTG_OTG
	bool
	prompt "Actions OTG USB otg Controller Driver"
	depends on USB_DEVICE || USB_HOST
	default n
	help
	  Actions OTG USB otg Controller Driver.

if USB_AOTG_OTG

config USB_AOTG_OTG_VERSION
	hex
	prompt "Actions OTG USB otg Controller version"
	default 0x551A22CF if SOC_SERIES_LARK
	help
	  Actions OTG USB otg Controller version.

config USB_AOTG_OTG_SUPPORT_HS
	bool
	prompt "Actions OTG USB otg Controller support high-speed"
	default y
	help
	  Actions OTG USB otg Controller support high-speed.

config USB_AOTG_OTG_IRQ_PRIO
    int
    depends on USB_AOTG_OTG
    default 2
    help
       IRQ priority of USB.

if USB_DEVICE

config USB_AOTG_DC_ENABLED
	bool
	prompt "Actions OTG USB Device Controller Driver"
	select USB_DEVICE_DRIVER
	default y
	help
	  Actions OTG USB Device mode.

endif # USB_DEVICE

if USB_HOST

config USB_AOTG_HC_ENABLED
	bool
	prompt "Actions OTG USB Host Controller Driver"
	select USB_HOST_DRIVER
	default y
	help
	  Actions OTG USB Host mode.

endif # USB_HOST

config USB_AOTG_DC_FS
	bool
	prompt "Actions OTG USB Device Controller (full-speed)"
	depends on USB_AOTG_OTG_SUPPORT_HS
	depends on USB_AOTG_DC_ENABLED
	default n
	help
	  Actions OTG USB Device Controller Driver (full-speed).

config USB_AOTG_UDC_DMA
	bool
	prompt "Actions OTG USB Device Controller Driver DMA Support"
	depends on DMA && USB_AOTG_DC_ENABLED
	default n
	help
	  Actions OTG USB Device Controller Driver DMA Support.

config USB_AOTG_DC_MULTI_FIFO
	bool "Actions OTG USB Device Controller Driver multi-fifo Support"
	depends on USB_AOTG_DC_ENABLED
	default n
	help
	  Actions OTG USB Device Controller Driver multi-fifo Support, it may
	  be used in non-DMA controller to optimize performance. It has so many
	  limits that it will break up read()/read_async()/write() APIs, so be
	  careful to enable it.

config USB_AOTG_DC_RAM0
	bool
	prompt "URAM0 used for Actions OTG USB Device Controller Driver"
	depends on USB_AOTG_DC_ENABLED
	default y

config USB_AOTG_DC_RAM1
	bool
	prompt "URAM1 used for Actions OTG USB Device Controller Driver"
	depends on USB_AOTG_DC_ENABLED
	default y

config USB_AOTG_DC_RAM2
	bool
	prompt "URAM2 used for Actions OTG USB Device Controller Driver"
	depends on USB_AOTG_DC_ENABLED
	default y

config USB_AOTG_HC_RAM0
	bool
	prompt "URAM0 used for Actions OTG USB Host Controller Driver"
	depends on USB_AOTG_HC_ENABLED
	default n

config USB_AOTG_HC_RAM1
	bool
	prompt "URAM1 used for Actions OTG USB Host Controller Driver"
	depends on USB_AOTG_HC_ENABLED
	default n

config USB_AOTG_HC_RAM2
	bool
	prompt "URAM2 used for Actions OTG USB Host Controller Driver"
	depends on USB_AOTG_HC_ENABLED
	default y

endif # USB_AOTG_OTG
```

## action_technology_zephyr_sdk/zephyr/drivers/video/Kconfig
```kconfig
# video drivers

# Copyright (c) 2017 Intel Corporation
# SPDX-License-Identifier: Apache-2.0

source "drivers/video/jpeg_hw/Kconfig"
```
