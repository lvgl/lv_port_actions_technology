## action_technology_zephyr_sdk/zephyr/drivers/video/jpeg_hw/Kconfig
```kconfig
# Configuration options for Actions Display Accelerator

# Copyright (c) 2020 Actions Technology Co., Ltd
# SPDX-License-Identifier: Apache-2.0

menuconfig JPEG_HW
	bool "JPEG_HW Engine"
	help
	  Enable JPEG_HW Engine

if JPEG_HW

config JPEG_HW_CLK_RATE
	int "jpeg hw clk rate"
	default 128
	help
	  Set JPEG_HW clk rate support

endif # JPEG_HW
```

## action_technology_zephyr_sdk/zephyr/framework/Kconfig
```kconfig
# drivers configuration options

# Copyright (c) 2020 Actions Corporation
# SPDX-License-Identifier: Apache-2.0

menu "Framework Porting Drivers"

rsource "anc/Kconfig"
rsource "dsp/Kconfig"
rsource "audio/Kconfig"
rsource "key/Kconfig"
rsource "osal/Kconfig"
rsource "dma2d/Kconfig"
rsource "display/Kconfig"
rsource "memory/Kconfig"
rsource "sensor/Kconfig"
rsource "misc/Kconfig"
rsource "led/Kconfig"
rsource "jpeg/Kconfig"
endmenu
```

## action_technology_zephyr_sdk/zephyr/framework/jpeg/Kconfig
```kconfig
# Configuration options for Actions OSAL

# Copyright (c) 2020 Actions Technology Co., Ltd
# SPDX-License-Identifier: Apache-2.0

menuconfig JPEG_HAL
	bool "JPEG Hal"
	depends on JPEG_HW
	help
	  Enable JPEG Hal

if JPEG_HAL

endif # JPEG_HAL
```

## action_technology_zephyr_sdk/zephyr/framework/sensor/Kconfig
```kconfig
# Copyright (c) 2018 Jan Van Winkel <jan.van_winkel@dxplore.eu>
# SPDX-License-Identifier: Apache-2.0

rsource "sensor_algo/Kconfig"
rsource "sensor_hal/Kconfig"
```
