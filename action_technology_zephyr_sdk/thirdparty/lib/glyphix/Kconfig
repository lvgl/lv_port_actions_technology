## action_technology_zephyr_sdk/thirdparty/lib/glyphix/Kconfig
```kconfig
# SPDX-License-Identifier: Apache-2.0

menuconfig GLYPHIX
  bool "Glyphix 3rd JavaScript Application Runtime Library"
  help
    This option enables the Glyphix library.

if GLYPHIX

  config GX_SCREEN_WIDTH
    int "Screen width size"
    default 466

  config GX_SCREEN_HEIGHT
    int "Screen height size"
    default 466
  
  config GX_SCREEN_DPI
    int "Screen dpi size"
    default 326

  config GX_DEFAULT_FONT_SIZE
    int "default font size"
    default 32

  config GX_UI_HEAP_MEM_POOL_SIZE
    int "Glyphix-UI heap memory pool size (in bytes)"
    default 4194304
    help
      "GX_UI_HEAP_MEM_POOL_SIZE is the size of the memory pool used for the glyphix ui."

  config GX_STORAGE_ROOTFS_PATH
    string "Glyphix application storage Root Path"
    default "/NAND:/gx"
    help
      "This option allows you to set a custom root path for the glyphix application storage."

  config GX_LOG_CAPACITY
    int "Glyphix-UI log file maximum capacity (in bytes)."
    default 8388608

endif #CONFIG_GLYPHIX
```

## action_technology_zephyr_sdk/thirdparty/lib/gui/lvgl/zephyr/Kconfig
```kconfig
# SPDX-License-Identifier: Apache-2.0

menuconfig LVGL
	bool "Light and Versatile Graphics Library"
	help
	  This option enables the LVGL GUI library.

if LVGL

config APP_LINK_WITH_LVGL
	bool "Link 'app' with LVGL"
	default y
	help
	  Add LVGL header files to the 'app' include path. It may be
	  disabled if the include paths for LVGL are causing aliasing
	  issues for 'app'.

config LV_Z_USE_FILESYSTEM
	bool "Enable file system"
	depends on FILE_SYSTEM
	default y
	help
	  Enable LVGL file system

rsource "../Kconfig"
rsource "Kconfig.gpu"
rsource "Kconfig.memory"

endif #LVGL
```

## action_technology_zephyr_sdk/thirdparty/lib/gui/lvgl/zephyr/Kconfig.memory
```kconfig
# SPDX-License-Identifier: Apache-2.0

menu "Memory manager settings"

config LV_Z_MEM_POOL_SYS_HEAP
	bool "User space lvgl pool"
	depends on LV_USE_CUSTOM_MALLOC
	help
		Use a dedicated memory pool from a private sys heap.

config LV_Z_MEM_POOL_SIZE
	int "Memory pool size"
	default 2048
	depends on LV_Z_MEM_POOL_SYS_HEAP
	help
	  Size of the memory pool in bytes

config LV_VDB_SIZE
	int "Rendering buffer size in bytes"
	default 0
	help
	  Size of the buffer used for rendering screen content in bytes.

config LV_VDB_NUM
	int "Number of VDB for rendering"
	range 1 2
	default 2
	help
	  Number of buffers to render and flush data in parallel.
	  To increase the upper limit, modify LV_DISP_BUF_MAX_NUM in lv_hal_disp.h.

endmenu
```

## action_technology_zephyr_sdk/zephyr/boards/arm/ats3089_dev_watch/ats3089_dev_watch_defconfig
```kconfig
# SPDX-License-Identifier: Apache-2.0

# Deprecated types
CONFIG_DEPRECATED_ZEPHYR_INT_TYPES=y

# Reserve Header
CONFIG_ROM_START_OFFSET=0x200

# Soc
CONFIG_SOC_SERIES_LEOPARD=y
CONFIG_SOC_LEOPARD=y
CONFIG_IRQ_VECTOR_IN_SRAM=y
CONFIG_SLEEP_FUNC_IN_SRAM=y
CONFIG_SOC_WKEN_BAT=n

# Enable MPU
#CONFIG_ARM_MPU=y

# Enable FPU
CONFIG_FPU=y

# stack monitor
CONFIG_STACK_SENTINEL=y
CONFIG_STACK_MONITOR=y
CONFIG_STACK_MONITOR_WARN_THRESHOLD=64
CONFIG_STACK_MONITOR_PARANOID=n
CONFIG_STACK_CANARIES=n

# Enable irq lock/unlock irq time stat
CONFIG_DISABLE_IRQ_STAT=n
CONFIG_DISABLE_IRQ_MAX_LATENCY_CYCLES=16000
#CONFIG_ARCH_SW_ISR_TABLE_ALIGN=8

# Enable sw isr table in ram
CONFIG_DYNAMIC_INTERRUPTS=y

# Enable cacheprofile stat
CONFIG_SOC_SPICACHE_PROFILE=n
CONFIG_SOC_SPICACHE_PROFILE_STAT=n
CONFIG_LOG=n

# Enable irq profiler stat
CONFIG_TRACING_IRQ_PROFILER=n
CONFIG_TRACING_IRQ_PROFILER_MAX_LATENCY=n
CONFIG_TRACING_IRQ_PROFILE_MAX_LATENCY_CYCLES=32000
CONFIG_TRACING_IRQ_PROFILER_IRQLOADING=n
CONFIG_SPIN_VALIDATE=n

# Clock
#CONFIG_CORTEX_M_SYSTICK=y
CONFIG_ACTS_TIMER=y
CONFIG_ACTS_HRTIMER=y
CONFIG_HOSC_CLK_MHZ=32
CONFIG_SYS_CLOCK_HW_CYCLES_PER_SEC=32000000
CONFIG_SYS_CLOCK_TICKS_PER_SEC=500
CONFIG_TIME_SLEEP_COMP=y

# Console
CONFIG_CONSOLE=y
CONFIG_UART_CONSOLE=y
CONFIG_EARLY_CONSOLE=y
CONFIG_PRINTK=y
CONFIG_STDOUT_CONSOLE=y
CONFIG_UART_CONSOLE_ON_DEV_NAME="UART_0"
CONFIG_UART_SHELL_ON_DEV_NAME="UART_0"
CONFIG_SERIAL=y
CONFIG_SHELL_BACKEND_SERIAL=y

# Uart
CONFIG_UART_ACTS=y
CONFIG_UART_INTERRUPT_DRIVEN=y
CONFIG_UART_ACTS_PORT_0=y
CONFIG_UART_ACTS_PORT_0_NAME="UART_0"
CONFIG_UART_ACTS_PORT_0_BAUD_RATE=115200
CONFIG_UART_ACTS_PORT_0_PRIORITY=0

# I2C
CONFIG_I2C=y
CONFIG_I2C_ACTS=y
CONFIG_I2CMT_ACTS=y
CONFIG_I2C_ASYNC=y

# GPIO
CONFIG_GPIO=y
CONFIG_GPIO_ACTS=y

# DMA
CONFIG_DMA=y
CONFIG_DMA_ACTS=y
CONFIG_PDMA_ACTS=y
CONFIG_DMA_LCD_RESEVER_CHAN=1
CONFIG_DMA_DBG_DUMP=y
CONFIG_DMA_SPINOR_RESEVER_CHAN=12

# SPI
CONFIG_SPI=n
CONFIG_SPI_ACTS=y
CONFIG_SPIMT_ACTS=y

#code link
CONFIG_USE_DT_CODE_PARTITION=n
CONFIG_FLASH_LOAD_OFFSET=0x0000
CONFIG_FLASH_LOAD_SIZE=0x100000

#mem
CONFIG_SRAM_SIZE=911
CONFIG_SRAM_BASE_ADDRESS=0x2ff60400
CONFIG_PSRAM_SIZE=16384
CONFIG_PSRAM_BASE_ADDRESS=0x38000000

# FLASH
CONFIG_FLASH=y
CONFIG_FLASH_BASE_ADDRESS=0x10000000
CONFIG_FLASH_SIZE=6876
CONFIG_SPI_FLASH_ACTS=y
CONFIG_SPINOR_TEST_DELAYCHAIN=n
CONFIG_SPINAND_ACTS=y
CONFIG_SPINAND_LIB=y
CONFIG_DMA_SPINAND_RESEVER_CHAN=9
CONFIG_CMD_SPINOR=y
CONFIG_CMD_SPINAND=y
CONFIG_SPINAND_TEST_FRAMEWORKS=n
CONFIG_SOC_SPI0_USE_CK64M=n
CONFIG_SPI_NOR_FLASH_4B_ADDRESS=n
CONFIG_NOR_SUSPEND_RESUME=y
CONFIG_NOR_ACTS_DATA_PROTECTION_ENABLE=y

#
# Storage
#
#CONFIG_FLASH_MAP=y
#CONFIG_STREAM_FLASH=y
#CONFIG_STREAM_FLASH_ERASE=y
# end of Storage

#
# shell cmd
#
CONFIG_SHELL_DBG=y
# end of shell cmd

# IPMSG
CONFIG_IPMSG_ACTS=y
CONFIG_IPMSG_ACTS_BTC=y
# bt_watch set IPMSG_BTC_SEL_32K
# CONFIG_IPMSG_BTC_SEL_32K=y

# MMC
CONFIG_MMC=n
CONFIG_MMC_ACTS=n
CONFIG_MMC_SDCARD=n

# DISK
CONFIG_DISK_ACCESS=y
CONFIG_DISK_ACCESS_SPINAND=y
CONFIG_DISK_ACCESS_SD=n

# file
CONFIG_FILE_SYSTEM=y
CONFIG_FAT_FILESYSTEM_ELM=y
CONFIG_FILE_SYSTEM_SHELL=n
CONFIG_SD_FS=y
CONFIG_SDFS_NOR_NOT_XIP=y
CONFIG_SD_FS_VADDR_START=0x12000000
CONFIG_SD_FS_NAND_SD_STORAGE=y

# heap
CONFIG_HEAP_MEM_POOL_SIZE=2048
#CONFIG_HEAP_MEM_POOL_MIN_SIZE=64
CONFIG_MINIMAL_LIBC_MALLOC_ARENA_SIZE=0


#log
CONFIG_LOG=y
CONFIG_LOG_MODE_MINIMAL=y
CONFIG_ACTIONS_PRINTK_DMA=y
CONFIG_PRINTK_TIME_FREFIX=n
CONFIG_KERNEL_SHOW_STACK=y
CONFIG_KALLSYMS=n
CONFIG_ASSERT=n
CONFIG_PRINTK_DMA_FULL_LOST=y
CONFIG_CBPRINTF_COMPLETE=y

#nvram
CONFIG_NVRAM_CONFIG=y
CONFIG_NVRAM_STORAGE_FLASH=y
CONFIG_NVRAM_FACTORY_REGION_SEGMENT_SIZE=0x1000
CONFIG_NVRAM_STORAGE_FACTORY_RW_REGION=y
CONFIG_NVRAM_FACTORY_RW_REGION_SEGMENT_SIZE=0x1000
CONFIG_NVRAM_USER_REGION_SEGMENT_SIZE=0x1000


#audio
CONFIG_AUDIO_ACTS=y
CONFIG_AUDIO_DRIVER_SHELL=n
CONFIG_AUDIO_DRIVER_STREAM_SHELL=n
CONFIG_AUDIO_OUT_ACTS=y
CONFIG_AUDIO_OUT_DAC_SUPPORT=y
CONFIG_AUDIO_OUT_I2STX_SUPPORT=n
CONFIG_AUDIO_IN_ACTS=y
CONFIG_AUDIO_IN_ADC_SUPPORT=y
CONFIG_AUDIO_IN_I2SRX_SUPPORT=n
CONFIG_AUDIO_OUT_DAC_PCMBUF_SUPPORT=y
CONFIG_AUDIO_POWERON_OPEN_PA=y
CONFIG_BOARD_EXTERNAL_PA_ENABLE=y
CONFIG_AUDIO_PA_AW87390_SUPPORT=y
CONFIG_AUDIO_ANTIPOP_PROCESS=n

#power
CONFIG_POWER_SUPPLY=y
CONFIG_POWER_SUPPLY_ACTS_BATTERY=y
CONFIG_ACTS_LEOPARD_BATTERY_SUPPLY_INTERNAL=n
CONFIG_ACTS_LEOPARD_BATTERY_SUPPLY_EXTERNAL=y
CONFIG_ACTS_BATTERY_SUPPLY_EXT_COULOMETER=n
CONFIG_ACTS_BATTERY_SUPPORT_CHARGER_NTC=n
CONFIG_ACTS_BATTERY_SUPPORT_MINI_CHARGER_NTC=y
CONFIG_ACTS_BATTERY_SUPPORT_FAST_CHARGER=n
CONFIG_ACTS_BATTERY_WAKEUP_PERIOD_MINUTE=10
CONFIG_SYS_POWER_MANAGEMENT=y
CONFIG_PM=y
CONFIG_DEVICE_POWER_MANAGEMENT=y
CONFIG_PM_POLICY_APP=y
CONFIG_IDLE_STACK_SIZE=4096

#cpu powergating
CONFIG_CPU_PWRGAT=y
CONFIG_BT_FAST_BOOT=y

#PMU ADC
CONFIG_ADC=y
CONFIG_ADC_ACTS_LEOPARD=y

#input
CONFIG_INPUT_DEV=y
#CONFIG_INPUT_DEV_ACTS_ADCKEY=n
CONFIG_INPUT_DEV_ACTS_ONOFF_KEY=y
CONFIG_INPUT_DEV_ACTS_TP_KEY=y
CONFIG_INPUT_DEV_ACTS_CST820_TP_KEY=y
CONFIG_INPUT_DEV_ACTS_GPIOKEY=y
CONFIG_INPUT_DEV_ACTS_KNOB=n

#RTC
CONFIG_RTC_ACTS=y
CONFIG_ALARM8HZ_ACTS=y

#mpu
CONFIG_MPU_ACTS=n
CONFIG_MPU_MONITOR_FLASH_AREA_WRITE=y
CONFIG_MPU_MONITOR_CACHECODE_WRITE=n
CONFIG_MPU_MONITOR_RAMFUNC_WRITE=n
CONFIG_MPU_MONITOR_USER_DATA=y
CONFIG_MPU_MONITOR_ROMFUNC_WRITE=y

#arm mpu
CONFIG_ACTIONS_ARM_MPU=y

#PWM
CONFIG_PWM=y
CONFIG_PWM_ACTS=y

#VIBRATOR
CONFIG_VIBRATOR=y
CONFIG_VIBRATOR_ACTS=y

#libc
CONFIG_LIBC_STRING_BROM=y

#os
#CONFIG_CBPRINTF_COMPLETE_BROM=y

#libgui
CONFIG_GUI_API_BROM=y

#jpeg
CONFIG_JPEG_HW=y
CONFIG_JPEG_HAL=y

#sensor
CONFIG_SENSOR_HAL=y
CONFIG_SENSOR_ACC_LIS2DW12=y
CONFIG_SENSOR_ACC_STK8321=y
CONFIG_SENSOR_ACC_SC7A20=n
CONFIG_SENSOR_ACC_QMA6100=y
CONFIG_SENSOR_HR_GH3011=n
CONFIG_SENSOR_HR_VC9201=n
CONFIG_SENSOR_HR_HX3605=y
CONFIG_SENSOR_HR_HX3690=n
CONFIG_SENSOR_MAG_MMC5603NJ=n
CONFIG_SENSOR_BARO_ICP10125=n

#RTT Console and Shell
#CONFIG_UART_CONSOLE=n
#CONFIG_RTT_CONSOLE=y
#CONFIG_ACTIONS_PRINTK_DMA=n
#CONFIG_USE_SEGGER_RTT=y
#CONFIG_SEGGER_RTT_BUFFER_SIZE_UP=4096
#CONFIG_SEGGER_RTT_BUFFER_SIZE_DOWN=64
#CONFIG_SHELL_BACKEND_SERIAL=n
#CONFIG_SHELL_BACKEND_RTT=y

#SystemView
#CONFIG_TRACING=y
#CONFIG_THREAD_NAME=y
#CONFIG_SEGGER_SYSTEMVIEW=y
#CONFIG_SEGGER_SYSVIEW_RTT_BUFFER_SIZE=16384
#CONFIG_USE_SEGGER_RTT=y
#CONFIG_UART_CONSOLE=n
#CONFIG_ACTIONS_PRINTK_DMA=n

#compensation
CONFIG_COMPENSATION=y
CONFIG_COMPENSATION_ACTS=y
CONFIG_COMPENSATION_DEFAULT_HOSC_CAP=100

#COREDUMP
CONFIG_DEBUG_COREDUMP=y
CONFIG_DEBUG_COREDUMP_BACKEND_FLASH_DEV=y
CONFIG_DEBUG_COREDUMP_MEMORY_DUMP_MIN=y
CONFIG_DEBUG_COREDUMP_BACKEND_FLASH_PARTITION=n
CONFIG_DEBUG_COREDUMP_SHELL=y

#actlog
CONFIG_ACTLOG=y
#actlog global compile level
CONFIG_ACTLOG_COMPILE_LEVEL=3
#enable actlog compile by LOG_MODULE_REGISTER level
CONFIG_ACTLOG_COMPILE_MODUL_LEVEL=y
#enable uart output backend or not
CONFIG_ACTLOG_OUTPUT_FLOW=y
#enable save in flash sectors
CONFIG_ACTLOG_OUTPUT_BINARY=y
#enable flash buffer in actlog, if CONFIG_ACTLOG_OUTPUT_BINARY is set, this must set
CONFIG_ACTLOG_LOG_BUFFER=y
#enable nanolog(default use)
CONFIG_ACTLOG_USE_NANOLOG=y
#enable show function or not,maybe used more than 40KB in flash
CONFIG_ACTLOG_SHOW_FUNCTION=n
#enable show timestamp
CONFIG_ACTLOG_SHOW_TIMESTAMP=n
#enable drop log item count or not
CONFIG_ACTLOG_PRINT_DROP_COUNT=y
#enable flash data compress in flash(default use)
CONFIG_ACTLOG_LOG_DATA_COMPRESS=y
#enable shell command for actlog
CONFIG_DEBUG_ACTLOG_SHELL=y
#enable sim flash for log write
CONFIG_SIM_FLASH_ACTS=y
#specify module compile level,this is an example
CONFIG_ACTLOG_LOG_LEVEL_WRN=y
#specify enable runtime log in flash or not
CONFIG_ACTLOG_RUNTIME_LOG_BUFFER=y
#enable block dev flash for runtime log write
CONFIG_BLOCK_DEV_FLASH_ACTS=y
```

## action_technology_zephyr_sdk/zephyr/boards/shields/st7789v_generic/Kconfig.defconfig
```kconfig
# Copyright (c) 2019 Jan Van Winkel <jan.van_winkel@dxplore.eu>
# SPDX-License-Identifier: Apache-2.0

if SHIELD_ST7789V_TL019FQV01 || SHIELD_ST7789V_WAVESHARE_240X240

if DISPLAY

config SPI
	default y

config ST7789V
	default y

choice ST7789V_PIXEL_FORMAT
	default ST7789V_RGB888 if SHIELD_ST7789V_TL019FQV01
	default ST7789V_RGB565 if SHIELD_ST7789V_WAVESHARE_240X240
endchoice

endif # DISPLAY

endif # SHIELD_ST7789V_TL019FQV01 || SHIELD_ST7789V_WAVESHARE_240X240
```

## action_technology_zephyr_sdk/zephyr/drivers/adc/Kconfig.acts
```kconfig
# ADC configuration options

# Copyright (c) 2021 Actions Semiconductor Co., Ltd
# SPDX-License-Identifier: Apache-2.0

config ADC_ACTS_LARK
	bool "Actions Lark ADC driver"
	default n
	help
	  Support the ADC functions for the Actions Lark chipset.

config ADC_ACTS_LEOPARD
	bool "Actions Leopard ADC driver"
	default n
	help
	  Support the ADC functions for the Actions Leopard chipset.

config PMUADC_NAME
	string "PMU ADC Driver's name"
	depends on ADC_ACTS_LARK || ADC_ACTS_LEOPARD
	default "PMUADC_0"

config ADC_ACTS_ALWAYS_ON
	bool "Actions ADC function always on"
	depends on ADC_ACTS_LARK || ADC_ACTS_LEOPARD
	default n
	help
	  Always enable ADC function in normal stage.
```

## action_technology_zephyr_sdk/zephyr/drivers/cfg_drv/Kconfig
```kconfig
# Kconfig - CFG DRV configuration options

#
# Copyright (c) 2015 Intel Corporation
#
# SPDX-License-Identifier: Apache-2.0
#

#
# CFG DRV options
#
menuconfig CFG_DRV
	bool
	prompt "Actions CFG_DRV Drivers"
	help
	Enable Actions CFG_DRV Driver Configuration
```

## action_technology_zephyr_sdk/zephyr/drivers/display/Kconfig
```kconfig
# Display drivers

# Copyright (c) 2017 Intel Corporation
# SPDX-License-Identifier: Apache-2.0

menuconfig DISPLAY
	bool "Display Drivers"
	help
	  Enable display drivers

if DISPLAY

config DISPLAY_INIT_PRIORITY
	int "Display devices init priority"
	default 85
	help
	  Display devices initialization priority.

module = DISPLAY
module-str = display
source "subsys/logging/Kconfig.template.log_config"

source "drivers/display/Kconfig.st7789v"
source "drivers/display/Kconfig.acts"

config FRAMEBUF_DISPLAY
	# Hidden, selected by client drivers.
	bool
	help
	  Enable framebuffer-based display 'helper' driver.

endif # DISPLAY
```

## action_technology_zephyr_sdk/zephyr/drivers/dvfs/Kconfig
```kconfig
# Kconfig - flash driver configuration options

#
# Copyright (c) 2016 Intel Corporation
#
# SPDX-License-Identifier: Apache-2.0
#

#
# flash driver
#
menuconfig DVFS
	bool
	prompt "support DVFS"
	default n
	select DVFS_DYNAMIC_LEVEL
	help
	  Enable support for dynamic voltage and frequency scaling.

if DVFS

config ACTS_DVFS_DYNAMIC_LEVEL
	bool "support dynamic DVFS level"
	depends on DVFS
	default n
	help
	  Support dynamic DVFS level

endif
```

## action_technology_zephyr_sdk/zephyr/drivers/flash/Kconfig
```kconfig
# Flash driver configuration options

# Copyright (c) 2016 Intel Corporation
# SPDX-License-Identifier: Apache-2.0

#
# Flash driver
#
config FLASH_HAS_DRIVER_ENABLED
	bool
	help
	  This option is enabled when any flash driver is enabled.

config FLASH_HAS_PAGE_LAYOUT
	bool
	help
	  This option is enabled when the SoC flash driver supports
	  retrieving the layout of flash memory pages.

config FLASH_JESD216
	bool
	help
	 Selected by drivers that support JESD216-compatible flash
	 devices to enable building a common support module.

config FLASH_JESD216_API
	bool "Provide API to read JESD216 flash parameters"
	depends on FLASH_JESD216
	help
	  This option extends the Zephyr flash API with the ability
	  to access the Serial Flash Discoverable Parameter section
	  allowing runtime determination of serial flash parameters
	  for flash drivers that expose this capability.

menuconfig FLASH
	bool "Flash hardware support"
	help
	  Enable support for the flash hardware.

if FLASH

module = FLASH
module-str = flash
source "subsys/logging/Kconfig.template.log_config"

config FLASH_SHELL
	bool "Enable Flash shell"
	depends on SHELL && FLASH_PAGE_LAYOUT
	default y
	help
	  Enable the flash shell with flash related commands such as test,
	  write, read and erase.

config FLASH_PAGE_LAYOUT
	bool "API for retrieving the layout of pages"
	depends on FLASH_HAS_PAGE_LAYOUT
	default y
	help
	  Enables API for retrieving the layout of flash memory pages.

config SPINOR_TEST_DELAYCHAIN
	bool "test delaychain"
	default n
	help
	  Enables test delaychain try.

config XSPI_NOR_ACTS_DEV_TEST_DELAYCHAIN_PRIORITY
	int "test delaychain proprity"
	default 60
	help
	  set test delaychain try proprity.

config NOR_ACTS_DATA_PROTECTION_ENABLE
	bool "write protection"
	default n
	help
	  Enables write protection.

config NOR_ACTS_DQ_MODE_ENABLE
	bool "try nor dual quad read mode"
	default n
	help
	  Enables mode to try nor dual quad read mode.

source "drivers/flash/Kconfig.acts"

endif # FLASH
```

## action_technology_zephyr_sdk/zephyr/drivers/gpio/Kconfig.acts
```kconfig
# Actions GPIO configuration options

# Copyright (c) 2018 Justin Watson
# SPDX-License-Identifier: Apache-2.0

menuconfig GPIO_ACTS
	bool "Actions acts GPIO (PORT) driver"
	default y
	help
	  Enable support for the Actions  GPIO controllers.
```

## action_technology_zephyr_sdk/zephyr/drivers/gpu/Kconfig
```kconfig
# Configuration options for GPU

# Copyright (c) 2020 Actions Technology Co., Ltd
# SPDX-License-Identifier: Apache-2.0

orsource "verisilicon/Kconfig"
```
