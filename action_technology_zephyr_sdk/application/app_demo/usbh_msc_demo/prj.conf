## CMakeLists.txt
```
# SPDX-License-Identifier: Apache-2.0

cmake_minimum_required(VERSION 3.20.0)

find_package(Zephyr REQUIRED HINTS $ENV{ZEPHYR_BASE})
project(cherryusb_msc)

if(CONFIG_CHERRYUSB)

set(CONFIG_CHERRYUSB_OSAL "zephyr")
include (${ZEPHYR_BASE}/../thirdparty/lib/CherryUSB/cherryusb.cmake)

zephyr_include_directories(${cherryusb_incs})

if (CONFIG_CHERRYUSB_HOST)
zephyr_linker_sources(SECTIONS usbh_class_info.ld)
endif()

#zephyr_library()
#zephyr_library_sources(${cherryusb_srcs})
endif()

zephyr_include_directories(src/include)
target_sources(app PRIVATE src/main.c src/usb_hc.c ${cherryusb_srcs})
```

## prj.conf
```kconfig
#========== system base config ===========
CONFIG_ACTIONS_FRAMEWORK=y
CONFIG_ACTIONS_FRAMEWORK_DISPLAY=y
CONFIG_THREAD_TIMER=y
CONFIG_ACTIONS_UTILS=y
CONFIG_CORE=y
CONFIG_SYSTEM=y
CONFIG_SYS_CLOCK_TICKS_PER_SEC=1000
CONFIG_PRINTK_TIME_FREFIX=n
CONFIG_DMA_PRINTK_BUF_SIZE=4096
CONFIG_SLEEP_SENSOR_RUN_ON_NOR=y
CONFIG_SLEEP_COPY_SRAM_FOR_SENSOR=n
CONFIG_SLEEP_MEMORY_CHECK_INTEGRITY=n
CONFIG_THREAD_RUNTIME_STATS=y
CONFIG_SYSTEM_SHELL=y
CONFIG_TASK_WDT=y
CONFIG_TASK_WDT_TIMEOUT=5000
CONFIG_DEBUG_RAMDUMP=n

#power config
CONFIG_POWER=y

#input config
CONFIG_INPUT=y
CONFIG_INPUT_POINTER=y
CONFIG_INPUT_KEYPAD=y
CONFIG_ACTS_RING_BUFFER=y

#standby config
CONFIG_SYS_STANDBY=y
CONFIG_AUTO_STANDBY_TIME_SEC=10
CONFIG_SYS_WAKELOCK=y

#system message config
CONFIG_NUM_MBOX_ASYNC_MSGS=35
CONFIG_MESSAGE_DEBUG=n

#property config
CONFIG_PROPERTY=y
CONFIG_PROPERTY_CACHE=y

#watchdog config
CONFIG_WATCHDOG=n
CONFIG_WDOG_ACTS=n
CONFIG_WDT_MODE_RESET=n

#dvfs config
CONFIG_DVFS=y
CONFIG_ACTS_DVFS_DYNAMIC_LEVEL=y

#memory config
CONFIG_MEMORY=y
CONFIG_SYS_MEMORY_DEBUG=n
CONFIG_APP_USED_MEM_POOL=y
CONFIG_RAM_POOL_PAGE_NUM=9
CONFIG_HEAP_MEM_POOL_SIZE=2560

#system stack config
CONFIG_MAIN_STACK_SIZE=4096
CONFIG_IDLE_STACK_SIZE=4096
CONFIG_SYSTEM_WORKQUEUE_STACK_SIZE=2048

#=========== display config ===========
CONFIG_DISPLAY=y
CONFIG_DISPLAY_LOG_LEVEL_INF=y
CONFIG_DISPLAY_CONTROLLER=y
CONFIG_DISPLAY_ENGINE=y
CONFIG_DISPLAY_ENGINE_INSTANCE_NUM=4
CONFIG_DMA2D_HAL=y
CONFIG_DMA2D_LITE=y
CONFIG_DISPLAY_WORK_Q=y
CONFIG_DISPLAY_WORK_Q_STACK_SIZE=1536

#=========== libc config ===========
CONFIG_NEWLIB_LIBC=y
CONFIG_NEWLIB_LIBC_FLOAT_PRINTF=y
CONFIG_NEWLIB_LIBC_NANO=y

CONFIG_CHERRYUSB=y
CONFIG_CHERRYUSB_HOST=y
CONFIG_CHERRYUSB_HOST_CDC_ACM=y
CONFIG_CHERRYUSB_HOST_MSC=y
CONFIG_CHERRYUSB_HOST_AUDIO=y
CONFIG_CHERRYUSB_HOST_DWC2_HC=y
CONFIG_HEAP_MEM_POOL_SIZE=16000
```

## src/main.c
```c
/*
 * Copyright (c) 2012-2014 Wind River Systems, Inc.
 *
 * SPDX-License-Identifier: Apache-2.0
 */

#include <kernel.h>
#include <shell/shell.h>

/*
 * Copyright (c) 2024, sakumisu
 *
 * SPDX-License-Identifier: Apache-2.0
 */
#include "usbh_core.h"
#include "usbh_cdc_acm.h"
#include "usbh_msc.h"

#ifndef TEST_USBH_MSC
#define TEST_USBH_MSC 1
#endif
#ifndef TEST_USBH_MSC_FATFS
#define TEST_USBH_MSC_FATFS 0
#endif


#if TEST_USBH_MSC

#if TEST_USBH_MSC_FATFS
#include "ff.h"

USB_NOCACHE_RAM_SECTION USB_MEM_ALIGNX uint8_t read_write_buffer[25 * 100];

USB_NOCACHE_RAM_SECTION FATFS fs;
USB_NOCACHE_RAM_SECTION FIL fnew;
UINT fnum;
FRESULT res_sd = 0;

int usb_msc_fatfs_test()
{
    const char *tmp_data = "cherryusb fatfs demo...\r\n";

    USB_LOG_RAW("data len:%d\r\n", strlen(tmp_data));
    for (uint32_t i = 0; i < 100; i++) {
        memcpy(&read_write_buffer[i * 25], tmp_data, strlen(tmp_data));
    }

    res_sd = f_mount(&fs, "2:", 1);
    if (res_sd != FR_OK) {
        USB_LOG_RAW("mount fail,res:%d\r\n", res_sd);
        return -1;
    }

    USB_LOG_RAW("test fatfs write\r\n");
    res_sd = f_open(&fnew, "2:test.txt", FA_CREATE_ALWAYS | FA_WRITE);
    if (res_sd == FR_OK) {
        res_sd = f_write(&fnew, read_write_buffer, sizeof(read_write_buffer), &fnum);
        if (res_sd == FR_OK) {
            USB_LOG_RAW("write success, write len:%d\n", fnum);
        } else {
            USB_LOG_RAW("write fail\r\n");
            goto unmount;
        }
        f_close(&fnew);
    } else {
        USB_LOG_RAW("open fail\r\n");
        goto unmount;
    }
    USB_LOG_RAW("test fatfs read\r\n");

    res_sd = f_open(&fnew, "2:test.txt", FA_OPEN_EXISTING | FA_READ);
    if (res_sd == FR_OK) {
        res_sd = f_read(&fnew, read_write_buffer, sizeof(read_write_buffer), &fnum);
        if (res_sd == FR_OK) {
            USB_LOG_RAW("read success, read len:%d\n", fnum);
        } else {
            USB_LOG_RAW("read fail\r\n");
            goto unmount;
        }
        f_close(&fnew);
    } else {
        USB_LOG_RAW("open fail\r\n");
        goto unmount;
    }
    f_mount(NULL, "2:", 1);
    return 0;
unmount:
    f_mount(NULL, "2:", 1);
    return -1;
}
#endif

USB_NOCACHE_RAM_SECTION USB_MEM_ALIGNX uint8_t partition_table[512];

static void usbh_msc_thread(void *argument)
{
    int ret;
    struct usbh_msc *msc_class = (struct usbh_msc *)argument;

    /* test with only one buffer, if you have more msc class, modify by yourself */
#if 1
    /* get the partition table */
    ret = usbh_msc_scsi_read10(msc_class, 0, partition_table, 1);
    if (ret < 0) {
        USB_LOG_RAW("scsi_read10 error,ret:%d\r\n", ret);
        goto delete;
    }
    for (uint32_t i = 0; i < 512; i++) {
        if (i % 16 == 0) {
            USB_LOG_RAW("\r\n");
        }
        USB_LOG_RAW("%02x ", partition_table[i]);
    }
    USB_LOG_RAW("\r\n");
#endif

#if TEST_USBH_MSC_FATFS
    usb_msc_fatfs_test();
#endif
    // clang-format off
delete:
    usb_osal_thread_delete(NULL);
    // clang-format on
}
#endif

static usb_osal_thread_t msc_th;
void usbh_msc_run(struct usbh_msc *msc_class)
{
#if TEST_USBH_MSC
    printk("start usbh_msc_run...\n");
    msc_th = usb_osal_thread_create("usbh_msc", 2048, CONFIG_USBHOST_PSC_PRIO + 1, usbh_msc_thread, msc_class);
#endif
}

void usbh_msc_stop(struct usbh_msc *msc_class)
{
    usb_osal_thread_delete(msc_th);
}


int main(void)
{
    //sys_cache_data_disable();
    printk("Hello World! %s\n", CONFIG_BOARD);
	usbh_initialize(0, 0x4008c000);
	return 0;
}

static void shell_lsusb_handle(const struct shell *sh, size_t argc, char **argv)
{
    ARG_UNUSED(sh);
    lsusb(argc, argv);

}

SHELL_CMD_REGISTER(lsusb, NULL, "Usage: lsusb [options]...\r\n", shell_lsusb_handle);
```
