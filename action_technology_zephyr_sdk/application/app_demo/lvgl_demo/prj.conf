## CMakeLists.txt
```
# SPDX-License-Identifier: Apache-2.0

#list(APPEND ZEPHYR_EXTRA_MODULES ${CMAKE_CURRENT_SOURCE_DIR}/../../modules/framework)


cmake_minimum_required(VERSION 3.13.1)

find_package(Zephyr REQUIRED HINTS $ENV{ZEPHYR_BASE})
project(lvgl_demo)

add_subdirectory(src)

if(CONFIG_STACK_CANARIES)
	zephyr_library_compile_options(-DAPP_BT_WATCH -fstack-protector-all)
endif()
```

## Kconfig
```
mainmenu "lvgl demo"

source "Kconfig.zephyr"

menu "App Configuration"

config OTA_UPGRADE
	bool "OTA Upgrade Support"
	default n
	select PARTITION
	select FIRMWARE_VERSION
	select RING_BUFFER
	help
	  This option enable OTA upgrade.

config OTA_BACKEND_BLUETOOTH
    bool "OTA upgrade by Bluetooth Support"
	depends on BT_MANAGER
	select STREAM
    select BT_SPPBLE_STREAM
    default n
    help
      This option enables OTA upgrade by Bluetooth SPP/BLE.

endmenu
```

## prj.conf
```kconfig
#=========== GUI config ===========
CONFIG_SURFACE_ZERO_BUFFER=y
CONFIG_UI_MEMORY_MANAGER=y
CONFIG_UI_MEMORY_DEBUG=n
CONFIG_MEM_GUARD=n

#actions RES manager
CONFIG_RES_MANAGER=y
CONFIG_RES_MANAGER_USE_STYLE_MMAP=y
CONFIG_RES_MANAGER_SKIP_PRELOAD=n

#actions freetype font
CONFIG_FREETYPE_FONT=y

#actions Bitmap font
CONFIG_BITMAP_FONT=y
CONFIG_BITMAP_FONT_SUPPORT_EMOJI=y
CONFIG_EMOJI_FONT_USE_MMAP=y

#lvgl config
CONFIG_LVGL=y
CONFIG_LVGL_USE_BITMAP_FONT=y
CONFIG_LVGL_USE_FREETYPE_FONT=y
CONFIG_LVGL_USE_RES_MANAGER=y
CONFIG_LV_VDB_NUM=2
CONFIG_LV_CONF_MINIMAL=y
CONFIG_LV_COLOR_DEPTH_16=y
CONFIG_LV_USE_PRIVATE_API=n
CONFIG_LV_DRAW_BUF_ALIGN=64
CONFIG_LV_USE_DRAW_CUSTOM_GPU_INIT=y
CONFIG_LV_USE_DRAW_ACTS_DMA2D=y
CONFIG_LV_USE_DRAW_VG_LITE=y
CONFIG_LV_VG_LITE_USE_GPU_INIT=y
CONFIG_LV_VG_LITE_COMMAND_BUFFER_SIZE=32
CONFIG_LV_VG_LITE_FLUSH_MAX_COUNT=0
CONFIG_LV_VG_LITE_GRAD_CACHE_CNT=2
CONFIG_LV_VG_LITE_STROKE_CACHE_CNT=1
CONFIG_LV_USE_VECTOR_GRAPHIC=y
CONFIG_LV_BIN_DECODER_RAM_LOAD=y
CONFIG_LV_USE_ETC2=y
CONFIG_LV_USE_IMGFONT=y
CONFIG_LV_USE_SNAPSHOT=y
CONFIG_LV_FONT_DEFAULT_MONTSERRAT_48=y
CONFIG_LV_TXT_ENC_UTF8=y
CONFIG_LV_TXT_BREAK_CHARS=""
CONFIG_LV_USE_LOG=y
CONFIG_LV_USE_ASSERT_NULL=y
CONFIG_LV_USE_ASSERT_MALLOC=y
CONFIG_LV_USE_STRACE=y
CONFIG_LV_USE_STRACE_OBJ_DRAW=n
CONFIG_LV_USE_STRACE_TASK_DRAW=n
CONFIG_LV_USE_FLEX=y
CONFIG_LV_USE_GRID=y
CONFIG_LV_USE_ARC=y
CONFIG_LV_USE_BUTTON=y
CONFIG_LV_USE_BARCODE=y
CONFIG_LV_USE_CANVAS=y
CONFIG_LV_USE_CHART=y
CONFIG_LV_USE_IMAGE=y
CONFIG_LV_USE_IMAGEBUTTON=y
CONFIG_LV_USE_LABEL=y
CONFIG_LV_USE_SLIDER=y
CONFIG_LV_USE_TILEVIEW=y
CONFIG_LV_USE_QRCODE=y

#=========== system base config ===========
CONFIG_ACTIONS_FRAMEWORK=y
CONFIG_ACTIONS_FRAMEWORK_DISPLAY=y
CONFIG_THREAD_TIMER=y
CONFIG_ACTIONS_UTILS=y
CONFIG_CORE=y
CONFIG_SYSTEM=y
CONFIG_SYS_CLOCK_TICKS_PER_SEC=1000
CONFIG_PRINTK_TIME_FREFIX=n
CONFIG_DMA_PRINTK_BUF_SIZE=4096
CONFIG_SLEEP_SENSOR_RUN_ON_NOR=y
CONFIG_SLEEP_COPY_SRAM_FOR_SENSOR=n
CONFIG_SLEEP_MEMORY_CHECK_INTEGRITY=n
CONFIG_THREAD_RUNTIME_STATS=y
CONFIG_SYSTEM_SHELL=y
CONFIG_TASK_WDT=y
CONFIG_TASK_WDT_TIMEOUT=5000
CONFIG_DEBUG_RAMDUMP=y
CONFIG_DEBUG_TRACEDUMP=y

#power config
CONFIG_POWER=y

#input config
CONFIG_INPUT=y
CONFIG_INPUT_POINTER=y
CONFIG_INPUT_KEYPAD=y
CONFIG_ACTS_RING_BUFFER=y

#standby config
CONFIG_SYS_STANDBY=y
CONFIG_AUTO_STANDBY_TIME_SEC=10
CONFIG_SYS_WAKELOCK=y

#system message config
CONFIG_NUM_MBOX_ASYNC_MSGS=35
CONFIG_MESSAGE_DEBUG=n

#property config
CONFIG_PROPERTY=y
CONFIG_PROPERTY_CACHE=y

#watchdog config
CONFIG_WATCHDOG=n
CONFIG_WDOG_ACTS=n
CONFIG_WDT_MODE_RESET=n

#dvfs config
CONFIG_DVFS=y
CONFIG_ACTS_DVFS_DYNAMIC_LEVEL=y

#memory config
CONFIG_MEMORY=y
CONFIG_SYS_MEMORY_DEBUG=n
CONFIG_APP_USED_MEM_POOL=y
CONFIG_RAM_POOL_PAGE_NUM=9
CONFIG_HEAP_MEM_POOL_SIZE=2560

#system stack config
CONFIG_MAIN_STACK_SIZE=4096
CONFIG_IDLE_STACK_SIZE=4096
CONFIG_SYSTEM_WORKQUEUE_STACK_SIZE=2048

# sdfs config
CONFIG_SD_FS=y
CONFIG_SDFS_MANAGER=y
CONFIG_MUTIPLE_VOLUME_MANAGER=y
CONFIG_SD_FILE_MAX=24
CONFIG_DISKIO_CACHE=n

#=========== bulooth config ===========
CONFIG_BLUETOOTH=y
CONFIG_ACTS_BT=y
CONFIG_ACTS_BT_SHELL=n
CONFIG_BT_BLE=y
CONFIG_BT_DRV=y
CONFIG_BT_ECC_ACTS=y
CONFIG_BT_HCI_ACTS=y
CONFIG_BT_CTRL_DEBUG=n
CONFIG_BT_CTRL_LOG=y
CONFIG_BT_CTRL_BQB=y
CONFIG_BT_CTRL_RF_DEBUG=n
CONFIG_BT_HCI_TX_PRINT=n
CONFIG_BT_HCI_RX_PRINT=n
CONFIG_HCI_DATA_LOG=y
CONFIG_BT_BREDR=y
CONFIG_BT_CONN_TX_MAX=12
CONFIG_BT_HCI_ACL_FLOW_CONTROL=n
CONFIG_BT_ATT_ENFORCE_FLOW=n
CONFIG_BT_GATT_DYNAMIC_DB=y
CONFIG_BT_MAX_CONN=4
CONFIG_BT_MAX_BR_CONN=2
CONFIG_BT_MAX_PAIRED=4
CONFIG_BT_MAX_BR_PAIRED=2
CONFIG_BT_SPP=y
CONFIG_BT_PBAP_CLIENT=y
CONFIG_BT_MAP_CLIENT=y
CONFIG_BT_HID=y
CONFIG_BT_SDP_CLIENT=y
CONFIG_BT_PERIPHERAL=y
CONFIG_BT_BAS=y
CONFIG_BT_SMP=y
CONFIG_BT_BONDABLE=y
CONFIG_BT_DEVICE_NAME="leopard_bt"
CONFIG_BT_RX_BUF_LEN=680
CONFIG_BT_RX_BUF_COUNT=25
CONFIG_BT_HCI_CMD_COUNT=4
CONFIG_BT_L2CAP_TX_MTU=672
CONFIG_BT_BLE_NOTIFY_PENDING=y
CONFIG_BT_BLE_APP_UPDATE_PARAM=y
CONFIG_BT_ANCS_AMS=y
CONFIG_BT_ACTIONS_SUPER_SERVICE=y

#=========== display config ===========
CONFIG_DISPLAY=y
CONFIG_DISPLAY_LOG_LEVEL_INF=y
CONFIG_DISPLAY_CONTROLLER=y
CONFIG_DISPLAY_ENGINE=y
CONFIG_DISPLAY_ENGINE_INSTANCE_NUM=4
CONFIG_DMA2D_HAL=y
CONFIG_DMA2D_LITE=y
CONFIG_DISPLAY_WORK_Q=y
CONFIG_DISPLAY_WORK_Q_STACK_SIZE=1536

#=========== libc config ===========
CONFIG_NEWLIB_LIBC=y
CONFIG_NEWLIB_LIBC_FLOAT_PRINTF=y
CONFIG_NEWLIB_LIBC_NANO=y

#=========== ota config ===========
CONFIG_OTA=y
CONFIG_OTA_UPGRADE=y
CONFIG_OTA_BACKEND_BLUETOOTH=y

#=========== sensor config ===========
CONFIG_SENSOR_MANAGER=y
CONFIG_SENSOR_ALGO_HR_GH30X=n
CONFIG_SENSOR_ALGO_HR_VCARE=n
CONFIG_SENSOR_ALGO_HR_HX3605=y
CONFIG_SENSOR_ALGO_HR_HX3690=n
CONFIG_SENSOR_ALGO_MOTION_CYWEE=y
CONFIG_SENSOR_ALGO_MOTION_CYWEE_DML=n
CONFIG_SENSOR_ALGO_MOTION_SILAN=n

CONFIG_COMPILER_OPT="-Wno-attributes -Wno-array-bounds -Wno-uninitialized"
```

## src/main.c
```c
/*
 * Copyright (c) 2020 Actions Technology Co., Ltd
 *
 * SPDX-License-Identifier: Apache-2.0
 */

/*********************
 *      INCLUDES
 *********************/

#include <stdio.h>
#include <string.h>
#include <stdint.h>
#include <board_cfg.h>
#include <os_common_api.h>
#include <lvgl/lvgl.h>
#include <lvgl/lvgl_ext.h>
#include <lvgl/lvgl_bitmap_font.h>
#include <lvgl/lvgl_freetype_font.h>
#include <drivers/input/input_dev.h>
#include <mem_manager.h>
#include <sys_manager.h>
#include <bt_manager.h>
#include <thread_timer.h>
//#include <thread_wdg.h>
#include <sys_wakelock.h>
#include <sensor_manager.h>
#include <partition/partition.h>
#ifdef CONFIG_DVFS
#include <dvfs.h>
#endif
#include "app_msg.h"
#include "ota_app.h"

/*********************
 *      DEFINES
 *********************/

// NOR:A ~ NOR:C --> file_id: 10 ~ 12 (firmware.xml)
#define DEF_FONT22_FILE			"/NOR:C/sans22.font"
#define DEF_VFONT_FILE      	"/NOR:C/vfont.ttf"

/**********************
 *  STATIC PROTOTYPES
 **********************/

static void _disp_vsync_cb(const lvx_display_observer_t * observer, uint32_t timestamp);
static void _disp_state_cb(const lvx_display_observer_t * observer, uint32_t state);

/**********************
 *  STATIC VARIABLES
 **********************/

static const lvx_display_observer_t g_disp_observer = {
	.vsync_cb = _disp_vsync_cb,
	.state_cb = _disp_state_cb,
};

static uint8_t g_disp_active = 1;

static K_SEM_DEFINE(g_disp_vsync_sem, 0, 1);

/**********************
 *   STATIC FUNCTIONS
 **********************/

static void _disp_vsync_cb(const lvx_display_observer_t *observer, uint32_t timestamp)
{
	k_sem_give(&g_disp_vsync_sem);
}

static void _disp_state_cb(const lvx_display_observer_t *observer, uint32_t state)
{
	switch (state) {
	case LVX_DISPLAY_STATE_OFF:
		app_msg_send(APP_NAME, MSG_UI, CMD_SCREEN_OFF);
		break;
	case LVX_DISPLAY_STATE_ON:
		app_msg_send(APP_NAME, MSG_UI, CMD_SCREEN_ON);
		break;
	default:
		break;
	}
}

static void _keypad_callback(struct device *dev, struct input_value *val)
{
	static uint32_t last_value = 0;

	SYS_LOG_INF("type: %d, code:%d, value:%d\n",
		val->keypad.type, val->keypad.code, val->keypad.value);

	if (last_value != val->keypad.value) {
		// screen on
		sys_wake_lock(FULL_WAKE_LOCK);
		sys_wake_unlock(FULL_WAKE_LOCK);

		last_value = val->keypad.value;
	}
}

static void _keypad_init(void)
{
	struct device *onoff_dev;

	onoff_dev = (struct device *)device_get_binding(CONFIG_INPUT_DEV_ACTS_ONOFF_KEY_NAME);
	if (!onoff_dev) {
		SYS_LOG_ERR("cannot found key dev %s", CONFIG_INPUT_DEV_ACTS_ONOFF_KEY_NAME);
		return;
	}

	input_dev_enable(onoff_dev);
	input_dev_register_notify(onoff_dev, _keypad_callback);
}

static void _lvgl_init(void)
{
	/* LVGL initialize */
	lvx_port_init();
	lvx_display_add_observer(&g_disp_observer);
	lvx_refr_set_manual(NULL);

	/* Set background color */
	lv_obj_set_style_bg_color(lv_screen_active(), lv_color_black(), 0);
	lv_obj_set_style_bg_opa(lv_screen_active(), LV_OPA_COVER, 0);

	// init font
	lvgl_bitmap_font_init(NULL);
	lvgl_freetype_font_init();
}

static void _lvgl_set_y_anim_cb(void *label, int32_t val)
{
	static const lv_color_t test_colors[] = {
		LV_COLOR_MAKE(255, 0, 0), LV_COLOR_MAKE(0, 255, 0),
		LV_COLOR_MAKE(0, 0, 255), LV_COLOR_MAKE(255, 255, 255),
	};
	static uint8_t color_idx = 0;

	if (val == 0) {
		lv_obj_set_style_text_color(label, test_colors[color_idx], LV_PART_MAIN);
		if (++color_idx >= ARRAY_SIZE(test_colors))
			color_idx = 0;
	}

    lv_obj_set_y(label, val);
}

static void _lvgl_anim_demo(const char* text)
{
	const lv_font_t *font = lv_font_default();

#if 0
	static lv_font_t ttf_font;
	static lv_font_t bmp_font;

	/* open ttf font */
	if (lvgl_freetype_font_open(&ttf_font, DEF_VFONT_FILE, 24)) {
		SYS_LOG_ERR("ttf font not found");
	} else {
		font = &ttf_font;
	}

	/* open bitmap font */
	if (lvgl_bitmap_font_open(&bmp_font, DEF_FONT22_FILE) < 0) {
		SYS_LOG_ERR("bitmap font not found");
	} else {
		font = &bmp_font;
	}
#endif

	lv_obj_t * label = lv_label_create(lv_screen_active());
	lv_obj_align(label, LV_ALIGN_TOP_MID, 0, 0);
	lv_obj_set_style_text_font(label, font, LV_PART_MAIN);
	lv_obj_set_style_text_color(label, lv_color_black(), LV_PART_MAIN);
	lv_label_set_text(label, text);

	lv_anim_t anim;
	lv_anim_init(&anim);
	lv_anim_set_time(&anim, 2000);
	lv_anim_set_playback_time(&anim, 2000);
	lv_anim_set_repeat_count(&anim, LV_ANIM_REPEAT_INFINITE);
	lv_anim_set_var(&anim, label);
	lv_anim_set_exec_cb(&anim, _lvgl_set_y_anim_cb);
	lv_anim_set_values(&anim, 0, lv_obj_get_height(lv_screen_active()) - lv_font_get_line_height(font));
	lv_anim_start(&anim);
}

static int _sensor_callback(int evt_id, sensor_res_t *res)
{
	SYS_LOG_INF("evt_id=%d, handup=%d, step=%d", evt_id, res->handup,
		(uint32_t)res->pedometer.total_steps);

	return 0;
}

static void _sensor_init(void)
{
	sensor_manager_enable(ALGO_ACTIVITY_OUTPUT, 0);
	sensor_manager_enable(ALGO_HANDUP, 0);
	sensor_manager_add_callback(_sensor_callback);
}

static void _process_ui_msg(struct app_msg *msg)
{
	switch (msg->cmd) {
	case CMD_SCREEN_OFF:
		g_disp_active = 0;
		break;
	case CMD_SCREEN_ON:
		g_disp_active = 1;
		lv_obj_invalidate(lv_screen_active());
		break;
	default:
		break;
	}
}

/**********************
 *   GLOBAL FUNCTIONS
 **********************/

int main(void)
{
	// init system
	mem_manager_init();
	system_init();
	bt_manager_init();

	// init app msg
	app_msg_init();

	// init lvgl
	_lvgl_init();

	// ota check and show animation
	// if (ota_is_already_running()) {
	// 	SYS_LOG_ERR("Error: ota running!");
	// } else if (ota_is_already_done()) {
	// 	_lvgl_anim_demo("Ota done!");
	// } else {
		_lvgl_anim_demo("Hello world!");
//	}

	// init key device
	_keypad_init();

	// init sensor
	_sensor_init();

	// init ota
	ota_app_init();
	ota_app_init_bluetooth();

	system_ready();

	// start soft watchdog
	//thread_wdg_start();

#ifdef CONFIG_ACTS_DVFS_DYNAMIC_LEVEL
	dvfs_unset_level(DVFS_LEVEL_HIGH_PERFORMANCE, "init");
	dvfs_set_level(DVFS_LEVEL_NORMAL, "launcher");
#endif

	while (1) {
		struct app_msg msg;

		os_strace_void(SYS_TRACE_ID_GUI_TASK);
		uint32_t lv_timeout = lv_task_handler();
		os_strace_end_call(SYS_TRACE_ID_GUI_TASK);

		uint32_t tt_timeout = thread_timer_next_timeout();
		uint32_t timeout = MIN(lv_timeout, tt_timeout);

		int rc = poll_msg(&msg, &g_disp_vsync_sem, timeout);
		switch (rc) {
		case OS_POLL_MSG:
			SYS_LOG_INF("msg type=0x%x, cmd=0x%x", msg.type, msg.cmd);
			switch (msg.type) {
				case MSG_UI:
					_process_ui_msg(&msg);
					break;
				case MSG_OTA:
					ota_app_process();
					break;
			}
			if (msg.callback != NULL) {
				msg.callback(&msg, 0, NULL);
			}
			break;

		case OS_POLL_SEM:
			if (g_disp_active) {
				lvx_refr_all();
			}
			break;
		}

		thread_timer_handle_expired();
	}

	return 0;
}
```

## src/ota_app.h
```c
/*
 * Copyright (c) 2019 Actions Semiconductor Co., Ltd
 *
 * SPDX-License-Identifier: Apache-2.0
 */

/**
 * @file
 * @brief OTA application interface
 */

#ifndef __OTA_APP_H__
#define __OTA_APP_H__

int ota_app_init(void);
int ota_app_init_bluetooth(void);
bool ota_is_already_running(void);
bool ota_is_already_done(void);
int ota_app_process(void);
int ota_app_reboot(uint8_t temp_file_id);

#endif /* __OTA_APP_H__ */
```
