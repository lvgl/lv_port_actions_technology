#define SENSOR_FUNC_ADDR	(CONFIG_SRAM_BASE_ADDRESS)

  ER_SENSOR_FUNC SENSOR_FUNC_ADDR ALIGN 8 {
#ifdef CONFIG_SENSOR_ALGO_MOTION_CYWEE
    * (.cwm_sec.common_aml.p0)
    * (.cwm_sec.common_amh_proc.p3)
    *cwm_watch_handupdown* (+RO)
#ifdef CONFIG_SENSOR_ALGO_MOTION_CYWEE_IN_RAM
    *CWM_LIB_m4.lib (+RO)
    *fz_wm.l (+RO)
    *m_wm.l (+RO)
#endif
#endif
  }

  ER_SENSOR_DATA +0 ALIGN 8 {
    sensor_algo* (.data*)
    hr_algo* (.data*)
#ifdef CONFIG_SENSOR_ALGO_MOTION_CYWEE
    *CWM_LIB_DML_m4.lib (.data*)
    *CWM_LIB_m4.lib (.data*)
#endif
#ifdef CONFIG_SENSOR_ALGO_MOTION_SILAN
    *SL_Watch_Pedo_Kcal_Wrist_Sleep_Sway_L_Algorithm.lib (.data*)
    SL_Watch_Pedo_Kcal_Wrist_Sleep_Sway_L_Application* (.data*)
    sensor_port* (.data*)
#endif
#ifdef CONFIG_SENSOR_ALGO_HR_GH30X
    *hbd_communicate_M4.lib (.data*)
    *hbd_ctrl_M4.lib (.data*)
    gh3011* (.data*)
#endif
#ifdef CONFIG_SENSOR_ALGO_HR_VCARE
    *vcHrAlgoV623ForCM4F.lib (.data*)
    *vcSpo2AlgoV151_VP60A2_B_v2_ForCM4F.lib (.data*)
    *vcSportMotionAlgoV11ForCM4Flib (.data*)
	module_heart_vc_int* (.data*)
	vcHr02* (.data*)
#endif
#ifdef CONFIG_SENSOR_ALGO_HR_HX3605
    *m33_3605_small_lib_hrs_spo2.lib (.data*)
    hx3605* (.data*)
#endif
#ifdef CONFIG_SENSOR_ALGO_HR_HX3690
	*m4_3690_keil_20210513_12d.lib (.data*)
    hx3690* (.data*)
#endif
  }

  ER_SENSOR_BSS +0 ALIGN 8 {
    sensor_algo* (.bss*)
    hr_algo* (.bss*)
#ifdef CONFIG_SENSOR_ALGO_MOTION_CYWEE
    *CWM_LIB_DML_m4.lib (.bss*)
    *CWM_LIB_m4.lib (.bss*)
#endif
#ifdef CONFIG_SENSOR_ALGO_MOTION_SILAN
    *SL_Watch_Pedo_Kcal_Wrist_Sleep_Sway_L_Algorithm.lib (.bss*)
    SL_Watch_Pedo_Kcal_Wrist_Sleep_Sway_L_Application* (.bss*)
    sensor_port* (.bss*)
#endif
#ifdef CONFIG_SENSOR_ALGO_HR_GH30X
    *hbd_communicate_M4.lib (.bss*)
    *hbd_ctrl_M4.lib (.bss*)
    gh3011* (.bss*)
#endif
#ifdef CONFIG_SENSOR_ALGO_HR_VCARE
    *vcHrAlgoV623ForCM4F.lib (.bss*)
    *vcSpo2AlgoV151_VP60A2_B_v2_ForCM4F.lib (.bss*)
    *vcSportMotionAlgoV11ForCM4Flib (.bss*)
	module_heart_vc_int* (.bss*)
	vcHr02* (.bss*)
#endif
#ifdef CONFIG_SENSOR_ALGO_HR_HX3605
    *m33_3605_small_lib_hrs_spo2.lib (.bss*)
    hx3605* (.bss*)
#endif
#ifdef CONFIG_SENSOR_ALGO_HR_HX3690
    *m33_hx3690l_hrs_spo2_hrv.lib (.bss*)
    hx3690* (.bss*)
#endif
  }

