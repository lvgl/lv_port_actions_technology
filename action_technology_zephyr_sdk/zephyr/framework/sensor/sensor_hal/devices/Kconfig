## action_technology_zephyr_sdk/zephyr/framework/sensor/sensor_hal/devices/Kconfig
```kconfig
# Configuration options for Actions Sensor

# Copyright (c) 2020 Actions Technology Co., Ltd
# SPDX-License-Identifier: Apache-2.0

config SENSOR_ACC_LIS2DW12
	bool
	prompt "ACC Sensor LIS2DW12 Support"
	default n
	help
	This option enables actions sensor LIS2DW12.

config SENSOR_ACC_STK8321
	bool
	prompt "ACC Sensor STK8321 Support"
	default n
	help
	This option enables actions sensor STK8321.

config SENSOR_ACC_SC7A20
	bool
	prompt "ACC Sensor SC7A20 Support"
	default n
	help
	This option enables actions sensor SC7A20.

config SENSOR_ACC_QMA6100
	bool
	prompt "ACC Sensor QMA6100 Support"
	default n
	help
	This option enables actions sensor QMA6100.

config SENSOR_HR_GH3011
	bool
	prompt "HR Sensor GH3011 Support"
	default n
	help
	This option enables actions sensor GH3011.

config SENSOR_HR_VC9201
	bool
	prompt "HR Sensor VC9201 Support"
	default n
	help
	This option enables actions sensor VC9201.

config SENSOR_HR_VC9202
	bool
	prompt "HR Sensor VC9202 Support"
	default n
	help
	This option enables actions sensor VC9202.

config SENSOR_HR_HX3605
	bool
	prompt "HR Sensor HX3605 Support"
	default n
	help
	This option enables actions sensor HX3605.

config SENSOR_HR_HX3690
	bool
	prompt "HR Sensor HX3690 Support"
	default n
	help
	This option enables actions sensor HX3690.
		
config SENSOR_MAG_MMC5603NJ
	bool
	prompt "MAG Sensor MMC5603NJ Support"
	default n
	help
	This option enables actions sensor MMC5603NJ.

config SENSOR_BARO_ICP10125
	bool
	prompt "BARO Sensor ICP10125 Support"
	default n
	help
	This option enables actions sensor ICP10125.
```

## action_technology_zephyr_sdk/zephyr/soc/arm/actions/leopard/Kconfig.defconfig.leopard
```kconfig
# LEOPARD MCU configuration options

# Copyright (c) 2016 Linaro Limited.
# SPDX-License-Identifier: Apache-2.0

if SOC_LEOPARD

config SOC
	default "leopard"

config NUM_IRQS
	default 64

config SOC_SPICACHE_PROFILE
	bool "Enable SPI cache profile"
	default n
	help
	  Enable SPI cache profile for actions SoC

config SOC_SPICACHE_PROFILE_STAT
	bool "Enable SPI cache profile stat"
	default n
	help
	  Enable SPI cache profile stat for actions SoC

endif # SOC_LEOPARD
```

## action_technology_zephyr_sdk/zephyr/soc/arm/actions/leopard/Kconfig.series
```kconfig
# Copyright (c) 2016 Linaro Limited
# SPDX-License-Identifier: Apache-2.0

config SOC_SERIES_LEOPARD
	bool "LEOPARD Series MCU"
	select ARM
	select CPU_CORTEX_M33
	select CPU_CORTEX_M_HAS_DWT
	select CPU_HAS_FPU
	select SOC_FAMILY_ACTS
	select CPU_HAS_ARM_MPU
	select HAS_SWO
	select HAS_SYS_POWER_STATE_SLEEP_1
	select HAS_SYS_POWER_STATE_DEEP_SLEEP_1	
	help
	  Enable support for LEOPARD  MCU series
```

## action_technology_zephyr_sdk/zephyr/soc/arm/actions/leopard/Kconfig.soc
```kconfig
# Copyright (c) 2016 Linaro Limited.
# SPDX-License-Identifier: Apache-2.0

choice
	prompt "LEOPARD MCU Selection"
	depends on SOC_SERIES_LEOPARD

config SOC_LEOPARD
	bool "LEOPARD"

endchoice

if SOC_LEOPARD

config SOC_SPI0_USE_CK64M
	bool
	prompt "enable cpu spi0 to use CK64M clock source"
	default y
	help
		enable cpu spi0 to use CK64M clock source

config IRQ_VECTOR_IN_SRAM
	bool
	prompt "enable irq vector copy to sram"
	default n
	help
		enable irq vector copy to sram

config SLEEP_FUNC_IN_SRAM
	bool
	prompt "enable sleep func copy to sram"
	default y
	help
		enable sleep func copy to sram
config SOC_WKEN_BAT
	bool
	prompt "eanbel battery first conected to run system"
	default n
	help
		the battery is connected for the first time;if disable, battery first insert,system power off.

config SOC_NO_PSRAM
	bool
	prompt "indicate soc not integrate psram"
	default n
	help
		prompt  "indicate soc not integrate psram"

config SLEEP_SENSOR_RUN_ON_NOR
	bool
	prompt "enable sleep sensor algo run on NOR"
	default n
	help
		enable sleep sensor algo run on NOR

config SLEEP_TIMER_DEBUG
	bool
	prompt "enable sleep timestamp debug"
	default n
	help
		enable sleep timestamp debug

config SLEEP_UART_SILENT
	bool
	prompt "enable sleep uart silent"
	default n
	help
		enable sleep uart silent

config SLEEP_COPY_SRAM_FOR_SENSOR
	bool
	prompt "enable copy sram for sensor algo"
	default n
	help
		enable copy sram for sensor algo

config SLEEP_MEMORY_CHECK_INTEGRITY
	bool
	prompt "enable memory check integrity"
	default n
	help
		enable memory check integrity

config SLEEP_DISABLE_BT
	bool
	prompt "disable Bluetooth when deep sleep"
	default n
	help
		disable Bluetooth when deep sleep

config SYS_WAKELOCK
	bool
	prompt "System Wake Lock Support"
	depends on PM
	default n
	help
	This option enables actions system wake lock.

config CPU_PWRGAT
	bool
	prompt "support cpu power gating"
	default n
	help
	This option support cpu power gating

config S1ML_LITTLE_BIAS
	bool
	prompt "support s1ml little bias"
	default n
	help
	This option support s1ml little bias regulation

endif
```

## action_technology_zephyr_sdk/zephyr/subsys/debug/ramdump/Kconfig
```kconfig
# Copyright (c) 2020 Intel Corporation.
# SPDX-License-Identifier: Apache-2.0

config DEBUG_RAMDUMP
	bool
	prompt "Dump ram to flash"
	default n
	select EXTRA_EXCEPTION_INFO
	help
	  This option enable ram dump support.
```

## action_technology_zephyr_sdk/zephyr/subsys/sdfs/Kconfig
```kconfig
config SD_FS
	bool "SD File System"
	default n
	help
	Use the SD File system implementation.

config SD_FS_VADDR_START
	hex "SD File System start mapping addr"
	default 0xb000000
	depends on SD_FS
	help
	Use SD File System start mapping addr.

config SD_FILE_MAX
	int "SD File can open file max num"
	default 6
	depends on SD_FS
	help
	SD File open file allow  max num file.

config SD_FS_NAND_SD_STORAGE
	bool "SD File System can use nand/sd storage devices"
	default n
	depends on SD_FS
	help
	SD File System can use nand/sd storage devices.

config SD_FS_DATA_NOR_STORAGE
	bool "SD File System can use data nor storage devices"
	default n
	depends on SD_FS
	help
	SD File System can use data nor storage devices.

config SDFS_READ_BY_CACHE
	bool "sdfs nand or sd read data by cache"
	default n
	depends on SD_FS_NAND_SD_STORAGE
	help
	sdfs nand or sd read data by cache.

config SDFS_CACHE_BUF_LEN
	hex "nand sdfs cache buf len"
	default 0x200
	depends on SD_FS_NAND_SD_STORAGE
	help
	nand sdfs cache buf len.It has to be a multiple of 512

config SDFS_NOR_NOT_XIP
	bool "sdfs nor not support XIP"
	default n
	depends on SD_FS
	help
	SD File System not support XIP in NOR medium.

config SDFS_NOR_NOT_XIP_MAX_COPY_OFFSET
	hex "sdfs nor not XIP max flash offset copied by bootloader"
	default 0x200000
	depends on SDFS_NOR_NOT_XIP
	help
	Specify the max flash offset which copied by bootloader.

config SDFS_NOR_DEV_NAME
	string "sdfs nor binding device name"
	default "spi_flash"
	depends on SDFS_NOR_NOT_XIP
	help
	Specify the nor device name that binding by SDFS
```

## action_technology_zephyr_sdk/zephyr/west.yml
```yaml
manifest:
  projects:
  - name: cmsis
    url: ssh://192.168.4.4:29418/ZH/actions/ZSDK_HAL_CMSIS
    revision: b0612c97c1401feeb4160add6462c3627fe90fc7
    path: thirdparty/hal/cmsis
  - name: fatfs
    url: ssh://192.168.4.4:29418/ZH/actions/ZSDK_FS_FATFS
    revision: ZS308B_dev_v2.7
    path: thirdparty/fs/fatfs
  - name: lvgl
    url: ssh://192.168.4.4:29418/ZH/actions/ZSDK_LIB_LVGL
    revision: ZS308B_dev_lvgl_v9
    path: thirdparty/lib/gui/lvgl
  - name: alipay
    url: ssh://192.168.4.4:29418/ZH/actions/ZSDK_LIB_ALIPAY
    revision: ZS308B_dev_v2.7
    path: thirdparty/lib/alipay
  - name: alipay_wxpay
    url: ssh://192.168.4.4:29418/ZH/actions/ZSDK_LIB_ALIPAY_WXPAY
    revision: ZS308B_dev_v2.7
    path: thirdparty/lib/alipay_wxpay
  - name: aicxtek
    url:  ssh://192.168.4.4:29418/ZH/actions/ZSDK_LIB_AICXSERVICE
    revision: ZS308B_dev_v2.7
    path: thirdparty/lib/aicxtek
  - name: mbedtls
    url: ssh://192.168.4.4:29418/ZH/actions/ZSDK_CRYPTO_MBEDTLS
    revision: ZS308B_dev_v2.7
    path: thirdparty/crypto/mbedtls
  - name: segger
    url: ssh://192.168.4.4:29418/ZH/actions/ZSDK_DBG_SEGGER
    revision: 5ad7e8d3ebe737becf753c21b8078d73ae6667b3
    path: thirdparty/debug/segger
  - name: tinycrypt
    url: ssh://192.168.4.4:29418/ZH/actions/ZSDK_CRYPTO_TINYCRYPT
    revision: 9bdf43334d57a4c982acba7586336e69faeecc1a
    path: thirdparty/crypto/tinycrypt
  - name: littlefs
    url: ssh://192.168.4.4:29418/ZH/actions/ZSDK_FS_LITTLEFS
    revision: 9e4498d1c73009acd84bb36036ee5e2869112a6c
    path: thirdparty/fs/littlefs
  - name: bootloader
    url: ssh://192.168.4.4:29418/ZH/actions/ZSDK_BOOT_LOADER
    revision: ZS308B_dev_v2.7
  - name: framework_base
    url: ssh://192.168.4.4:29418/ZH/actions/ZSDK_LIB_FRAMEWORK_BASE
    revision: ZS308B_dev_v2.7
    path: framework/base
  - name: framework_system
    url: ssh://192.168.4.4:29418/ZH/actions/ZSDK_LIB_SYSTEM
    revision: ZS308B_dev_v2.7
    path: framework/system
  - name: audio
    url: ssh://192.168.4.4:29418/ZH/actions/ZSDK_LIB_AUDIO
    revision: ZS308B_dev_v2.7
    path: framework/audio
  - name: media
    url: ssh://192.168.4.4:29418/ZH/actions/ZSDK_LIB_MEDIA_BASE
    revision: ZS308B_dev_v2.7
    path: framework/media
  - name: ota
    url: ssh://192.168.4.4:29418/ZH/actions/ZSDK_LIB_OTA
    revision: ZS308B_dev_v2.7
    path: framework/ota
  - name: bluetooth
    url: ssh://192.168.4.4:29418/ZH/actions/ZSDK_LIB_BLUETOOTH
    revision: ZS308B_dev_v2.7
    path: framework/bluetooth
  - name: display
    url: ssh://192.168.4.4:29418/ZH/actions/ZSDK_LIB_DISPLAY
    revision: ZS308B_dev_lvgl_v9
    path: framework/display
  - name: usb
    url: ssh://192.168.4.4:29418/ZH/actions/ZSDK_LIB_USB
    revision: ZS308B_dev_v2.7
    path: framework/usb
  - name: sensor
    url: ssh://192.168.4.4:29418/ZH/actions/ZSDK_LIB_SENSOR
    revision: ZS308B_dev_v2.7
    path: framework/sensor
  - name: bt_watch
    url: ssh://192.168.4.4:29418/ZH/actions/ZSDK_APPLICATION_BT_WATCH
    revision: ZS308B_dev_lvgl_v9
    path: application/bt_watch
  - name: app_demo
    url: ssh://192.168.4.4:29418/ZH/actions/ZSDK_APPLICATION_DEMO
    revision: ZS308B_dev_lvgl_v9
    path: application/app_demo
  self:
    path: zephyr
    west-commands: scripts/west-commands.yml
```
