## CMakeLists.txt
```
# SPDX-License-Identifier: Apache-2.0

#list(APPEND ZEPHYR_EXTRA_MODULES ${CMAKE_CURRENT_SOURCE_DIR}/../../modules/framework)


cmake_minimum_required(VERSION 3.13.1)

find_package(Zephyr REQUIRED HINTS $ENV{ZEPHYR_BASE})
project(bt_watch)

add_subdirectory(src)
```

## Kconfig
```
# Kconfig - ACTIONS primitive options for sdk version 2.0

#
# Copyright (c) 2015 Intel Corporation
#
# Licensed under the Apache License, Version 2.0 (the "License");
# you may not use this file except in compliance with the License.
# You may obtain a copy of the License at
#
#     http://www.apache.org/licenses/LICENSE-2.0
#
# Unless required by applicable law or agreed to in writing, software
# distributed under the License is distributed on an "AS IS" BASIS,
# WITHOUT WARRANTIES OR CONDITIONS OF ANY KIND, either express or implied.
# See the License for the specific language governing permissions and
# limitations under the License.
#

mainmenu "BT Watch App"

source "Kconfig.zephyr"

menu "App Configuration"

config APP_PRIORITY
    int
    prompt "App Thread Priority"
    default 10
    help
    This option set app thread priority

config APP_STACKSIZE
    int
    prompt "App Thread Stack Size"
    default 2048
    help
    This option set stack size for app thread

config APP_UI_DISK
	string "drive name for ui resource"
	default "/SD:A"
	help
	  This option set driver name for ui resource

config APP_FAT_DISK
	string "drive name for fatfs"
	default "/SD:"
	help
	  This option set drive name for fatfs

rsource "src/ota_recovery/Kconfig"
endmenu
```

## prj.conf
```kconfig
# Kernel
CONFIG_MULTITHREADING=y
CONFIG_KERNEL_MEM_POOL=y
CONFIG_NUM_MBOX_ASYNC_MSGS=0
CONFIG_NUM_PIPE_ASYNC_MSGS=0
CONFIG_HOSC_CLK_MHZ=32
CONFIG_SYS_CLOCK_EXISTS=y
CONFIG_SYS_CLOCK_HW_CYCLES_PER_SEC=32000000
CONFIG_HEAP_MEM_POOL_SIZE=8192
CONFIG_MAIN_STACK_SIZE=10240
CONFIG_THREAD_MONITOR=y
CONFIG_SYSTEM_WORKQUEUE_STACK_SIZE=0

# Drivers and peripherals
CONFIG_I2C=n
CONFIG_WDOG_ACTS=y
CONFIG_WATCHDOG=y
CONFIG_WDT_MODE_RESET=y
CONFIG_GPIO=y
CONFIG_SPI=n
CONFIG_SERIAL=y
CONFIG_FLASH=y
CONFIG_DMA=y
CONFIG_ACTS_TIMER=y
CONFIG_ACTS_HRTIMER=n
CONFIG_UART_ACTS=y
CONFIG_GPIO_ACTS=y
CONFIG_IPMSG_ACTS=n
CONFIG_SPI_ACTS=y
CONFIG_DMA_SPINAND_RESEVER_CHAN=9
CONFIG_SOC_SPICACHE_PROFILE=n
CONFIG_DMA_ACTS=y
CONFIG_VDMA_ACTS=y
CONFIG_DMA_DBG_DUMP=n

# Interrupts
CONFIG_DYNAMIC_INTERRUPTS=n
CONFIG_IRQ_OFFLOAD=n

# Memory protection
CONFIG_ARM_MPU=n
CONFIG_THREAD_STACK_INFO=n
CONFIG_THREAD_CUSTOM_DATA=n
CONFIG_FPU=n

# Boot
CONFIG_BOOT_BANNER=n
CONFIG_BOOT_DELAY=0

# Console
CONFIG_CONSOLE=y
CONFIG_UART_CONSOLE=y
CONFIG_STDOUT_CONSOLE=n
CONFIG_PRINTK=y
CONFIG_EARLY_CONSOLE=n
CONFIG_ACTIONS_PRINTK_DMA=n
CONFIG_PRINTK_TIME_FREFIX=n
CONFIG_KERNEL_SHOW_STACK=n
CONFIG_KALLSYMS=n
CONFIG_ASSERT=n
CONFIG_CBPRINTF_COMPLETE_BROM=y

# Build
CONFIG_SIZE_OPTIMIZATIONS=y

# Disk and FS
CONFIG_SD_FS=y
CONFIG_SD_FS_NAND_SD_STORAGE=n
CONFIG_FLASH_MAP=n
CONFIG_STREAM_FLASH=n
CONFIG_DISK_ACCESS=y
CONFIG_DISK_ACCESS_SD=y
CONFIG_DISKIO_CACHE=n
CONFIG_FILE_SYSTEM=n
CONFIG_FAT_FILESYSTEM_ELM=n
CONFIG_FS_FATFS_MOUNT_MKFS=n
CONFIG_FS_FATFS_EXFAT=n
CONFIG_MEMORY=y
CONFIG_APP_USED_MEM_POOL=y

# Power
CONFIG_PM=n
CONFIG_PM_DEVICE=n
CONFIG_DEVICE_POWER_MANAGEMENT=n

CONFIG_LOG=y
CONFIG_LOG_MODE_MINIMAL=y
CONFIG_SHELL_DBG=n
CONFIG_NVRAM_CONFIG=y
CONFIG_INPUT_DEV=n
CONFIG_FIRMWARE_VERSION=n
CONFIG_PARTITION=n

# Debug
CONFIG_RUNTIME_NMI=n
CONFIG_FORCE_NO_ASSERT=y
CONFIG_FAULT_DUMP=0

# Display
CONFIG_DISPLAY=y
CONFIG_DISPLAY_CONTROLLER=y
CONFIG_DISPLAY_ENGINE=n
CONFIG_DMA2D_HAL=n

#ota config
CONFIG_OTA=y
CONFIG_OTA_RECOVERY=y
CONFIG_OTA_RECOVERY_APP=y
CONFIG_OTA_UPGRADE=y
CONFIG_OTA_APP=n
CONFIG_OTA_BACKGROUND=n
CONFIG_OTA_FOREGROUND=n
CONFIG_OTA_BACKEND_SDCARD=n
CONFIG_OTA_BACKEND_BLUETOOTH=n
CONFIG_OTA_BACKEND_TEMP_PART=y
CONFIG_OTA_RES_PATCH=n

#framework
CONFIG_ACTIONS_FRAMEWORK=y
CONFIG_ACTIONS_UTILS=n
CONFIG_UI_MANAGER=n

#ota app
CONFIG_FLASH_LOAD_OFFSET=0
```

## src/main.c
```c
/*
 * Copyright (c) 2012-2014 Wind River Systems, Inc.
 *
 * SPDX-License-Identifier: Apache-2.0
 */

#include <kernel.h>
#include <device.h>
#include <string.h>
#include <soc.h>
#include <recovery.h>
#include <board_cfg.h>
#include <partition/partition.h>
#ifdef CONFIG_WATCHDOG
#include <watchdog_hal.h>
#endif

extern void boot_to_application(void);
extern void boot_to_ota_app(void);

int check_adfu(void)
{
	#if IS_ENABLED(CONFIG_TXRX_ADFU)
	if(check_adfu_connect(CONFIG_ADFU_TX_GPIO, CONFIG_ADFU_RX_GPIO))
		return 1;
	#endif
	#if IS_ENABLED(CONFIG_GPIO_ADFU)
	if(check_adfu_gpiokey(CONFIG_ADFU_KEY_GPIO))
		return 1;
	#endif	
	return 0;
}

int main(void)
{
	u32_t jtag_flag = 0;
	u16_t reboot_type;
	u8_t reason;
	//soc_watchdog_clear();
#ifdef CONFIG_WATCHDOG
	watchdog_clear();
#endif
	if(partition_valid_check()){		
		printk("part invalid,go to ota\n");
		goto exit_to_ota;
	}
	sys_pm_get_reboot_reason(&reboot_type, &reason);
	printk("reboot_type0x%x, reason=0x%x\n", reboot_type, reason);
	if(reboot_type == REBOOT_TYPE_GOTO_OTA){		
		printk("reboot to ota\n");
		goto exit_to_ota;
	}
		
	if(check_adfu()){
		jtag_set();
		soc_pstore_set(SOC_PSTORE_TAG_FLAG_JTAG, 1);
		sys_pm_reboot(REBOOT_TYPE_GOTO_ADFU);
	}
	soc_pstore_get(SOC_PSTORE_TAG_FLAG_JTAG, &jtag_flag);
	if(jtag_flag){
		printk("jtag switch\n");
		jtag_set();
	}

	if (ota_upgrade_is_allowed()) {
#if CONFIG_FLASH_LOAD_OFFSET
		boot_to_ota_app();
#endif
		recovery_main();		
	}
	//soc_watchdog_clear();
#ifdef CONFIG_WATCHDOG
	watchdog_clear();
#endif
	boot_to_application();
	sys_pm_reboot(REBOOT_TYPE_GOTO_OTA);
exit_to_ota:	
	// boot fail enter ota
	if(ota_main())// ota fail reboot adfu
		sys_pm_reboot(REBOOT_TYPE_GOTO_ADFU);
	else // ota ok reboot system
		sys_pm_reboot(REBOOT_TYPE_NORMAL);

	return 0;
}
```
