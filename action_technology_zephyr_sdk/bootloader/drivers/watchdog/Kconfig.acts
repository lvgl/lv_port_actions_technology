## action_technology_zephyr_sdk/thirdparty/lib/aicxtek/Kconfig
```kconfig
config USING_AICXTEK_LIB
	bool
	prompt "Enable using aicxtek lib"
    default n
    help
    This option choose aicstek lib
```
