## action_technology_zephyr_sdk/framework/usb/class/Kconfig
```kconfig
# Kconfig - USB class drivers configuration options

#
# Copyright (c) 2016 Wind River Systems, Inc.
#
# SPDX-License-Identifier: Apache-2.0
#

if USB_DEVICE_STACK

config USB_CDC_ACM
	bool "USB CDC ACM device class driver"
	default n
	help
	  USB CDC ACM device class driver.

if USB_CDC_ACM

config CDC_ACM_PORT_NAME
	string "CDC ACM class device driver port name"
	depends on USB_CDC_ACM
	default "CDC_ACM"
	help
	  Port name through which CDC-ACM class device driver is accessed.

config CDC_ACM_INTERRUPT_EP_ADDR
	hex "CDC ACM class interrupt IN endpoint address"
	depends on USB_CDC_ACM
	default 0x82
	range 0x81 0x8f
	help
	  CDC ACM class interrupt IN endpoint address

config CDC_ACM_INTERRUPT_EP_MPS
	int "CDC ACM class (full-speed) interrupt IN endpoint size"
	depends on USB_CDC_ACM
	default 16
	help
	  CDC ACM class full-speed interrupt IN endpoint size.

config CDC_ACM_INTERRUPT_EP_INTERVAL
	hex "CDC ACM class (full-speed) interrupt IN endpoint interval"
	depends on USB_CDC_ACM
	default 0x0a
	range 0x01 0xff
	help
	  CDC ACM class full-speed interrupt IN endpoint interval.

config CDC_ACM_HS_INTERRUPT_EP_INTERVAL
	hex "CDC ACM class (high-speed) interrupt IN endpoint interval"
	depends on USB_CDC_ACM
	default 0x6
	range 0x01 0x10
	help
	  CDC ACM class high-speed interrupt IN endpoint interval.

config CDC_ACM_BULK_IN_EP_ADDR
	hex "CDC ACM class bulk IN endpoint address"
	depends on USB_CDC_ACM
	default 0x81
	range 0x81 0x8f
	help
	  CDC ACM class bulk IN endpoint address

config CDC_ACM_BULK_OUT_EP_ADDR
	hex "CDC ACM class bulk OUT endpoint address"
	depends on USB_CDC_ACM
	default 0x01
	range 0x01 0x0f
	help
	  CDC ACM class bulk OUT endpoint address

config CDC_ACM_BULK_EP_MPS
	int "CDC ACM class (full-speed) bulk endpoints size"
	depends on USB_CDC_ACM
	default 64
	range 8 64
	help
	  CDC ACM class full-speed bulk endpoints size

config SYS_LOG_USB_CDC_ACM_LEVEL
	int "USB CDC ACM device class driver log level"
	depends on USB_CDC_ACM && LOG
	default 0
	help
	  Sets log level for USB CDC ACM device class driver

	  Levels are:

	  - 0 OFF, do not write

	  - 1 ERROR, only write SYS_LOG_ERR

	  - 2 WARNING, write SYS_LOG_WRN in addition to previous level

	  - 3 INFO, write SYS_LOG_INF in addition to previous levels

	  - 4 DEBUG, write SYS_LOG_DBG in addition to previous levels

config USB_CDC_ACM_MANUFACTURER
	string
	prompt "USB cdc acm device manufacture string"
	default "Actoins"
	help
	  USB cdc acm device manufacturer string, can be configured by vendor.

config USB_CDC_ACM_PRODUCT
	string
	prompt "usb cdc acm device product string"
	default "USB-CDC-ACM"
	help
	  USB cdc acm device product string, can be configured by vendor.

config USB_CDC_ACM_SN
	string
	prompt "USB cdc acm device serial-number string"
	default "0123456789AB"
	help
	  USB cdc acm device serial-number string, can be configured by vendor.

config USB_CDC_ACM_SN_NVRAM
	string
	prompt "get serial number from NVRAM"
	default "BT_MAC"
	help
	  get USB cdc_acm device serial number string from NVRAM, can be configured by vendor.

endif #USB_CDC_ACM

config USB_MASS_STORAGE
	bool
	prompt "USB mass storage device class driver"
	depends on FAT_FILESYSTEM_ELM
	select DISK_ACCESS
	default n
	help
	  USB mass storage device class driver.

if USB_MASS_STORAGE

config USB_MASS_STORAGE_SHARE_THREAD
	bool "USB mass storage thread is shared"
	depends on USB_MASS_STORAGE
	default n
	help
	  USB Mass Storage thread is shared

config MASS_STORAGE_DISK_NAME
	string "Mass storage disk or drive name"
	depends on USB_MASS_STORAGE
	default "NO_LUN"
	help
	  Mass storage device disk or drive name

config MASS_STORAGE_DISK_PDRV
	hex
	prompt "Mass storage disk or drive number"
	depends on USB_MASS_STORAGE
	default 0xff
	help
	  Mass storage device disk or drive number

	  pdrv numbers are:

	  - 0 NOR

	  - 1 NAND

	  - 2 PSRAM

	  - 3 USB

	  - 4 SD

	  - 5 RAM

	  - 0xff NO_LUN

config MASS_STORAGE_STACK_SIZE
	int "USB Mass Storage stack size"
	depends on USB_MASS_STORAGE
	default 1024
	help
	  USB Mass Storage stack size

config MASS_STORAGE_PRIORITY
	int "USB Mass Storage thread priority"
	depends on USB_MASS_STORAGE
	default -5
	help
	  USB Mass Storage thread priority

config MASS_STORAGE_BUF_SIZE
	int "USB Mass Storage buffer size"
	depends on USB_MASS_STORAGE
	default 512
	range 512 131072
	help
	  USB Mass Storage buffer size should be multiple of 512

config MASS_STORAGE_IN_EP_ADDR
	hex "Mass storage bulk IN endpoint size"
	depends on USB_MASS_STORAGE
	default 0x84 if SOC_SERIES_LARK
	range 0x81 0x8f
	help
	   Mass storage bulk IN endpoint address

config MASS_STORAGE_OUT_EP_ADDR
	hex "Mass storage bulk OUT endpoint address"
	depends on USB_MASS_STORAGE
	default 0x04 if SOC_SERIES_LARK
	range 0x01 0x0f
	help
	  Mass storage bulk OUT endpoint address

config MASS_STORAGE_BULK_EP_MPS
	int
	prompt "Mass storage full-speed bulk endpoints size"
	depends on USB_MASS_STORAGE
	default 64
	range 8 64
	help
	  Mass storage device class full-speed bulk endpoints size

config MASS_STORAGE_WP
	bool
	prompt "Mass storage write protect"
	depends on USB_MASS_STORAGE
	default n
	help
	  Enable Mass storage write protect

config MASS_STORAGE_SWITCH_TO_ADFU
	bool
	prompt "Mass storage switch to ADFU"
	depends on USB_MASS_STORAGE
	default y
	help
	  Enable Mass storage switch to ADFU

config SYS_LOG_USB_MASS_STORAGE_LEVEL
	int
	prompt "USB Mass Storage device class driver log level"
	depends on USB_MASS_STORAGE && LOG
	default 0
	help
	  Sets log level for USB Mass Storage device class driver

	  Levels are:

	  - 0 OFF, do not write

	  - 1 ERROR, only write SYS_LOG_ERR

	  - 2 WARNING, write SYS_LOG_WRN in addition to previous level

	  - 3 INFO, write SYS_LOG_INF in addition to previous levels

	  - 4 DEBUG, write SYS_LOG_DBG in addition to previous levels

config MASS_STORAGE_MANUFACTURER
	string
	prompt "USB Mass Storage device manufacturer string"
	depends on USB_MASS_STORAGE
	default "Actions"
	help
	  USB Mass Storage device manufacturer string

config MASS_STORAGE_PRODUCT
	string
	prompt "USB Mass Storage device product string"
	depends on USB_MASS_STORAGE
	default "MSC Sample"
	help
	  USB Mass Storage device product string

config MASS_STORAGE_SN
	string
	prompt "USB Mass Storage device serial number string"
	depends on USB_MASS_STORAGE
	default "0.01"
	help
	  USB Mass Storage device serial number string
endif #USB_MASS_STORAGE

rsource "audio/Kconfig"
rsource "stub/Kconfig"
rsource "hid/Kconfig"
rsource "dfu/Kconfig"

endif #USB_DEVICE_STACK
```
