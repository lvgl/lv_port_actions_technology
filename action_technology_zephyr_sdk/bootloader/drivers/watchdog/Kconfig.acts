## action_technology_zephyr_sdk/bootloader/drivers/watchdog/Kconfig.acts
```kconfig
# ADC configuration options

# Copyright (c) 2021 Actions Semiconductor Co., Ltd
# SPDX-License-Identifier: Apache-2.0

menuconfig WDOG_ACTS
	bool "Actions SoC Watchdog (WDT) Driver"
	depends on SOC_FAMILY_ACTS
	default n
	help
	  Enable watchdog driver for Actions SoC.

config WDT_ACTS_NAME
	string "Watchdog Driver's name"
	depends on WDOG_ACTS
	default "WDT_0"

config WDT_ACTS_START_AT_BOOT
	bool "Start Watchdog during boot"
	depends on WDOG_ACTS
	default n
	help
	  Enable this setting to allow WDOG to be automatically started
	  during device initialization. Note that once WDOG is started
	  it must be reloaded before the counter reaches 0, otherwise
	  the MCU will be reset.

config WDT_ACTS_OVERFLOW_TIME
	int "actions watchdog overflow time"
	depends on WDOG_ACTS
	default 10000
	help
	  Set the name used by WDT device during registration.

config WDT_MODE_RESET
	bool "actions watchdog overflow reset or not"
	depends on WDOG_ACTS
	default n
	help
	  Set watchdog overflow reset or interrupt
```

## action_technology_zephyr_sdk/bootloader/framework/key/Kconfig
```kconfig
# Configuration options for Actions DSP

# Copyright (c) 2020 Actions Technology Co., Ltd
# SPDX-License-Identifier: Apache-2.0

menuconfig DSP
	bool "DSP Drivers"
	help
	  Enable dsp drivers

if DSP

config DSP_ACTS_DEV_NAME
	string "Device name of DSP Controller"
	default "DSP_LARK"
	help
	  Device name of DSP Controller

config DSP_ACTIVE_POWER_LATENCY_MS
	int "dsp active power latency in milliseconds"
	default -1
	help
	  Set the latency of power-off dsp after dsp became idle. Set negative (< 0)
	  if you want to disable this feature.

config DSP_DEBUG_PRINT
    bool "enable dsp debug print"
    default n
    help
       enable dsp debug print

endif # DSP
```

## action_technology_zephyr_sdk/bootloader/framework/memory/Kconfig
```kconfig
# Configuration options for Actions DSP

# Copyright (c) 2020 Actions Technology Co., Ltd
# SPDX-License-Identifier: Apache-2.0

menuconfig MEMORY
	bool "memory hal"
	help
	  Enable memory hal

if MEMORY

config MEMORY_SLABS
	bool "enable memory slabs"
	default n
	help
	  enable memory slabs

endif # MEMORY
```

## action_technology_zephyr_sdk/bootloader/kernel/Kconfig.acts
```kconfig
# Kernel configuration options

# Copyright (c) 2014-2015 Wind River Systems, Inc.
# SPDX-License-Identifier: Apache-2.0

menu "Actions Kernel Options"

config DEVICE_DEBUG
	bool "Device runtime debug"
	default y
	help
	  This option enables device debug code in kernel.

endmenu
```

## action_technology_zephyr_sdk/bootloader/soc/arm/actions/Kconfig.soc
```kconfig
# Copyright (c) 2016 Open-RnD Sp. z o.o.
# SPDX-License-Identifier: Apache-2.0

source "soc/arm/actions/*/Kconfig.series"
```

## action_technology_zephyr_sdk/framework/audio/Kconfig
```kconfig
# Kconfig - Actions audio

#
# Copyright (c) 2016 Actions Corporation
#
# SPDX-License-Identifier: Apache-2.0
#

menuconfig AUDIO
	bool
	prompt "Audio"
	select VOLUME_MANAGER
	select AUDIO_IN
	select AUDIO_OUT
	default n
	help
	This option enables actions audio
	
config VOLUME_MANAGER
	bool
	prompt "actions volume manager"
	depends on AUDIO
	default n
	help
	This option enables actions actions volume manager.

config AUDIO_VOICE_HARDWARE_REFERENCE
	bool
	prompt "actions voice hardware reference"
	depends on AUDIO
	default y
	help
	This option enablesactions voice hardware reference.
```

## action_technology_zephyr_sdk/framework/bluetooth/Kconfig
```kconfig
# Kconfig - ACTIONS primitive options for sdk version 2.0

#
# Copyright (c) 2015 Intel Corporation
#
# Licensed under the Apache License, Version 2.0 (the "License");
# you may not use this file except in compliance with the License.
# You may obtain a copy of the License at
#
#     http://www.apache.org/licenses/LICENSE-2.0
#
# Unless required by applicable law or agreed to in writing, software
# distributed under the License is distributed on an "AS IS" BASIS,
# WITHOUT WARRANTIES OR CONDITIONS OF ANY KIND, either express or implied.
# See the License for the specific language governing permissions and
# limitations under the License.
#

if ACTIONS_FRAMEWORK

config BT_STACK
	bool
	prompt "Blutooth Stack Support"
	default n
	help
	This option enables actions Blutooth Stack.

rsource "bt_stack/Kconfig"

menuconfig BLUETOOTH
	bool
	prompt "BlueTooth"
	default n
	select BT_MANAGER
	help
	This option enables actions bluetooth funcion.

config BT_MANAGER
    bool
    prompt "Bt Manager Support"
	select BT_SERVICE
	select BT_STACK
	select BLUETOOTH_PORTING
	select ACTS_TRANSCODE
    default n
    help
    This option enables bt manager.

config BT_SERVICE
	bool
	prompt "Blutooth Service Support"
	select THREAD_TIMER
	default n
	help
	This option enables actions Blutooth service.

config BTSRV_PRIORITY
    int
    prompt "bt Service Thread Priority"
    default 2
    depends on BT_SERVICE
    help
    This option set bt thread priority 

config BTSRV_STACKSIZE
    int
    prompt "bt Service Thread Stack Size"
    default 1536
    depends on BT_SERVICE
    help
    This option set stack size for bt service thread	  

config BT_DOUBLE_PHONE
    bool
    prompt "Bt double phone Support"
	depends on BT_MANAGER
    default n
    help
    This option enables Bt double phone manager.

config BT_DOUBLE_PHONE_EXT_MODE
    bool
    prompt "Bt double phone ext mode Support"
    depends on BT_DOUBLE_PHONE
    default n
    help
    This option enables Bt double phone ext mode Support.

config BT_DOUBLE_PHONE_PREEMPTION_MODE
    bool
    prompt "Bt double phone preemption mode Support"
    depends on BT_DOUBLE_PHONE
    default n
    help
    This option enables Bt double phone preemption mode Support.

config BT_BLE
    bool
    prompt "Bt Ble Support"
	depends on BT_MANAGER
	depends on BT_LE_ATT
    default n
    help
    This option enables bt manager.

config BLE_MASTER
	bool
	prompt "Bt ble master Support"
	depends on BT_BLE
	default n
	help
	This option enable or disable ble master

config ACTIVE_REQ_BLE_ENC
	bool
	prompt "Active request encryption after connected"
	depends on BT_BLE
	default n
	help
	This option enables active request encryption after connected.

config BT_AVRCP_GET_ID3
    bool
    prompt "Bt avrcp get ID3 Support"
    depends on BT_AVRCP
    default n
    help
    This option enables Bt avrcp get ID3 .


config BT_A2DP_AAC
    bool
    prompt "Bt a2dp aac Support"
	depends on BT_MANAGER
    default n
    help
    This option enables bt a2dp aac.

config BT_A2DP_MAX_BITPOOL
    int
    prompt "Bt a2dp bit pool config"
	depends on BT_A2DP
    default 53
    help
    This option enables bt a2dp bit pool.

config SCO_SEND_USED_WORKQUEUE
    bool
    prompt "Use workqueue send sco data"
    depends on BT_SERVICE
    default n
    help
    This option use workqueue send sco data.

config BT_DEV_NAME
    string
    prompt "bt device name"
    depends on BT_MANAGER
    help
    This option specifies bt device classic name

config TWS
    bool
    prompt "bt manager Support tws"
	depends on BT_MANAGER
    default n
    help
    This option enables bt tws.

config TWS_MONO_MODE
    bool
    prompt "bt manager Support tws mono mode"
	depends on TWS
    default n
    help
    This option enables bt tws mono mode.

config TWS_BACKGROUND_BT
    bool
    prompt "bt manager Support local tws support background bt"
	depends on TWS
    default n
    help
    This option enables local tws support background bt.

config BT_HFP_TWS
    bool
    prompt "bt manager Support hfp tws"
    depends on TWS
    default n
    help
    This option enables bt hfp tws.

config CSB
    bool
    prompt "bt manager Support csb"
	depends on BT_MANAGER
    default n
    help
    This option enables bt csb.

config MGR_TEST_SAMPLE
    bool
    prompt "bt manager test sample"
	depends on BT_MANAGER
    default n
    help
    This option enables bt manager test sample.

config BT_A2DP_TRS
    bool
    prompt "bt manager Support a2dp trs"
	depends on BT_MANAGER
    default n
    help
    This option enables a2dp trs.

config BT_A2DP_SINK
    bool
    prompt "bt manager Support a2dp sink"
    depends on BT_MANAGER
    default y
    help
    This option enables a2dp sink device.

config BT_MANAGER_DEINIT_SERVICE
    bool
    prompt "bt manager deinit btsrv"
	depends on BT_MANAGER
    default n
    help
    This option enables bt manager service.

config BT_BLE_NOTIFY_PENDING
    bool
    prompt "bt ble notify pending"
    depends on BT_MANAGER
    default n
    help
    This option enables bt ble notify pending.

config BT_BLE_APP_UPDATE_PARAM
    bool
    prompt "App responsible for update ble parameter"
	depends on BT_MANAGER
    default n
    help
    This option request app responsible for update ble parameter.

config BT_ACTIONS_SUPER_SERVICE
    bool
    prompt "enable actions super service"
	depends on BT_MANAGER
    default n
    help
    This option enables bt super service.

config BT_ANCS_AMS
	bool
	prompt "Bt ancs ams Support"
	default n
	select BT_SMP_ALLOW_UNAUTH_OVERWRITE
	select BT_KEYS_OVERWRITE_OLDEST
	select BT_GATT_CLIENT
	select BT_CENTRAL
	select BT_DIS
	help
	This option enable or disable ancs_ams

config CONNECT_ANCSAMS_AFTER_ENC
	bool
	prompt "Discover and connect ANCS/AMS after ble encrypted"
	depends on BT_ANCS_AMS
	default y
	help
	This option set discover and connect ANCS/AMS after ble encrypted.

config BT_TEMP_COMPENSATION
    bool
    prompt "bt temp compensation"
	depends on BT_MANAGER
    default y
    help
    This option enables bt temp compensation.

config BT_AUDIO_TEST
    bool
    prompt "bt audio test"
	depends on BT_MANAGER
    default n
    help
    This option enables bt audio test.

config GATT_OVER_BREDR
    bool "Bluetooth support gatt over BREDR"
    depends on BT_BREDR
    default n
    help
    This option enables Bluetooth gatt over BREDR

config BT_LINK_MISS_REJECT
    bool "Bluetooth reject after linkkey miss"
    depends on BT_SERVICE
    default n
    help
    This option enables Bluetooth

config BT_PNP_INFO_SEARCH
    bool "Bluetooth SDP pnp info get"
    depends on BT_SERVICE
    default n
    help
    This option enables Bluetooth

config BR_SDP_ACTIVE_REGISTER
    bool "Bluetooth sdp active register"
    depends on BT_SERVICE
    default n
    help
    This option enables Bluetooth

config OTA_GATT_OVER_EDR_TEST
    bool "OTA support gatt over edr"
    depends on BT_SERVICE
    default n
    help
    This option enables Bluetooth

config BT_DEVICE_ENCRYPT_FORCE
    bool "Bluetooth all profile to be encrypt force"
    depends on BT_SERVICE
    default n
    help
    This option enables Bluetooth

config BT_BREDR_DISABLE
    bool "Disable Bluetooth BREDR"
    depends on BT_SERVICE
    default n
    help
    This option enables Bluetooth

config BT_BLE_IPS
    bool "InterPhone"
    depends on BT_MANAGER
    default n
    help
    This option enables InterPhone

if BT_A2DP_TRS

rsource "bt_trans/Kconfig"

endif #BT_A2DP_TRS

endif #ACTIONS_FRAMEWORK
```

## action_technology_zephyr_sdk/framework/bluetooth/bt_stack/Kconfig.buf
```kconfig
# Kconfig - net stack configuration options

#
# Copyright (c) 2015 Intel Corporation
#
# SPDX-License-Identifier: Apache-2.0
#

if ACTS_NET_BUF

config NET_BUF_USER_DATA_SIZE
	int "Size of user_data available in every network buffer"
	default 8 if (BT || NET_TCP2) && 64BIT
	default 4
	range 4 65535 if BT || NET_TCP2
	range 0 65535
	help
	  Amount of memory reserved in each network buffer for user data. In
	  most cases this can be left as the default value.

config NET_BUF_POOL_USAGE
	bool "Network buffer pool usage tracking"
	help
	  Enable network buffer pool tracking. This means that:
	  * amount of free buffers in the pool is remembered
	  * total size of the pool is calculated
	  * pool name is stored and can be shown in debugging prints

endif
```

## action_technology_zephyr_sdk/framework/display/font/freetype/Kconfig
```kconfig
# Copyright (c) 2018-2019 Jan Van Winkel <jan.van_winkel@dxplore.eu>
# SPDX-License-Identifier: Apache-2.0

menuconfig FREETYPE
	bool "Freetype library"
	help
	  This option enables the freetype library.

if FREETYPE

module = FREETYPE
module-str = freetype

choice
	prompt "Memory pool"
	default FREETYPE_MEM_POOL_USER
	help
	  Memory pool to use for freetype allocated objects

	config FREETYPE_MEM_POOL_HEAP_KERNEL
		bool "Kernel Heap"
		depends on HEAP_MEM_POOL_SIZE != 0
		help
		  Use k_malloc and k_free to allocate objects on the kernel heap

	config FREETYPE_MEM_POOL_HEAP_LIB_C
		bool "C library Heap"
		depends on !MINIMAL_LIBC || (MINIMAL_LIBC_MALLOC_ARENA_SIZE != 0)
		help
		  Use C library malloc and free to allocate objects on the C library heap

	config FREETYPE_MEM_POOL_KERNEL
		bool "Kernel space freetype pool"
		help
		  Use a dedicated memory pool in kernel space to allocate freetype objects
		  on

	config FREETYPE_MEM_POOL_USER
		bool "User space freetype pool"
		help
		  Use a dedicated memory pool in user space to allocate freetype objects on

endchoice

if FREETYPE_MEM_POOL_KERNEL || FREETYPE_MEM_POOL_USER

config FREETYPE_MEM_POOL_MIN_SIZE
	int "Minimum memory pool block size"
	default 16
	help
	  Size of the smallest block in the memory pool in bytes

config FREETYPE_MEM_POOL_MAX_SIZE
	int "Maximum memory pool block size"
	default 32768
	help
	  Size of the largest block in the memory pool in bytes

config FREETYPE_MEM_POOL_NUMBER_BLOCKS
	int "Number of max size blocks in memory pool"
	default 1
	help
	  Number of maximum sized blocks in the memory pool

endif

config APP_LINK_WITH_FREETYPE
	bool "Link 'app' with Freetype"
	default y
	help
	  Add Freetype header files to the 'app' include path. It may be
	  disabled if the include paths for Freetype are causing aliasing
	  issues for 'app'.

endif # FREETYPE
```

## action_technology_zephyr_sdk/framework/display/memory/Kconfig
```kconfig
# Kconfig - Actions memory manager

#
# Copyright (c) 2016 Actions Corporation
#
# SPDX-License-Identifier: Apache-2.0
#

menuconfig UI_MEMORY_MANAGER
	bool "ui memory manager"
	help
	  This option enables ui memory manager

if UI_MEMORY_MANAGER

config UI_MEM_BLOCK_SIZE
	int "Block size (in bytes)"
	default 32
	help
	  This option specifies the size of block in bytes.

config UI_MEM_NUMBER_BLOCKS
	int "Number of Blocks"
	default 0
	help
	  This option specifies the block number. A value of zero
	  means that no framebuffer block is defined.

config UI_GUI_MEM_POOL_SIZE
	int "GUI memory pool size (in bytes)"
	default 0
	help
	  This option specifies the size of the GUI memory pool. A size of zero
	  means that no GUI memory pool is defined.

config UI_RES_MEM_POOL_SIZE
	int "Resource memory pool size (in bytes)"
	default 0
	help
	  This option specifies the size of the resource memory pool. A size of
	  zero means that no resource memory pool is defined.

config UI_MEM_VDB_SHARE_SURFACE_BUFFER
	bool "vdb buffer share with sram suface buffer"
	default n
	help
	  This option specifies vdb share with sram surface buffer.

config UI_MEMORY_DEBUG
	bool "ui memory debug"
	depends on MEM_GUARD
	help
	  This option enables ui memory debug

endif # UI_MEMORY_MANAGER
```
