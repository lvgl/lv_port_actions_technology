## action_technology_zephyr_sdk/framework/display/res_manager/Kconfig
```kconfig
# Kconfig - Actions resource manager

#
# Copyright (c) 2016 Actions Corporation
#
# SPDX-License-Identifier: Apache-2.0
#

menuconfig RES_MANAGER
	bool "res_manager library"
	depends on UI_MEMORY_MANAGER
	help
	  This option enables the res_manager library.

if RES_MANAGER

config RES_MANAGER_DISABLE_AUTO_SEARCH_FILES
	bool "disable auto search for updated res files"
	default y
	help
	  This option disables auto search for updated res files on incremental update

config RES_PRELOAD_MAX_BLOCK_SIZE
	int "max block size for res manager preload compact block"
	default 102400
	help
	  This option set max block size for res manager preload compact block
	  
config RES_MANAGER_ENABLE_MEM_LEAK_DEBUG
	bool "enable resource unload check in res manager"
	default n
	help
	  This option enables pic resource unload check in res manager

config RES_MANAGER_USE_STYLE_MMAP
	bool "enable mmap style file in res manager"
	default n
	help
	  This option enables mmap style file in res manager

config RES_MANAGER_SKIP_PRELOAD
	bool "makes preload do layout directly in res manager"
	default n
	help
	  This option makes preload do layout directly in res manager

config RES_MANAGER_ALIGN
	int "set picture resource mem align, default is 4"
	default 4
	help
	  This option set picture resource mem align  

config RES_MANAGER_IMG_DECODER
	bool "enable lvgl use res manager as an image decoder"
	default n
	help
	  This option enables lvgl to use res manager as an image decoder

config RES_MANAGER_RES_DISK
	string "drive name for picture resource"
	default "/SD:A"
	help
	  This option set driver name for picture resource

config RES_MANAGER_BLOCK_SIZE
	int "set block size for big pictures"
	default 0
	help
	  This option set block size for big pictures

config RES_MANAGER_BLOCK_NUM
	int "set block size for big pictures"
	default 0
	help
	  This option set block size for big pictures


endif # RES_MANAGER
```

## action_technology_zephyr_sdk/framework/media/Kconfig
```kconfig
# Kconfig - Actions media player

#
# Copyright (c) 2016 Actions Corporation
#
# SPDX-License-Identifier: Apache-2.0
#

menuconfig MEDIA
	bool
	prompt "media"
	imply MEDIA_PLAYER
	default n
	help
	This option enables actions media

config MEDIA_PLAYER
	bool
	prompt "media player Support"
	depends on MEDIA
	select MEDIA_SERVICE
	select STREAM
	select MEDIA_EFFECT
	select SECTION_OVERLAY
	default n
	help
	This option enables actions media player

config MEDIA_SERVICE
	bool
	prompt "Media Service Support"
	select THREAD_TIMER
	select AUDIO_SYSTEM
	select ACTIONS_LIBRARY
	select ACTIONS_ALGORITHMS_LIBRARY
	select ACTS_EBERGY_STATISTICS
	select DSP
	select DSP_HAL
	select ACTIONS_DECODER
	select ACTIONS_ENCODER
	select AUDIO
	default n
	help
	This option enables actions Media service.

config MEDIASRV_PRIORITY
    int
    prompt "Media Service Thread Priority"
    default 1
    depends on MEDIA_SERVICE
    help
    This option set audio thread priority  

config MEDIASRV_STACKSIZE
    int
    prompt "Media Service Thread Stack Size"
    default 2048
    depends on MEDIA_SERVICE
    help
    This option set stack size for audio service thread	 


config MEDIA_EFFECT
	bool
	prompt "media effect Support"
	depends on MEDIA_PLAYER
	default n
	help
	This option enables actions media effect

config MEDIA_EFFECT_OUTMODE
	int
	prompt "media effect output mode Support"
	depends on MEDIA_PLAYER
	default 0
	help
	This option enables actions media output mode 

config MUSIC_EFFECT
	bool
	prompt "music effect Support"
	depends on MEDIA_PLAYER
	select MEDIA_EFFECT
	select MUSIC_DAE
	select MUSIC_DAE_FADE
	default n
	help
	This option enables actions music effect

config MUSIC_DRC_EFFECT
	bool
	prompt "music drc effect Support"
	depends on MUSIC_EFFECT
	select MEDIA_EFFECT
	default n
	help
	This option enables actions music drc effect

config VOICE_EFFECT
	bool
	prompt "voice effect Support"
	depends on MEDIA_EFFECT
	default n
	help
	This option enables actions voice effect

config AEC_TAIL_LENGTH
	int
	prompt "AEC tail length config"
	depends on VOICE_EFFECT
	default 48
	help
	This option set AEC tail length config


config MEDIA_DSP_SLEEP
	bool
	prompt "dsp sleep Support"
	depends on MEDIA
	default y
	help
	This option enables dsp sleep

config MEDIA_DSP_SLEEP_MODE
	int
	prompt "dsp sleep mode, 0: light sleep, 1: deep sleep"
	depends on MEDIA
	default 1
	help
	This option dsp sleep mode, 0: light sleep, 1: deep sleep

config VIDEO_PLAYER
	bool
	prompt "video player Support"
	default n
	help
	This option enables actions video player
	
rsource "libal/Kconfig"
```

## action_technology_zephyr_sdk/framework/ota/Kconfig
```kconfig
# Kconfig - Actions ota

#
# Copyright (c) 2016 Actions Corporation
#
# SPDX-License-Identifier: Apache-2.0
#

menuconfig OTA
	bool
	prompt "ota"
	default n
	help
	This option enables actions ota

config OTA_LZMA
	bool "OTA lzma Support"
	depends on OTA
	default y
	help
	  This option enable OTA lzma.

config OTA_PRODUCT_SUPPORT
	bool "OTA product Support"
	depends on OTA
	default n
	help
	  This option enable OTA transmit.

config OTA_BLE_MASTER_SUPPORT
	bool "LE OTA product Support"
	depends on OTA
	default n
	help
	  This option enable BLE OTA transmit.
```

## action_technology_zephyr_sdk/framework/system/act_log/Kconfig
```kconfig
# Kconfig - Actions system manager

#
# Copyright (c) 2016 Actions Corporation
#
# SPDX-License-Identifier: Apache-2.0
#

menuconfig ACTLOG
	bool
	prompt "Actlog"
	default n
	help
	This option enables actions log system

if ACTLOG
config ACTLOG_COMPILE_LEVEL
	int "Default actlog compile level"
	default 3
	range 0 4
	help
	  Sets log level for modules which don't specify it explicitly. When
	  set to 0 it means log will not be activated for those modules.
	  Levels are:

	  - 0 OFF, do not write by default
	  - 1 ERROR, default to only write LOG_LEVEL_ERR
	  - 2 WARNING, default to write LOG_LEVEL_WRN
	  - 3 INFO, default to write LOG_LEVEL_INFO
	  - 4 DEBUG, default to write LOG_LEVEL_DBG	

config ACTLOG_APP_COMPILE_LEVEL
	int "Default actlog app compile level"
	default 3
	range 0 4
	help
	  Sets log level for modules which don't specify it explicitly. When
	  set to 0 it means log will not be activated for those modules.
	  Levels are:

	  - 0 OFF, do not write by default
	  - 1 ERROR, default to only write LOG_LEVEL_ERR
	  - 2 WARNING, default to write LOG_LEVEL_WRN
	  - 3 INFO, default to write LOG_LEVEL_INFO
	  - 4 DEBUG, default to write LOG_LEVEL_DBG		  

config ACTLOG_USE_NORMALLOG
	bool "Enable normal in actlog"
	default n
	help
	  Enable normal log in actlog  	

config ACTLOG_USE_NANOLOG
	bool "Enable nanolog replace normal log in actlog"
	default n
	help
	  Enable nanolog replace normal log in actlog  	  

config ACTLOG_COMPILE_MODUL_LEVEL
	bool "Enable actlog compile by module level"
	default n
	help
	  Enable actlog compile by module level or not  

config ACTLOG_SHOW_FUNCTION
	bool "Enable show functions in actlog"
	default n
	help
	  Enable show functions in actlog  

config ACTLOG_SHOW_TIMESTAMP
	bool "Enable show timestamp in actlog"
	default n
	help
	  Enable show timestamp in actlog 

config ACTLOG_OUTPUT_BINARY
	bool "Enable actlog output to flash binary region"
	default n
	help
	  Enable actlog output to flash binary region

config ACTLOG_OUTPUT_FILE
	bool "Enable actlog output to flash filesystem"
	default n
	help
	  Enable actlog output to flash filesystem	 

config ACTLOG_OUTPUT_FLOW
	bool "Enable actlog output to flow device"
	default n
	help
	  Enable actlog output to flow device	

config ACTLOG_OUTPUT_USER
	bool "Enable actlog output to user-defined flow"
	default n
	help
	  Enable actlog output to user-defined flow

config ACTLOG_LOG_DATA_COMPRESS
	bool "Enable actlog data compress store"
	default n
	help
	  enable actlog data compress store

config ACTLOG_LOG_BUFFER
	bool "Enable actlog store normal log to flash buffer"
	default n
	help
	  Enable actlog store normal log to flash buffer		  

config ACTLOG_RUNTIME_LOG_BUFFER
	bool "Enable actlog store runtime log to flash buffer"
	default n
	help
	  Enable actlog store runtime log to flash buffer	

config ACTLOG_EVENT_BUFFER
	bool "Enable actlog store event to flash buffer"
	default n
	help
	  Enable actlog store event to flash buffef

config DEBUG_ACTLOG_SHELL  
	bool "Enable actlog shell to dump actlog"
	default n
	help
	  Enable actlog shell to dump actlog

config ACTLOG_FLASH_CACHE_SIZE
	int "Default actlog flash cache size, must be an integer multiple of 4k"
	default 2048
	help
		Default actlog flash cache size, must be an integer multiple of 4k

config ACTLOG_LINEBUF_SIZE
	int "Default actlog line buf size"
	default 256
	help
		Default actlog line buf size	

config ACTLOG_FMT_DATA_SIZE
	int "Default actlog vsnprintk max buf size"
	default 128
	help
		Default actlog vsnprintk max buf size	

config ACTLOG_NORMAL_LOG_NUM
	int "Default actlog normal log number"
	default 3
	help
		Default actlog normal log number

config ACTLOG_NANO_LOG_NUM
	int "Default actlog nano log number"
	default 16
	help
		Default actlog nano log number				

config ACTLOG_PRINT_DROP_COUNT
	bool "Enable actlog output drop count"
	default n
	help
	  Enable actlog output drop count

#specify module name
module = ACTLOG

#specify module name str
module-str = logging_actlog

#import kconfig template
source "subsys/logging/Kconfig.template.log_config"

endif	  					
```

## action_technology_zephyr_sdk/framework/system/input/Kconfig
```kconfig
# Kconfig - Actions input menager

#
# Copyright (c) 2016 Actions Corporation
#
# SPDX-License-Identifier: Apache-2.0
#

menuconfig INPUT
	bool
	prompt "Input"
	select INPUT_MANAGER
	default n
	help
	This option enables actions input 
	
config INPUT_MANAGER
	bool
	prompt "INPUT manager Support"
	depends on INPUT
	select KEY
	default n
	help
	This option enables actions input manager.

config INPUT_MUTIPLE_CLICK
	bool
	prompt "INPUT mutiple click Support"
	depends on INPUT_MANAGER
	default n
	help
	This option enables actions input manager.

config INPUT_POINTER
	bool
	prompt "INPUT Pointer Support"
	depends on INPUT_MANAGER
	default n
	help
	This option enables actions input pointer.


config INPUT_KEYPAD
	bool
	prompt "INPUT KEYPAD Support"
	depends on INPUT_MANAGER
	default n
	help
	This option enables actions input keypad.


config INPUT_ENCODER
	bool
	prompt "INPUT ENCODER Support"
	depends on INPUT_MANAGER
	default n
	help
	This option enables actions input encoder.
```

## action_technology_zephyr_sdk/framework/usb/Kconfig
```kconfig
# Kconfig - USB device stack configuration options

#
# Copyright (c) 2016 Wind River Systems, Inc.
#
# SPDX-License-Identifier: Apache-2.0
#

menuconfig USB_DEVICE_STACK
	bool
	prompt "USB device stack"
	depends on USB_DEVICE_DRIVER || ARCH_POSIX
	default n
	help
	  Enable USB device stack.

if USB_DEVICE_STACK

config SYS_LOG_USB_DEVICE_LEVEL
	int
	prompt "Sets log level for the USB device stack"
	default 0
	depends on LOG
	help
	  This option sets log level for the USB device stack.

	  Levels are:

	  - 0 OFF, do not write

	  - 1 ERROR, only write SYS_LOG_ERR

	  - 2 WARNING, write SYS_LOG_WRN in addition to previous level

	  - 3 INFO, write SYS_LOG_INF in addition to previous levels

	  - 4 DEBUG, write SYS_LOG_DBG in addition to previous levels

config USB_DEVICE_SELF_POWERED
	bool "Enable USB device with self-powered"
	default n
	help
	  This option enables USB device with self-powered.

config USB_DEVICE_REMOTE_WAKEUP
	bool "Enable support for remote wakeup"
	default n
	help
	  This option requires USBD peripheral driver to also support remote wakeup.

config USB_DEVICE_STRING_DESC_MAX_LEN
	int
	prompt "The max len of device string descriptor"
	default 20
	help
	  The max len of device string descriptor.

config USB_DEVICE_TRANSFER
	bool
	prompt "Enable usb transfer work"
	default n
	help
	  Enable usb transfer work.

config USB_COMPOSITE_DEVICE_CLASS_NUM
	int
	prompt "Number of single class devices in composite devices"
	default 2
	help
	  Number of single class devices in composite devices.

config USB_REQUEST_BUFFER_SIZE
	int "Set buffer size for Standard, Class and Vendor request handlers"
	range 256 65536 if USB_DEVICE_NETWORK_RNDIS
	range 8 65536
	default 256 if USB_DEVICE_NETWORK_RNDIS
	default 1024 if USB_DEVICE_LOOPBACK
	default 128

config USB_DEVICE_BOS
	bool
	prompt "Enable USB Binary Device Object Store (BOS)"
	default n

rsource "class/Kconfig"

endif # USB_DEVICE_STACK

menuconfig USB_HOST_STACK
	bool
	prompt "USB host stack"
	depends on USB_HOST_DRIVER
	default n
	help
	  Enable USB host stack.

if USB_HOST_STACK

config SYS_LOG_USB_HOST_LEVEL
	int
	prompt "Sets log level for the USB host stack"
	default 0
	depends on SYS_LOG
	help
	  This option sets log level for the USB host stack.

	  Levels are:

	  - 0 OFF, do not write

	  - 1 ERROR, only write SYS_LOG_ERR

	  - 2 WARNING, write SYS_LOG_WRN in addition to previous level

	  - 3 INFO, write SYS_LOG_INF in addition to previous levels

	  - 4 DEBUG, write SYS_LOG_DBG in addition to previous levels

config USB_HOST_MAXINTERFACES
	int
	prompt "max number of interfaces of one configure"
	default 1

config USB_HOST_MAXENDPOINTS
	int
	prompt "max number of endpoints of one interface"
	default 2

config USB_HOST_RAW_DESCRIPTORS_SIZE
	int
	prompt "max size of the whole configure descriptor"
	default 32

rsource "host/Kconfig"

endif # USB_HOST_STACK
```
